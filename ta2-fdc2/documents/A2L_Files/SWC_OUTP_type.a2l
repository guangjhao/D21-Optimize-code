ASAP2_VERSION 1 31
/begin PROJECT ProjectName "Project Comment Goes Here"
/begin HEADER "Header Comments go here" /end HEADER
/begin MODULE ModuleName "Module Comment Goes Here"
/begin MOD_COMMON "Mod Common Comment Here" BYTE_ORDER MSB_LAST /end MOD_COMMON
/begin RECORD_LAYOUT Scalar_BOOLEAN FNC_VALUES 1 UBYTE COLUMN_DIR DIRECT /end RECORD_LAYOUT
/begin RECORD_LAYOUT Scalar_UBYTE FNC_VALUES 1 UBYTE COLUMN_DIR DIRECT /end RECORD_LAYOUT
/begin RECORD_LAYOUT Scalar_UWORD FNC_VALUES 1 UWORD COLUMN_DIR DIRECT /end RECORD_LAYOUT
/begin RECORD_LAYOUT Scalar_ULONG FNC_VALUES 1 ULONG COLUMN_DIR DIRECT /end RECORD_LAYOUT
/begin RECORD_LAYOUT Scalar_FLOAT32_IEEE FNC_VALUES 1 FLOAT32_IEEE COLUMN_DIR DIRECT /end RECORD_LAYOUT
/begin RECORD_LAYOUT Lookup2D_X_UBYTE AXIS_PTS_X 1 UBYTE INDEX_INCR DIRECT /end RECORD_LAYOUT
/begin RECORD_LAYOUT Lookup2D_BYTE FNC_VALUES 1 SBYTE COLUMN_DIR DIRECT /end RECORD_LAYOUT
/begin RECORD_LAYOUT Lookup2D_X_BYTE AXIS_PTS_X 1 SBYTE INDEX_INCR DIRECT /end RECORD_LAYOUT
/begin RECORD_LAYOUT Lookup2D_UWORD FNC_VALUES 1 UWORD COLUMN_DIR DIRECT /end RECORD_LAYOUT
/begin CHARACTERISTIC KOUTP_DCCurr_A_maxval "" VALUE 0x0000 /* @ECU_Address@KOUTP_DCCurr_A_maxval@ */ Scalar_FLOAT32_IEEE 0 SWC_OUTP_type_CM_single_A -100000.0 100000.0 /end CHARACTERISTIC
/begin CHARACTERISTIC KOUTP_DCCurr_A_minval "" VALUE 0x0000 /* @ECU_Address@KOUTP_DCCurr_A_minval@ */ Scalar_FLOAT32_IEEE 0 SWC_OUTP_type_CM_single_A -100000.0 100000.0 /end CHARACTERISTIC
/begin CHARACTERISTIC KOUTP_DCCurr_A_ovrdval "" VALUE 0x0000 /* @ECU_Address@KOUTP_DCCurr_A_ovrdval@ */ Scalar_FLOAT32_IEEE 0 SWC_OUTP_type_CM_single_A -100000.0 100000.0 /end CHARACTERISTIC
/begin CHARACTERISTIC KOUTP_DCVol_V_maxval "" VALUE 0x0000 /* @ECU_Address@KOUTP_DCVol_V_maxval@ */ Scalar_FLOAT32_IEEE 0 SWC_OUTP_type_CM_single_V -100000.0 100000.0 /end CHARACTERISTIC
/begin CHARACTERISTIC KOUTP_DCVol_V_minval "" VALUE 0x0000 /* @ECU_Address@KOUTP_DCVol_V_minval@ */ Scalar_FLOAT32_IEEE 0 SWC_OUTP_type_CM_single_V -100000.0 100000.0 /end CHARACTERISTIC
/begin CHARACTERISTIC KOUTP_DCVol_V_ovrdval "" VALUE 0x0000 /* @ECU_Address@KOUTP_DCVol_V_ovrdval@ */ Scalar_FLOAT32_IEEE 0 SWC_OUTP_type_CM_single_V -100000.0 100000.0 /end CHARACTERISTIC
/begin CHARACTERISTIC KOUTP_DISCTargetSpd_kph_maxval "" VALUE 0x0000 /* @ECU_Address@KOUTP_DISCTargetSpd_kph_maxval@ */ Scalar_FLOAT32_IEEE 0 SWC_OUTP_type_CM_single_kph -65535.0 65535.0 /end CHARACTERISTIC
/begin CHARACTERISTIC KOUTP_DISCTargetSpd_kph_minval "" VALUE 0x0000 /* @ECU_Address@KOUTP_DISCTargetSpd_kph_minval@ */ Scalar_FLOAT32_IEEE 0 SWC_OUTP_type_CM_single_kph -65535.0 65535.0 /end CHARACTERISTIC
/begin CHARACTERISTIC KOUTP_DISCTargetSpd_kph_ovrdval "" VALUE 0x0000 /* @ECU_Address@KOUTP_DISCTargetSpd_kph_ovrdval@ */ Scalar_FLOAT32_IEEE 0 SWC_OUTP_type_CM_single_kph -65535.0 65535.0 /end CHARACTERISTIC
/begin CHARACTERISTIC KOUTP_HVESSCHARGEACT_kW_ovrdval "" VALUE 0x0000 /* @ECU_Address@KOUTP_HVESSCHARGEACT_kW_ovrdval@ */ Scalar_FLOAT32_IEEE 0 SWC_OUTP_type_CM_single_kW -65535.0 65535.0 /end CHARACTERISTIC
/begin CHARACTERISTIC KOUTP_HVESSCHARGELIM_kW_maxval "" VALUE 0x0000 /* @ECU_Address@KOUTP_HVESSCHARGELIM_kW_maxval@ */ Scalar_FLOAT32_IEEE 0 SWC_OUTP_type_CM_single_kW -65535.0 65535.0 /end CHARACTERISTIC
/begin CHARACTERISTIC KOUTP_HVESSCHARGELIM_kW_minval "" VALUE 0x0000 /* @ECU_Address@KOUTP_HVESSCHARGELIM_kW_minval@ */ Scalar_FLOAT32_IEEE 0 SWC_OUTP_type_CM_single_kW -65535.0 65535.0 /end CHARACTERISTIC
/begin CHARACTERISTIC KOUTP_HVESSCHARGELIM_kW_ovrdval "" VALUE 0x0000 /* @ECU_Address@KOUTP_HVESSCHARGELIM_kW_ovrdval@ */ Scalar_FLOAT32_IEEE 0 SWC_OUTP_type_CM_single_kW -65535.0 65535.0 /end CHARACTERISTIC
/begin CHARACTERISTIC KOUTP_HVESSENER_Whps_maxval "" VALUE 0x0000 /* @ECU_Address@KOUTP_HVESSENER_Whps_maxval@ */ Scalar_FLOAT32_IEEE 0 SWC_OUTP_type_CM_single_Whps -65535.0 65535.0 /end CHARACTERISTIC
/begin CHARACTERISTIC KOUTP_HVESSENER_Whps_minval "" VALUE 0x0000 /* @ECU_Address@KOUTP_HVESSENER_Whps_minval@ */ Scalar_FLOAT32_IEEE 0 SWC_OUTP_type_CM_single_Whps -65535.0 65535.0 /end CHARACTERISTIC
/begin CHARACTERISTIC KOUTP_HVESSENER_Whps_ovrdval "" VALUE 0x0000 /* @ECU_Address@KOUTP_HVESSENER_Whps_ovrdval@ */ Scalar_FLOAT32_IEEE 0 SWC_OUTP_type_CM_single_Whps -65535.0 65535.0 /end CHARACTERISTIC
/begin CHARACTERISTIC KOUTP_MAXBATTEMPL_C_maxval "" VALUE 0x0000 /* @ECU_Address@KOUTP_MAXBATTEMPL_C_maxval@ */ Scalar_FLOAT32_IEEE 0 SWC_OUTP_type_CM_single_C -65535.0 65535.0 /end CHARACTERISTIC
/begin CHARACTERISTIC KOUTP_MAXBATTEMPL_C_minval "" VALUE 0x0000 /* @ECU_Address@KOUTP_MAXBATTEMPL_C_minval@ */ Scalar_FLOAT32_IEEE 0 SWC_OUTP_type_CM_single_C -65535.0 65535.0 /end CHARACTERISTIC
/begin CHARACTERISTIC KOUTP_MAXBATTEMPL_C_ovrdval "" VALUE 0x0000 /* @ECU_Address@KOUTP_MAXBATTEMPL_C_ovrdval@ */ Scalar_FLOAT32_IEEE 0 SWC_OUTP_type_CM_single_C -65535.0 65535.0 /end CHARACTERISTIC
/begin CHARACTERISTIC KOUTP_MILDIST_km_maxval "" VALUE 0x0000 /* @ECU_Address@KOUTP_MILDIST_km_maxval@ */ Scalar_FLOAT32_IEEE 0 SWC_OUTP_type_CM_single_km -65535.0 65535.0 /end CHARACTERISTIC
/begin CHARACTERISTIC KOUTP_MILDIST_km_minval "" VALUE 0x0000 /* @ECU_Address@KOUTP_MILDIST_km_minval@ */ Scalar_FLOAT32_IEEE 0 SWC_OUTP_type_CM_single_km -65535.0 65535.0 /end CHARACTERISTIC
/begin CHARACTERISTIC KOUTP_MILDIST_km_ovrdval "" VALUE 0x0000 /* @ECU_Address@KOUTP_MILDIST_km_ovrdval@ */ Scalar_FLOAT32_IEEE 0 SWC_OUTP_type_CM_single_km -65535.0 65535.0 /end CHARACTERISTIC
/begin CHARACTERISTIC KOUTP_MINBATTEMPL_C_maxval "" VALUE 0x0000 /* @ECU_Address@KOUTP_MINBATTEMPL_C_maxval@ */ Scalar_FLOAT32_IEEE 0 SWC_OUTP_type_CM_single_C -65535.0 65535.0 /end CHARACTERISTIC
/begin CHARACTERISTIC KOUTP_MINBATTEMPL_C_minval "" VALUE 0x0000 /* @ECU_Address@KOUTP_MINBATTEMPL_C_minval@ */ Scalar_FLOAT32_IEEE 0 SWC_OUTP_type_CM_single_C -65535.0 65535.0 /end CHARACTERISTIC
/begin CHARACTERISTIC KOUTP_MINBATTEMPL_C_ovrdval "" VALUE 0x0000 /* @ECU_Address@KOUTP_MINBATTEMPL_C_ovrdval@ */ Scalar_FLOAT32_IEEE 0 SWC_OUTP_type_CM_single_C -65535.0 65535.0 /end CHARACTERISTIC
/begin CHARACTERISTIC KOUTP_ODOMETER_km_maxval "" VALUE 0x0000 /* @ECU_Address@KOUTP_ODOMETER_km_maxval@ */ Scalar_FLOAT32_IEEE 0 SWC_OUTP_type_CM_single_km -65535.0 4.294967295E+8 /end CHARACTERISTIC
/begin CHARACTERISTIC KOUTP_ODOMETER_km_minval "" VALUE 0x0000 /* @ECU_Address@KOUTP_ODOMETER_km_minval@ */ Scalar_FLOAT32_IEEE 0 SWC_OUTP_type_CM_single_km -65535.0 4.294967295E+8 /end CHARACTERISTIC
/begin CHARACTERISTIC KOUTP_ODOMETER_km_ovrdval "" VALUE 0x0000 /* @ECU_Address@KOUTP_ODOMETER_km_ovrdval@ */ Scalar_FLOAT32_IEEE 0 SWC_OUTP_type_CM_single_km -65535.0 4.294967295E+8 /end CHARACTERISTIC
/begin CHARACTERISTIC KOUTP_PKELNumerator_kphsqr_maxval "" VALUE 0x0000 /* @ECU_Address@KOUTP_PKELNumerator_kphsqr_maxval@ */ Scalar_FLOAT32_IEEE 0 SWC_OUTP_type_CM_single_kphsqr -65535.0 3.4028E+38 /end CHARACTERISTIC
/begin CHARACTERISTIC KOUTP_PKELNumerator_kphsqr_minval "" VALUE 0x0000 /* @ECU_Address@KOUTP_PKELNumerator_kphsqr_minval@ */ Scalar_FLOAT32_IEEE 0 SWC_OUTP_type_CM_single_kphsqr -65535.0 3.4028E+38 /end CHARACTERISTIC
/begin CHARACTERISTIC KOUTP_PKELNumerator_kphsqr_ovrdval "" VALUE 0x0000 /* @ECU_Address@KOUTP_PKELNumerator_kphsqr_ovrdval@ */ Scalar_FLOAT32_IEEE 0 SWC_OUTP_type_CM_single_kphsqr -65535.0 3.4028E+38 /end CHARACTERISTIC
/begin CHARACTERISTIC KOUTP_PKEL_kphsqr_maxval "" VALUE 0x0000 /* @ECU_Address@KOUTP_PKEL_kphsqr_maxval@ */ Scalar_FLOAT32_IEEE 0 SWC_OUTP_type_CM_single_kphsqr -65535.0 4.294967295E+9 /end CHARACTERISTIC
/begin CHARACTERISTIC KOUTP_PKEL_kphsqr_minval "" VALUE 0x0000 /* @ECU_Address@KOUTP_PKEL_kphsqr_minval@ */ Scalar_FLOAT32_IEEE 0 SWC_OUTP_type_CM_single_kphsqr -65535.0 4.294967295E+9 /end CHARACTERISTIC
/begin CHARACTERISTIC KOUTP_PKEL_kphsqr_ovrdval "" VALUE 0x0000 /* @ECU_Address@KOUTP_PKEL_kphsqr_ovrdval@ */ Scalar_FLOAT32_IEEE 0 SWC_OUTP_type_CM_single_kphsqr -65535.0 4.294967295E+9 /end CHARACTERISTIC
/begin CHARACTERISTIC KOUTP_PKERNumerator_kphsqr_maxval "" VALUE 0x0000 /* @ECU_Address@KOUTP_PKERNumerator_kphsqr_maxval@ */ Scalar_FLOAT32_IEEE 0 SWC_OUTP_type_CM_single_kphsqr -65535.0 3.4028E+38 /end CHARACTERISTIC
/begin CHARACTERISTIC KOUTP_PKERNumerator_kphsqr_minval "" VALUE 0x0000 /* @ECU_Address@KOUTP_PKERNumerator_kphsqr_minval@ */ Scalar_FLOAT32_IEEE 0 SWC_OUTP_type_CM_single_kphsqr -65535.0 3.4028E+38 /end CHARACTERISTIC
/begin CHARACTERISTIC KOUTP_PKERNumerator_kphsqr_ovrdval "" VALUE 0x0000 /* @ECU_Address@KOUTP_PKERNumerator_kphsqr_ovrdval@ */ Scalar_FLOAT32_IEEE 0 SWC_OUTP_type_CM_single_kphsqr -65535.0 3.4028E+38 /end CHARACTERISTIC
/begin CHARACTERISTIC KOUTP_PKER_kphsqr_maxval "" VALUE 0x0000 /* @ECU_Address@KOUTP_PKER_kphsqr_maxval@ */ Scalar_FLOAT32_IEEE 0 SWC_OUTP_type_CM_single_kphsqr -65535.0 4.294967295E+9 /end CHARACTERISTIC
/begin CHARACTERISTIC KOUTP_PKER_kphsqr_minval "" VALUE 0x0000 /* @ECU_Address@KOUTP_PKER_kphsqr_minval@ */ Scalar_FLOAT32_IEEE 0 SWC_OUTP_type_CM_single_kphsqr -65535.0 4.294967295E+9 /end CHARACTERISTIC
/begin CHARACTERISTIC KOUTP_PKER_kphsqr_ovrdval "" VALUE 0x0000 /* @ECU_Address@KOUTP_PKER_kphsqr_ovrdval@ */ Scalar_FLOAT32_IEEE 0 SWC_OUTP_type_CM_single_kphsqr -65535.0 4.294967295E+9 /end CHARACTERISTIC
/begin CHARACTERISTIC KOUTP_RESSV2XENNONPSAL_kWh_maxval "" VALUE 0x0000 /* @ECU_Address@KOUTP_RESSV2XENNONPSAL_kWh_maxval@ */ Scalar_FLOAT32_IEEE 0 SWC_OUTP_type_CM_single_kWh -65535.0 4.294967295E+8 /end CHARACTERISTIC
/begin CHARACTERISTIC KOUTP_RESSV2XENNONPSAL_kWh_minval "" VALUE 0x0000 /* @ECU_Address@KOUTP_RESSV2XENNONPSAL_kWh_minval@ */ Scalar_FLOAT32_IEEE 0 SWC_OUTP_type_CM_single_kWh -65535.0 4.294967295E+8 /end CHARACTERISTIC
/begin CHARACTERISTIC KOUTP_RESSV2XENNONPSAL_kWh_ovrdval "" VALUE 0x0000 /* @ECU_Address@KOUTP_RESSV2XENNONPSAL_kWh_ovrdval@ */ Scalar_FLOAT32_IEEE 0 SWC_OUTP_type_CM_single_kWh -65535.0 4.294967295E+8 /end CHARACTERISTIC
/begin CHARACTERISTIC KOUTP_RESSV2XENNONPSAR_kWh_maxval "" VALUE 0x0000 /* @ECU_Address@KOUTP_RESSV2XENNONPSAR_kWh_maxval@ */ Scalar_FLOAT32_IEEE 0 SWC_OUTP_type_CM_single_kWh -65535.0 4.294967295E+8 /end CHARACTERISTIC
/begin CHARACTERISTIC KOUTP_RESSV2XENNONPSAR_kWh_minval "" VALUE 0x0000 /* @ECU_Address@KOUTP_RESSV2XENNONPSAR_kWh_minval@ */ Scalar_FLOAT32_IEEE 0 SWC_OUTP_type_CM_single_kWh -65535.0 4.294967295E+8 /end CHARACTERISTIC
/begin CHARACTERISTIC KOUTP_RESSV2XENNONPSAR_kWh_ovrdval "" VALUE 0x0000 /* @ECU_Address@KOUTP_RESSV2XENNONPSAR_kWh_ovrdval@ */ Scalar_FLOAT32_IEEE 0 SWC_OUTP_type_CM_single_kWh -65535.0 4.294967295E+8 /end CHARACTERISTIC
/begin CHARACTERISTIC KOUTP_ResetCDEODTR_km_maxval "" VALUE 0x0000 /* @ECU_Address@KOUTP_ResetCDEODTR_km_maxval@ */ Scalar_FLOAT32_IEEE 0 SWC_OUTP_type_CM_single_km -65535.0 4.294967295E+8 /end CHARACTERISTIC
/begin CHARACTERISTIC KOUTP_ResetCDEODTR_km_minval "" VALUE 0x0000 /* @ECU_Address@KOUTP_ResetCDEODTR_km_minval@ */ Scalar_FLOAT32_IEEE 0 SWC_OUTP_type_CM_single_km -65535.0 4.294967295E+8 /end CHARACTERISTIC
/begin CHARACTERISTIC KOUTP_ResetCDEODTR_km_ovrdval "" VALUE 0x0000 /* @ECU_Address@KOUTP_ResetCDEODTR_km_ovrdval@ */ Scalar_FLOAT32_IEEE 0 SWC_OUTP_type_CM_single_km -65535.0 4.294967295E+8 /end CHARACTERISTIC
/begin CHARACTERISTIC KOUTP_TEBPSAL_kWh_maxval "" VALUE 0x0000 /* @ECU_Address@KOUTP_TEBPSAL_kWh_maxval@ */ Scalar_FLOAT32_IEEE 0 SWC_OUTP_type_CM_single_kWh -65535.0 4.294967295E+8 /end CHARACTERISTIC
/begin CHARACTERISTIC KOUTP_TEBPSAL_kWh_minval "" VALUE 0x0000 /* @ECU_Address@KOUTP_TEBPSAL_kWh_minval@ */ Scalar_FLOAT32_IEEE 0 SWC_OUTP_type_CM_single_kWh -65535.0 4.294967295E+8 /end CHARACTERISTIC
/begin CHARACTERISTIC KOUTP_TEBPSAL_kWh_ovrdval "" VALUE 0x0000 /* @ECU_Address@KOUTP_TEBPSAL_kWh_ovrdval@ */ Scalar_FLOAT32_IEEE 0 SWC_OUTP_type_CM_single_kWh -65535.0 4.294967295E+8 /end CHARACTERISTIC
/begin CHARACTERISTIC KOUTP_TEBPSAR_kWh_maxval "" VALUE 0x0000 /* @ECU_Address@KOUTP_TEBPSAR_kWh_maxval@ */ Scalar_FLOAT32_IEEE 0 SWC_OUTP_type_CM_single_kWh -65535.0 4.294967295E+8 /end CHARACTERISTIC
/begin CHARACTERISTIC KOUTP_TEBPSAR_kWh_minval "" VALUE 0x0000 /* @ECU_Address@KOUTP_TEBPSAR_kWh_minval@ */ Scalar_FLOAT32_IEEE 0 SWC_OUTP_type_CM_single_kWh -65535.0 4.294967295E+8 /end CHARACTERISTIC
/begin CHARACTERISTIC KOUTP_TEBPSAR_kWh_ovrdval "" VALUE 0x0000 /* @ECU_Address@KOUTP_TEBPSAR_kWh_ovrdval@ */ Scalar_FLOAT32_IEEE 0 SWC_OUTP_type_CM_single_kWh -65535.0 4.294967295E+8 /end CHARACTERISTIC
/begin CHARACTERISTIC KOUTP_TGEOVCL_kWh_maxval "" VALUE 0x0000 /* @ECU_Address@KOUTP_TGEOVCL_kWh_maxval@ */ Scalar_FLOAT32_IEEE 0 SWC_OUTP_type_CM_single_kWh -65535.0 4.294967295E+8 /end CHARACTERISTIC
/begin CHARACTERISTIC KOUTP_TGEOVCL_kWh_minval "" VALUE 0x0000 /* @ECU_Address@KOUTP_TGEOVCL_kWh_minval@ */ Scalar_FLOAT32_IEEE 0 SWC_OUTP_type_CM_single_kWh -65535.0 4.294967295E+8 /end CHARACTERISTIC
/begin CHARACTERISTIC KOUTP_TGEOVCL_kWh_ovrdval "" VALUE 0x0000 /* @ECU_Address@KOUTP_TGEOVCL_kWh_ovrdval@ */ Scalar_FLOAT32_IEEE 0 SWC_OUTP_type_CM_single_kWh -65535.0 4.294967295E+8 /end CHARACTERISTIC
/begin CHARACTERISTIC KOUTP_TGEOVCR_kWh_maxval "" VALUE 0x0000 /* @ECU_Address@KOUTP_TGEOVCR_kWh_maxval@ */ Scalar_FLOAT32_IEEE 0 SWC_OUTP_type_CM_single_kWh -65535.0 4.294967295E+8 /end CHARACTERISTIC
/begin CHARACTERISTIC KOUTP_TGEOVCR_kWh_minval "" VALUE 0x0000 /* @ECU_Address@KOUTP_TGEOVCR_kWh_minval@ */ Scalar_FLOAT32_IEEE 0 SWC_OUTP_type_CM_single_kWh -65535.0 4.294967295E+8 /end CHARACTERISTIC
/begin CHARACTERISTIC KOUTP_TGEOVCR_kWh_ovrdval "" VALUE 0x0000 /* @ECU_Address@KOUTP_TGEOVCR_kWh_ovrdval@ */ Scalar_FLOAT32_IEEE 0 SWC_OUTP_type_CM_single_kWh -65535.0 4.294967295E+8 /end CHARACTERISTIC
/begin CHARACTERISTIC KOUTP_TNBCPSAL_Ahr_maxval "" VALUE 0x0000 /* @ECU_Address@KOUTP_TNBCPSAL_Ahr_maxval@ */ Scalar_FLOAT32_IEEE 0 SWC_OUTP_type_CM_single_Ahr -65535.0 4.294967295E+8 /end CHARACTERISTIC
/begin CHARACTERISTIC KOUTP_TNBCPSAL_Ahr_minval "" VALUE 0x0000 /* @ECU_Address@KOUTP_TNBCPSAL_Ahr_minval@ */ Scalar_FLOAT32_IEEE 0 SWC_OUTP_type_CM_single_Ahr -65535.0 4.294967295E+8 /end CHARACTERISTIC
/begin CHARACTERISTIC KOUTP_TNBCPSAL_Ahr_ovrdval "" VALUE 0x0000 /* @ECU_Address@KOUTP_TNBCPSAL_Ahr_ovrdval@ */ Scalar_FLOAT32_IEEE 0 SWC_OUTP_type_CM_single_Ahr -65535.0 4.294967295E+8 /end CHARACTERISTIC
/begin CHARACTERISTIC KOUTP_TNBCPSAR_Ahr_maxval "" VALUE 0x0000 /* @ECU_Address@KOUTP_TNBCPSAR_Ahr_maxval@ */ Scalar_FLOAT32_IEEE 0 SWC_OUTP_type_CM_single_Ahr -65535.0 4.294967295E+6 /end CHARACTERISTIC
/begin CHARACTERISTIC KOUTP_TNBCPSAR_Ahr_minval "" VALUE 0x0000 /* @ECU_Address@KOUTP_TNBCPSAR_Ahr_minval@ */ Scalar_FLOAT32_IEEE 0 SWC_OUTP_type_CM_single_Ahr -65535.0 4.294967295E+6 /end CHARACTERISTIC
/begin CHARACTERISTIC KOUTP_TNBCPSAR_Ahr_ovrdval "" VALUE 0x0000 /* @ECU_Address@KOUTP_TNBCPSAR_Ahr_ovrdval@ */ Scalar_FLOAT32_IEEE 0 SWC_OUTP_type_CM_single_Ahr -65535.0 4.294967295E+6 /end CHARACTERISTIC
/begin CHARACTERISTIC KOUTP_TNECPSAL_kWh_maxval "" VALUE 0x0000 /* @ECU_Address@KOUTP_TNECPSAL_kWh_maxval@ */ Scalar_FLOAT32_IEEE 0 SWC_OUTP_type_CM_single_kWh -65535.0 4.294967295E+8 /end CHARACTERISTIC
/begin CHARACTERISTIC KOUTP_TNECPSAL_kWh_minval "" VALUE 0x0000 /* @ECU_Address@KOUTP_TNECPSAL_kWh_minval@ */ Scalar_FLOAT32_IEEE 0 SWC_OUTP_type_CM_single_kWh -65535.0 4.294967295E+8 /end CHARACTERISTIC
/begin CHARACTERISTIC KOUTP_TNECPSAL_kWh_ovrdval "" VALUE 0x0000 /* @ECU_Address@KOUTP_TNECPSAL_kWh_ovrdval@ */ Scalar_FLOAT32_IEEE 0 SWC_OUTP_type_CM_single_kWh -65535.0 4.294967295E+8 /end CHARACTERISTIC
/begin CHARACTERISTIC KOUTP_TNECPSAR_kWh_maxval "" VALUE 0x0000 /* @ECU_Address@KOUTP_TNECPSAR_kWh_maxval@ */ Scalar_FLOAT32_IEEE 0 SWC_OUTP_type_CM_single_kWh -65535.0 4.294967295E+8 /end CHARACTERISTIC
/begin CHARACTERISTIC KOUTP_TNECPSAR_kWh_minval "" VALUE 0x0000 /* @ECU_Address@KOUTP_TNECPSAR_kWh_minval@ */ Scalar_FLOAT32_IEEE 0 SWC_OUTP_type_CM_single_kWh -65535.0 4.294967295E+8 /end CHARACTERISTIC
/begin CHARACTERISTIC KOUTP_TNECPSAR_kWh_ovrdval "" VALUE 0x0000 /* @ECU_Address@KOUTP_TNECPSAR_kWh_ovrdval@ */ Scalar_FLOAT32_IEEE 0 SWC_OUTP_type_CM_single_kWh -65535.0 4.294967295E+8 /end CHARACTERISTIC
/begin CHARACTERISTIC KOUTP_VSS_kph_maxval "" VALUE 0x0000 /* @ECU_Address@KOUTP_VSS_kph_maxval@ */ Scalar_FLOAT32_IEEE 0 SWC_OUTP_type_CM_single_kph -65535.0 65535.0 /end CHARACTERISTIC
/begin CHARACTERISTIC KOUTP_VSS_kph_minval "" VALUE 0x0000 /* @ECU_Address@KOUTP_VSS_kph_minval@ */ Scalar_FLOAT32_IEEE 0 SWC_OUTP_type_CM_single_kph -65535.0 65535.0 /end CHARACTERISTIC
/begin CHARACTERISTIC KOUTP_VSS_kph_ovrdval "" VALUE 0x0000 /* @ECU_Address@KOUTP_VSS_kph_ovrdval@ */ Scalar_FLOAT32_IEEE 0 SWC_OUTP_type_CM_single_kph -65535.0 65535.0 /end CHARACTERISTIC
/begin CHARACTERISTIC KOUTP_DKCTimeSN_cnt_maxval "" VALUE 0x0000 /* @ECU_Address@KOUTP_DKCTimeSN_cnt_maxval@ */ Scalar_ULONG 0 SWC_OUTP_type_CM_uint32_cnt 0.0 4.294967295E+9 /end CHARACTERISTIC
/begin CHARACTERISTIC KOUTP_DKCTimeSN_cnt_minval "" VALUE 0x0000 /* @ECU_Address@KOUTP_DKCTimeSN_cnt_minval@ */ Scalar_ULONG 0 SWC_OUTP_type_CM_uint32_cnt 0.0 4.294967295E+9 /end CHARACTERISTIC
/begin CHARACTERISTIC KOUTP_DKCTimeSN_cnt_ovrdval "" VALUE 0x0000 /* @ECU_Address@KOUTP_DKCTimeSN_cnt_ovrdval@ */ Scalar_ULONG 0 SWC_OUTP_type_CM_uint32_cnt 0.0 4.294967295E+9 /end CHARACTERISTIC
/begin CHARACTERISTIC KOUTP_IPSAL_sec_maxval "" VALUE 0x0000 /* @ECU_Address@KOUTP_IPSAL_sec_maxval@ */ Scalar_ULONG 0 SWC_OUTP_type_CM_uint32_sec 0.0 4.294967295E+9 /end CHARACTERISTIC
/begin CHARACTERISTIC KOUTP_IPSAL_sec_minval "" VALUE 0x0000 /* @ECU_Address@KOUTP_IPSAL_sec_minval@ */ Scalar_ULONG 0 SWC_OUTP_type_CM_uint32_sec 0.0 4.294967295E+9 /end CHARACTERISTIC
/begin CHARACTERISTIC KOUTP_IPSAL_sec_ovrdval "" VALUE 0x0000 /* @ECU_Address@KOUTP_IPSAL_sec_ovrdval@ */ Scalar_ULONG 0 SWC_OUTP_type_CM_uint32_sec 0.0 4.294967295E+9 /end CHARACTERISTIC
/begin CHARACTERISTIC KOUTP_IPSAR_sec_maxval "" VALUE 0x0000 /* @ECU_Address@KOUTP_IPSAR_sec_maxval@ */ Scalar_ULONG 0 SWC_OUTP_type_CM_uint32_sec 0.0 4.294967295E+9 /end CHARACTERISTIC
/begin CHARACTERISTIC KOUTP_IPSAR_sec_minval "" VALUE 0x0000 /* @ECU_Address@KOUTP_IPSAR_sec_minval@ */ Scalar_ULONG 0 SWC_OUTP_type_CM_uint32_sec 0.0 4.294967295E+9 /end CHARACTERISTIC
/begin CHARACTERISTIC KOUTP_IPSAR_sec_ovrdval "" VALUE 0x0000 /* @ECU_Address@KOUTP_IPSAR_sec_ovrdval@ */ Scalar_ULONG 0 SWC_OUTP_type_CM_uint32_sec 0.0 4.294967295E+9 /end CHARACTERISTIC
/begin CHARACTERISTIC KOUTP_OFFL_sec_maxval "" VALUE 0x0000 /* @ECU_Address@KOUTP_OFFL_sec_maxval@ */ Scalar_ULONG 0 SWC_OUTP_type_CM_uint32_sec 0.0 4.294967295E+9 /end CHARACTERISTIC
/begin CHARACTERISTIC KOUTP_OFFL_sec_minval "" VALUE 0x0000 /* @ECU_Address@KOUTP_OFFL_sec_minval@ */ Scalar_ULONG 0 SWC_OUTP_type_CM_uint32_sec 0.0 4.294967295E+9 /end CHARACTERISTIC
/begin CHARACTERISTIC KOUTP_OFFL_sec_ovrdval "" VALUE 0x0000 /* @ECU_Address@KOUTP_OFFL_sec_ovrdval@ */ Scalar_ULONG 0 SWC_OUTP_type_CM_uint32_sec 0.0 4.294967295E+9 /end CHARACTERISTIC
/begin CHARACTERISTIC KOUTP_OFFR_sec_maxval "" VALUE 0x0000 /* @ECU_Address@KOUTP_OFFR_sec_maxval@ */ Scalar_ULONG 0 SWC_OUTP_type_CM_uint32_sec 0.0 4.294967295E+9 /end CHARACTERISTIC
/begin CHARACTERISTIC KOUTP_OFFR_sec_minval "" VALUE 0x0000 /* @ECU_Address@KOUTP_OFFR_sec_minval@ */ Scalar_ULONG 0 SWC_OUTP_type_CM_uint32_sec 0.0 4.294967295E+9 /end CHARACTERISTIC
/begin CHARACTERISTIC KOUTP_OFFR_sec_ovrdval "" VALUE 0x0000 /* @ECU_Address@KOUTP_OFFR_sec_ovrdval@ */ Scalar_ULONG 0 SWC_OUTP_type_CM_uint32_sec 0.0 4.294967295E+9 /end CHARACTERISTIC
/begin CHARACTERISTIC KOUTP_OVCL_sec_maxval "" VALUE 0x0000 /* @ECU_Address@KOUTP_OVCL_sec_maxval@ */ Scalar_ULONG 0 SWC_OUTP_type_CM_uint32_sec 0.0 4.294967295E+9 /end CHARACTERISTIC
/begin CHARACTERISTIC KOUTP_OVCL_sec_minval "" VALUE 0x0000 /* @ECU_Address@KOUTP_OVCL_sec_minval@ */ Scalar_ULONG 0 SWC_OUTP_type_CM_uint32_sec 0.0 4.294967295E+9 /end CHARACTERISTIC
/begin CHARACTERISTIC KOUTP_OVCL_sec_ovrdval "" VALUE 0x0000 /* @ECU_Address@KOUTP_OVCL_sec_ovrdval@ */ Scalar_ULONG 0 SWC_OUTP_type_CM_uint32_sec 0.0 4.294967295E+9 /end CHARACTERISTIC
/begin CHARACTERISTIC KOUTP_OVCR_sec_maxval "" VALUE 0x0000 /* @ECU_Address@KOUTP_OVCR_sec_maxval@ */ Scalar_ULONG 0 SWC_OUTP_type_CM_uint32_sec 0.0 4.294967295E+9 /end CHARACTERISTIC
/begin CHARACTERISTIC KOUTP_OVCR_sec_minval "" VALUE 0x0000 /* @ECU_Address@KOUTP_OVCR_sec_minval@ */ Scalar_ULONG 0 SWC_OUTP_type_CM_uint32_sec 0.0 4.294967295E+9 /end CHARACTERISTIC
/begin CHARACTERISTIC KOUTP_OVCR_sec_ovrdval "" VALUE 0x0000 /* @ECU_Address@KOUTP_OVCR_sec_ovrdval@ */ Scalar_ULONG 0 SWC_OUTP_type_CM_uint32_sec 0.0 4.294967295E+9 /end CHARACTERISTIC
/begin CHARACTERISTIC KOUTP_PSAL_sec_maxval "" VALUE 0x0000 /* @ECU_Address@KOUTP_PSAL_sec_maxval@ */ Scalar_ULONG 0 SWC_OUTP_type_CM_uint32_sec 0.0 4.294967295E+9 /end CHARACTERISTIC
/begin CHARACTERISTIC KOUTP_PSAL_sec_minval "" VALUE 0x0000 /* @ECU_Address@KOUTP_PSAL_sec_minval@ */ Scalar_ULONG 0 SWC_OUTP_type_CM_uint32_sec 0.0 4.294967295E+9 /end CHARACTERISTIC
/begin CHARACTERISTIC KOUTP_PSAL_sec_ovrdval "" VALUE 0x0000 /* @ECU_Address@KOUTP_PSAL_sec_ovrdval@ */ Scalar_ULONG 0 SWC_OUTP_type_CM_uint32_sec 0.0 4.294967295E+9 /end CHARACTERISTIC
/begin CHARACTERISTIC KOUTP_PSAR_sec_maxval "" VALUE 0x0000 /* @ECU_Address@KOUTP_PSAR_sec_maxval@ */ Scalar_ULONG 0 SWC_OUTP_type_CM_uint32_sec 0.0 4.294967295E+9 /end CHARACTERISTIC
/begin CHARACTERISTIC KOUTP_PSAR_sec_minval "" VALUE 0x0000 /* @ECU_Address@KOUTP_PSAR_sec_minval@ */ Scalar_ULONG 0 SWC_OUTP_type_CM_uint32_sec 0.0 4.294967295E+9 /end CHARACTERISTIC
/begin CHARACTERISTIC KOUTP_PSAR_sec_ovrdval "" VALUE 0x0000 /* @ECU_Address@KOUTP_PSAR_sec_ovrdval@ */ Scalar_ULONG 0 SWC_OUTP_type_CM_uint32_sec 0.0 4.294967295E+9 /end CHARACTERISTIC
/begin CHARACTERISTIC KOUTP_QTYPSATRIPSL_cnt_maxval "" VALUE 0x0000 /* @ECU_Address@KOUTP_QTYPSATRIPSL_cnt_maxval@ */ Scalar_ULONG 0 SWC_OUTP_type_CM_uint32_cnt 0.0 4.294967295E+9 /end CHARACTERISTIC
/begin CHARACTERISTIC KOUTP_QTYPSATRIPSL_cnt_minval "" VALUE 0x0000 /* @ECU_Address@KOUTP_QTYPSATRIPSL_cnt_minval@ */ Scalar_ULONG 0 SWC_OUTP_type_CM_uint32_cnt 0.0 4.294967295E+9 /end CHARACTERISTIC
/begin CHARACTERISTIC KOUTP_QTYPSATRIPSL_cnt_ovrdval "" VALUE 0x0000 /* @ECU_Address@KOUTP_QTYPSATRIPSL_cnt_ovrdval@ */ Scalar_ULONG 0 SWC_OUTP_type_CM_uint32_cnt 0.0 4.294967295E+9 /end CHARACTERISTIC
/begin CHARACTERISTIC KOUTP_QTYPSATRIPSR_cnt_maxval "" VALUE 0x0000 /* @ECU_Address@KOUTP_QTYPSATRIPSR_cnt_maxval@ */ Scalar_ULONG 0 SWC_OUTP_type_CM_uint32_cnt 0.0 4.294967295E+9 /end CHARACTERISTIC
/begin CHARACTERISTIC KOUTP_QTYPSATRIPSR_cnt_minval "" VALUE 0x0000 /* @ECU_Address@KOUTP_QTYPSATRIPSR_cnt_minval@ */ Scalar_ULONG 0 SWC_OUTP_type_CM_uint32_cnt 0.0 4.294967295E+9 /end CHARACTERISTIC
/begin CHARACTERISTIC KOUTP_QTYPSATRIPSR_cnt_ovrdval "" VALUE 0x0000 /* @ECU_Address@KOUTP_QTYPSATRIPSR_cnt_ovrdval@ */ Scalar_ULONG 0 SWC_OUTP_type_CM_uint32_cnt 0.0 4.294967295E+9 /end CHARACTERISTIC
/begin CHARACTERISTIC KOUTP_RESSTIMESOCCHGRNGL_s_maxval "" VALUE 0x0000 /* @ECU_Address@KOUTP_RESSTIMESOCCHGRNGL_s_maxval@ */ Scalar_ULONG 0 SWC_OUTP_type_CM_uint32_sec 0.0 4.294967295E+9 /end CHARACTERISTIC
/begin CHARACTERISTIC KOUTP_RESSTIMESOCCHGRNGL_s_minval "" VALUE 0x0000 /* @ECU_Address@KOUTP_RESSTIMESOCCHGRNGL_s_minval@ */ Scalar_ULONG 0 SWC_OUTP_type_CM_uint32_sec 0.0 4.294967295E+9 /end CHARACTERISTIC
/begin CHARACTERISTIC KOUTP_RESSTIMESOCCHGRNGL_s_ovrdval "" VALUE 0x0000 /* @ECU_Address@KOUTP_RESSTIMESOCCHGRNGL_s_ovrdval@ */ Scalar_ULONG 0 SWC_OUTP_type_CM_uint32_s 0.0 4.294967295E+9 /end CHARACTERISTIC
/begin CHARACTERISTIC KOUTP_RESSTIMESOCCHGRNGR_s_maxval "" VALUE 0x0000 /* @ECU_Address@KOUTP_RESSTIMESOCCHGRNGR_s_maxval@ */ Scalar_ULONG 0 SWC_OUTP_type_CM_uint32_sec 0.0 4.294967295E+9 /end CHARACTERISTIC
/begin CHARACTERISTIC KOUTP_RESSTIMESOCCHGRNGR_s_minval "" VALUE 0x0000 /* @ECU_Address@KOUTP_RESSTIMESOCCHGRNGR_s_minval@ */ Scalar_ULONG 0 SWC_OUTP_type_CM_uint32_sec 0.0 4.294967295E+9 /end CHARACTERISTIC
/begin CHARACTERISTIC KOUTP_RESSTIMESOCCHGRNGR_s_ovrdval "" VALUE 0x0000 /* @ECU_Address@KOUTP_RESSTIMESOCCHGRNGR_s_ovrdval@ */ Scalar_ULONG 0 SWC_OUTP_type_CM_uint32_s 0.0 4.294967295E+9 /end CHARACTERISTIC
/begin CHARACTERISTIC KOUTP_RESSTIMESOCOFFRNGL_s_maxval "" VALUE 0x0000 /* @ECU_Address@KOUTP_RESSTIMESOCOFFRNGL_s_maxval@ */ Scalar_ULONG 0 SWC_OUTP_type_CM_uint32_sec 0.0 4.294967295E+9 /end CHARACTERISTIC
/begin CHARACTERISTIC KOUTP_RESSTIMESOCOFFRNGL_s_minval "" VALUE 0x0000 /* @ECU_Address@KOUTP_RESSTIMESOCOFFRNGL_s_minval@ */ Scalar_ULONG 0 SWC_OUTP_type_CM_uint32_sec 0.0 4.294967295E+9 /end CHARACTERISTIC
/begin CHARACTERISTIC KOUTP_RESSTIMESOCOFFRNGL_s_ovrdval "" VALUE 0x0000 /* @ECU_Address@KOUTP_RESSTIMESOCOFFRNGL_s_ovrdval@ */ Scalar_ULONG 0 SWC_OUTP_type_CM_uint32_s 0.0 4.294967295E+9 /end CHARACTERISTIC
/begin CHARACTERISTIC KOUTP_RESSTIMESOCOFFRNGR_s_maxval "" VALUE 0x0000 /* @ECU_Address@KOUTP_RESSTIMESOCOFFRNGR_s_maxval@ */ Scalar_ULONG 0 SWC_OUTP_type_CM_uint32_sec 0.0 4.294967295E+9 /end CHARACTERISTIC
/begin CHARACTERISTIC KOUTP_RESSTIMESOCOFFRNGR_s_minval "" VALUE 0x0000 /* @ECU_Address@KOUTP_RESSTIMESOCOFFRNGR_s_minval@ */ Scalar_ULONG 0 SWC_OUTP_type_CM_uint32_sec 0.0 4.294967295E+9 /end CHARACTERISTIC
/begin CHARACTERISTIC KOUTP_RESSTIMESOCOFFRNGR_s_ovrdval "" VALUE 0x0000 /* @ECU_Address@KOUTP_RESSTIMESOCOFFRNGR_s_ovrdval@ */ Scalar_ULONG 0 SWC_OUTP_type_CM_uint32_s 0.0 4.294967295E+9 /end CHARACTERISTIC
/begin CHARACTERISTIC KOUTP_RESSTIMESOCPSARNGL_s_maxval "" VALUE 0x0000 /* @ECU_Address@KOUTP_RESSTIMESOCPSARNGL_s_maxval@ */ Scalar_ULONG 0 SWC_OUTP_type_CM_uint32_sec 0.0 4.294967295E+9 /end CHARACTERISTIC
/begin CHARACTERISTIC KOUTP_RESSTIMESOCPSARNGL_s_minval "" VALUE 0x0000 /* @ECU_Address@KOUTP_RESSTIMESOCPSARNGL_s_minval@ */ Scalar_ULONG 0 SWC_OUTP_type_CM_uint32_sec 0.0 4.294967295E+9 /end CHARACTERISTIC
/begin CHARACTERISTIC KOUTP_RESSTIMESOCPSARNGL_s_ovrdval "" VALUE 0x0000 /* @ECU_Address@KOUTP_RESSTIMESOCPSARNGL_s_ovrdval@ */ Scalar_ULONG 0 SWC_OUTP_type_CM_uint32_s 0.0 4.294967295E+9 /end CHARACTERISTIC
/begin CHARACTERISTIC KOUTP_RESSTIMESOCPSARNGR_s_maxval "" VALUE 0x0000 /* @ECU_Address@KOUTP_RESSTIMESOCPSARNGR_s_maxval@ */ Scalar_ULONG 0 SWC_OUTP_type_CM_uint32_sec 0.0 4.294967295E+9 /end CHARACTERISTIC
/begin CHARACTERISTIC KOUTP_RESSTIMESOCPSARNGR_s_minval "" VALUE 0x0000 /* @ECU_Address@KOUTP_RESSTIMESOCPSARNGR_s_minval@ */ Scalar_ULONG 0 SWC_OUTP_type_CM_uint32_sec 0.0 4.294967295E+9 /end CHARACTERISTIC
/begin CHARACTERISTIC KOUTP_RESSTIMESOCPSARNGR_s_ovrdval "" VALUE 0x0000 /* @ECU_Address@KOUTP_RESSTIMESOCPSARNGR_s_ovrdval@ */ Scalar_ULONG 0 SWC_OUTP_type_CM_uint32_s 0.0 4.294967295E+9 /end CHARACTERISTIC
/begin CHARACTERISTIC KOUTP_TimeSNDKCFbk_cnt_maxval "" VALUE 0x0000 /* @ECU_Address@KOUTP_TimeSNDKCFbk_cnt_maxval@ */ Scalar_ULONG 0 SWC_OUTP_type_CM_uint32_cnt 0.0 4.294967295E+9 /end CHARACTERISTIC
/begin CHARACTERISTIC KOUTP_TimeSNDKCFbk_cnt_minval "" VALUE 0x0000 /* @ECU_Address@KOUTP_TimeSNDKCFbk_cnt_minval@ */ Scalar_ULONG 0 SWC_OUTP_type_CM_uint32_cnt 0.0 4.294967295E+9 /end CHARACTERISTIC
/begin CHARACTERISTIC KOUTP_TimeSNDKCFbk_cnt_ovrdval "" VALUE 0x0000 /* @ECU_Address@KOUTP_TimeSNDKCFbk_cnt_ovrdval@ */ Scalar_ULONG 0 SWC_OUTP_type_CM_uint32_cnt 0.0 4.294967295E+9 /end CHARACTERISTIC
/begin CHARACTERISTIC KOUTP_IGNCNTR_cnt_maxval "" VALUE 0x0000 /* @ECU_Address@KOUTP_IGNCNTR_cnt_maxval@ */ Scalar_UWORD 0 SWC_OUTP_type_CM_uint16_cnt 0.0 65535.0 /end CHARACTERISTIC
/begin CHARACTERISTIC KOUTP_IGNCNTR_cnt_minval "" VALUE 0x0000 /* @ECU_Address@KOUTP_IGNCNTR_cnt_minval@ */ Scalar_UWORD 0 SWC_OUTP_type_CM_uint16_cnt 0.0 65535.0 /end CHARACTERISTIC
/begin CHARACTERISTIC KOUTP_IGNCNTR_cnt_ovrdval "" VALUE 0x0000 /* @ECU_Address@KOUTP_IGNCNTR_cnt_ovrdval@ */ Scalar_UWORD 0 SWC_OUTP_type_CM_uint16_cnt 0.0 65535.0 /end CHARACTERISTIC
/begin CHARACTERISTIC KOUTP_MILTIME_min_maxval "" VALUE 0x0000 /* @ECU_Address@KOUTP_MILTIME_min_maxval@ */ Scalar_UWORD 0 SWC_OUTP_type_CM_uint16_min 0.0 65535.0 /end CHARACTERISTIC
/begin CHARACTERISTIC KOUTP_MILTIME_min_minval "" VALUE 0x0000 /* @ECU_Address@KOUTP_MILTIME_min_minval@ */ Scalar_UWORD 0 SWC_OUTP_type_CM_uint16_min 0.0 65535.0 /end CHARACTERISTIC
/begin CHARACTERISTIC KOUTP_MILTIME_min_ovrdval "" VALUE 0x0000 /* @ECU_Address@KOUTP_MILTIME_min_ovrdval@ */ Scalar_UWORD 0 SWC_OUTP_type_CM_uint16_min 0.0 65535.0 /end CHARACTERISTIC
/begin CHARACTERISTIC KOUTP_NUMPSATRIPSFLTMEMCLR_cnt_maxval "" VALUE 0x0000 /* @ECU_Address@KOUTP_NUMPSATRIPSFLTMEMCLR_cnt_maxval@ */ Scalar_UWORD 0 SWC_OUTP_type_CM_uint16_cnt 0.0 65535.0 /end CHARACTERISTIC
/begin CHARACTERISTIC KOUTP_NUMPSATRIPSFLTMEMCLR_cnt_minval "" VALUE 0x0000 /* @ECU_Address@KOUTP_NUMPSATRIPSFLTMEMCLR_cnt_minval@ */ Scalar_UWORD 0 SWC_OUTP_type_CM_uint16_cnt 0.0 65535.0 /end CHARACTERISTIC
/begin CHARACTERISTIC KOUTP_NUMPSATRIPSFLTMEMCLR_cnt_ovrdval "" VALUE 0x0000 /* @ECU_Address@KOUTP_NUMPSATRIPSFLTMEMCLR_cnt_ovrdval@ */ Scalar_UWORD 0 SWC_OUTP_type_CM_uint16_cnt 0.0 65535.0 /end CHARACTERISTIC
/begin CHARACTERISTIC KOUTP_RESSCNTDODRNGL_cnt_maxval "" VALUE 0x0000 /* @ECU_Address@KOUTP_RESSCNTDODRNGL_cnt_maxval@ */ Scalar_UWORD 0 SWC_OUTP_type_CM_uint16_cnt 0.0 65535.0 /end CHARACTERISTIC
/begin CHARACTERISTIC KOUTP_RESSCNTDODRNGL_cnt_minval "" VALUE 0x0000 /* @ECU_Address@KOUTP_RESSCNTDODRNGL_cnt_minval@ */ Scalar_UWORD 0 SWC_OUTP_type_CM_uint16_cnt 0.0 65535.0 /end CHARACTERISTIC
/begin CHARACTERISTIC KOUTP_RESSCNTDODRNGL_cnt_ovrdval "" VALUE 0x0000 /* @ECU_Address@KOUTP_RESSCNTDODRNGL_cnt_ovrdval@ */ Scalar_UWORD 0 SWC_OUTP_type_CM_uint16_cnt 0.0 65535.0 /end CHARACTERISTIC
/begin CHARACTERISTIC KOUTP_RESSCNTDODRNGR_cnt_maxval "" VALUE 0x0000 /* @ECU_Address@KOUTP_RESSCNTDODRNGR_cnt_maxval@ */ Scalar_UWORD 0 SWC_OUTP_type_CM_uint16_cnt 0.0 65535.0 /end CHARACTERISTIC
/begin CHARACTERISTIC KOUTP_RESSCNTDODRNGR_cnt_minval "" VALUE 0x0000 /* @ECU_Address@KOUTP_RESSCNTDODRNGR_cnt_minval@ */ Scalar_UWORD 0 SWC_OUTP_type_CM_uint16_cnt 0.0 65535.0 /end CHARACTERISTIC
/begin CHARACTERISTIC KOUTP_RESSCNTDODRNGR_cnt_ovrdval "" VALUE 0x0000 /* @ECU_Address@KOUTP_RESSCNTDODRNGR_cnt_ovrdval@ */ Scalar_UWORD 0 SWC_OUTP_type_CM_uint16_cnt 0.0 65535.0 /end CHARACTERISTIC
/begin CHARACTERISTIC KOUTP_RUNTM_s_maxval "" VALUE 0x0000 /* @ECU_Address@KOUTP_RUNTM_s_maxval@ */ Scalar_UWORD 0 SWC_OUTP_type_CM_uint16_sec 0.0 65535.0 /end CHARACTERISTIC
/begin CHARACTERISTIC KOUTP_RUNTM_s_minval "" VALUE 0x0000 /* @ECU_Address@KOUTP_RUNTM_s_minval@ */ Scalar_UWORD 0 SWC_OUTP_type_CM_uint16_sec 0.0 65535.0 /end CHARACTERISTIC
/begin CHARACTERISTIC KOUTP_RUNTM_s_ovrdval "" VALUE 0x0000 /* @ECU_Address@KOUTP_RUNTM_s_ovrdval@ */ Scalar_UWORD 0 SWC_OUTP_type_CM_uint16_s 0.0 65535.0 /end CHARACTERISTIC
/begin CHARACTERISTIC KOUTP_ACHVLoopDem_enum_ovrdflg "" VALUE 0x0000 /* @ECU_Address@KOUTP_ACHVLoopDem_enum_ovrdflg@ */ Scalar_BOOLEAN 0 SWC_OUTP_type_CM_boolean_flg 0.0 1.0 /end CHARACTERISTIC
/begin CHARACTERISTIC KOUTP_ActiveDischargeReq_enum_ovrdflg "" VALUE 0x0000 /* @ECU_Address@KOUTP_ActiveDischargeReq_enum_ovrdflg@ */ Scalar_BOOLEAN 0 SWC_OUTP_type_CM_boolean_flg 0.0 1.0 /end CHARACTERISTIC
/begin CHARACTERISTIC KOUTP_ActiveWU_flg_maxval "" VALUE 0x0000 /* @ECU_Address@KOUTP_ActiveWU_flg_maxval@ */ Scalar_BOOLEAN 0 SWC_OUTP_type_CM_boolean_flg 0.0 1.0 /end CHARACTERISTIC
/begin CHARACTERISTIC KOUTP_ActiveWU_flg_minval "" VALUE 0x0000 /* @ECU_Address@KOUTP_ActiveWU_flg_minval@ */ Scalar_BOOLEAN 0 SWC_OUTP_type_CM_boolean_flg 0.0 1.0 /end CHARACTERISTIC
/begin CHARACTERISTIC KOUTP_ActiveWU_flg_ovrdflg "" VALUE 0x0000 /* @ECU_Address@KOUTP_ActiveWU_flg_ovrdflg@ */ Scalar_BOOLEAN 0 SWC_OUTP_type_CM_boolean_flg 0.0 1.0 /end CHARACTERISTIC
/begin CHARACTERISTIC KOUTP_ActiveWU_flg_ovrdval "" VALUE 0x0000 /* @ECU_Address@KOUTP_ActiveWU_flg_ovrdval@ */ Scalar_BOOLEAN 0 SWC_OUTP_type_CM_boolean_flg 0.0 1.0 /end CHARACTERISTIC
/begin CHARACTERISTIC KOUTP_AllCANTxReq_flg_maxval "" VALUE 0x0000 /* @ECU_Address@KOUTP_AllCANTxReq_flg_maxval@ */ Scalar_BOOLEAN 0 SWC_OUTP_type_CM_boolean_flg 0.0 1.0 /end CHARACTERISTIC
/begin CHARACTERISTIC KOUTP_AllCANTxReq_flg_minval "" VALUE 0x0000 /* @ECU_Address@KOUTP_AllCANTxReq_flg_minval@ */ Scalar_BOOLEAN 0 SWC_OUTP_type_CM_boolean_flg 0.0 1.0 /end CHARACTERISTIC
/begin CHARACTERISTIC KOUTP_AllCANTxReq_flg_ovrdflg "" VALUE 0x0000 /* @ECU_Address@KOUTP_AllCANTxReq_flg_ovrdflg@ */ Scalar_BOOLEAN 0 SWC_OUTP_type_CM_boolean_flg 0.0 1.0 /end CHARACTERISTIC
/begin CHARACTERISTIC KOUTP_AllCANTxReq_flg_ovrdval "" VALUE 0x0000 /* @ECU_Address@KOUTP_AllCANTxReq_flg_ovrdval@ */ Scalar_BOOLEAN 0 SWC_OUTP_type_CM_boolean_flg 0.0 1.0 /end CHARACTERISTIC
/begin CHARACTERISTIC KOUTP_Awake_enum_ovrdflg "" VALUE 0x0000 /* @ECU_Address@KOUTP_Awake_enum_ovrdflg@ */ Scalar_BOOLEAN 0 SWC_OUTP_type_CM_boolean_flg 0.0 1.0 /end CHARACTERISTIC
/begin CHARACTERISTIC KOUTP_BattHVDem_enum_ovrdflg "" VALUE 0x0000 /* @ECU_Address@KOUTP_BattHVDem_enum_ovrdflg@ */ Scalar_BOOLEAN 0 SWC_OUTP_type_CM_boolean_flg 0.0 1.0 /end CHARACTERISTIC
/begin CHARACTERISTIC KOUTP_CACRlyDem_enum_ovrdflg "" VALUE 0x0000 /* @ECU_Address@KOUTP_CACRlyDem_enum_ovrdflg@ */ Scalar_BOOLEAN 0 SWC_OUTP_type_CM_boolean_flg 0.0 1.0 /end CHARACTERISTIC
/begin CHARACTERISTIC KOUTP_CSB_flg_maxval "" VALUE 0x0000 /* @ECU_Address@KOUTP_CSB_flg_maxval@ */ Scalar_BOOLEAN 0 SWC_OUTP_type_CM_boolean_flg 0.0 1.0 /end CHARACTERISTIC
/begin CHARACTERISTIC KOUTP_CSB_flg_minval "" VALUE 0x0000 /* @ECU_Address@KOUTP_CSB_flg_minval@ */ Scalar_BOOLEAN 0 SWC_OUTP_type_CM_boolean_flg 0.0 1.0 /end CHARACTERISTIC
/begin CHARACTERISTIC KOUTP_CSB_flg_ovrdflg "" VALUE 0x0000 /* @ECU_Address@KOUTP_CSB_flg_ovrdflg@ */ Scalar_BOOLEAN 0 SWC_OUTP_type_CM_boolean_flg 0.0 1.0 /end CHARACTERISTIC
/begin CHARACTERISTIC KOUTP_CSB_flg_ovrdval "" VALUE 0x0000 /* @ECU_Address@KOUTP_CSB_flg_ovrdval@ */ Scalar_BOOLEAN 0 SWC_OUTP_type_CM_boolean_flg 0.0 1.0 /end CHARACTERISTIC
/begin CHARACTERISTIC KOUTP_ChrgBCUHVFail_flg_maxval "" VALUE 0x0000 /* @ECU_Address@KOUTP_ChrgBCUHVFail_flg_maxval@ */ Scalar_BOOLEAN 0 SWC_OUTP_type_CM_boolean_flg 0.0 1.0 /end CHARACTERISTIC
/begin CHARACTERISTIC KOUTP_ChrgBCUHVFail_flg_minval "" VALUE 0x0000 /* @ECU_Address@KOUTP_ChrgBCUHVFail_flg_minval@ */ Scalar_BOOLEAN 0 SWC_OUTP_type_CM_boolean_flg 0.0 1.0 /end CHARACTERISTIC
/begin CHARACTERISTIC KOUTP_ChrgBCUHVFail_flg_ovrdflg "" VALUE 0x0000 /* @ECU_Address@KOUTP_ChrgBCUHVFail_flg_ovrdflg@ */ Scalar_BOOLEAN 0 SWC_OUTP_type_CM_boolean_flg 0.0 1.0 /end CHARACTERISTIC
/begin CHARACTERISTIC KOUTP_ChrgBCUHVFail_flg_ovrdval "" VALUE 0x0000 /* @ECU_Address@KOUTP_ChrgBCUHVFail_flg_ovrdval@ */ Scalar_BOOLEAN 0 SWC_OUTP_type_CM_boolean_flg 0.0 1.0 /end CHARACTERISTIC
/begin CHARACTERISTIC KOUTP_ChrgFault_enum_ovrdflg "" VALUE 0x0000 /* @ECU_Address@KOUTP_ChrgFault_enum_ovrdflg@ */ Scalar_BOOLEAN 0 SWC_OUTP_type_CM_boolean_flg 0.0 1.0 /end CHARACTERISTIC
/begin CHARACTERISTIC KOUTP_ChrgPowerUpFail_flg_maxval "" VALUE 0x0000 /* @ECU_Address@KOUTP_ChrgPowerUpFail_flg_maxval@ */ Scalar_BOOLEAN 0 SWC_OUTP_type_CM_boolean_flg 0.0 1.0 /end CHARACTERISTIC
/begin CHARACTERISTIC KOUTP_ChrgPowerUpFail_flg_minval "" VALUE 0x0000 /* @ECU_Address@KOUTP_ChrgPowerUpFail_flg_minval@ */ Scalar_BOOLEAN 0 SWC_OUTP_type_CM_boolean_flg 0.0 1.0 /end CHARACTERISTIC
/begin CHARACTERISTIC KOUTP_ChrgPowerUpFail_flg_ovrdflg "" VALUE 0x0000 /* @ECU_Address@KOUTP_ChrgPowerUpFail_flg_ovrdflg@ */ Scalar_BOOLEAN 0 SWC_OUTP_type_CM_boolean_flg 0.0 1.0 /end CHARACTERISTIC
/begin CHARACTERISTIC KOUTP_ChrgPowerUpFail_flg_ovrdval "" VALUE 0x0000 /* @ECU_Address@KOUTP_ChrgPowerUpFail_flg_ovrdval@ */ Scalar_BOOLEAN 0 SWC_OUTP_type_CM_boolean_flg 0.0 1.0 /end CHARACTERISTIC
/begin CHARACTERISTIC KOUTP_ChrgState_enum_ovrdflg "" VALUE 0x0000 /* @ECU_Address@KOUTP_ChrgState_enum_ovrdflg@ */ Scalar_BOOLEAN 0 SWC_OUTP_type_CM_boolean_flg 0.0 1.0 /end CHARACTERISTIC
/begin CHARACTERISTIC KOUTP_DCCurr_A_ovrdflg "" VALUE 0x0000 /* @ECU_Address@KOUTP_DCCurr_A_ovrdflg@ */ Scalar_BOOLEAN 0 SWC_OUTP_type_CM_boolean_flg 0.0 1.0 /end CHARACTERISTIC
/begin CHARACTERISTIC KOUTP_DCDCRlyDem_enum_ovrdflg "" VALUE 0x0000 /* @ECU_Address@KOUTP_DCDCRlyDem_enum_ovrdflg@ */ Scalar_BOOLEAN 0 SWC_OUTP_type_CM_boolean_flg 0.0 1.0 /end CHARACTERISTIC
/begin CHARACTERISTIC KOUTP_DCVol_V_ovrdflg "" VALUE 0x0000 /* @ECU_Address@KOUTP_DCVol_V_ovrdflg@ */ Scalar_BOOLEAN 0 SWC_OUTP_type_CM_boolean_flg 0.0 1.0 /end CHARACTERISTIC
/begin CHARACTERISTIC KOUTP_DISCButtSta_flg_maxval "" VALUE 0x0000 /* @ECU_Address@KOUTP_DISCButtSta_flg_maxval@ */ Scalar_BOOLEAN 0 SWC_OUTP_type_CM_boolean_flg 0.0 1.0 /end CHARACTERISTIC
/begin CHARACTERISTIC KOUTP_DISCButtSta_flg_minval "" VALUE 0x0000 /* @ECU_Address@KOUTP_DISCButtSta_flg_minval@ */ Scalar_BOOLEAN 0 SWC_OUTP_type_CM_boolean_flg 0.0 1.0 /end CHARACTERISTIC
/begin CHARACTERISTIC KOUTP_DISCButtSta_flg_ovrdflg "" VALUE 0x0000 /* @ECU_Address@KOUTP_DISCButtSta_flg_ovrdflg@ */ Scalar_BOOLEAN 0 SWC_OUTP_type_CM_boolean_flg 0.0 1.0 /end CHARACTERISTIC
/begin CHARACTERISTIC KOUTP_DISCButtSta_flg_ovrdval "" VALUE 0x0000 /* @ECU_Address@KOUTP_DISCButtSta_flg_ovrdval@ */ Scalar_BOOLEAN 0 SWC_OUTP_type_CM_boolean_flg 0.0 1.0 /end CHARACTERISTIC
/begin CHARACTERISTIC KOUTP_DISCSta_enum_ovrdflg "" VALUE 0x0000 /* @ECU_Address@KOUTP_DISCSta_enum_ovrdflg@ */ Scalar_BOOLEAN 0 SWC_OUTP_type_CM_boolean_flg 0.0 1.0 /end CHARACTERISTIC
/begin CHARACTERISTIC KOUTP_DISCTargetSpd_kph_ovrdflg "" VALUE 0x0000 /* @ECU_Address@KOUTP_DISCTargetSpd_kph_ovrdflg@ */ Scalar_BOOLEAN 0 SWC_OUTP_type_CM_boolean_flg 0.0 1.0 /end CHARACTERISTIC
/begin CHARACTERISTIC KOUTP_DISCTurn_flg_maxval "" VALUE 0x0000 /* @ECU_Address@KOUTP_DISCTurn_flg_maxval@ */ Scalar_BOOLEAN 0 SWC_OUTP_type_CM_boolean_flg 0.0 1.0 /end CHARACTERISTIC
/begin CHARACTERISTIC KOUTP_DISCTurn_flg_minval "" VALUE 0x0000 /* @ECU_Address@KOUTP_DISCTurn_flg_minval@ */ Scalar_BOOLEAN 0 SWC_OUTP_type_CM_boolean_flg 0.0 1.0 /end CHARACTERISTIC
/begin CHARACTERISTIC KOUTP_DISCTurn_flg_ovrdflg "" VALUE 0x0000 /* @ECU_Address@KOUTP_DISCTurn_flg_ovrdflg@ */ Scalar_BOOLEAN 0 SWC_OUTP_type_CM_boolean_flg 0.0 1.0 /end CHARACTERISTIC
/begin CHARACTERISTIC KOUTP_DISCTurn_flg_ovrdval "" VALUE 0x0000 /* @ECU_Address@KOUTP_DISCTurn_flg_ovrdval@ */ Scalar_BOOLEAN 0 SWC_OUTP_type_CM_boolean_flg 0.0 1.0 /end CHARACTERISTIC
/begin CHARACTERISTIC KOUTP_DKCAuthSta_enum_ovrdflg "" VALUE 0x0000 /* @ECU_Address@KOUTP_DKCAuthSta_enum_ovrdflg@ */ Scalar_BOOLEAN 0 SWC_OUTP_type_CM_boolean_flg 0.0 1.0 /end CHARACTERISTIC
/begin CHARACTERISTIC KOUTP_DKCTimeSN_cnt_ovrdflg "" VALUE 0x0000 /* @ECU_Address@KOUTP_DKCTimeSN_cnt_ovrdflg@ */ Scalar_BOOLEAN 0 SWC_OUTP_type_CM_boolean_flg 0.0 1.0 /end CHARACTERISTIC
/begin CHARACTERISTIC KOUTP_DKeyWelcomeSta_enum_ovrdflg "" VALUE 0x0000 /* @ECU_Address@KOUTP_DKeyWelcomeSta_enum_ovrdflg@ */ Scalar_BOOLEAN 0 SWC_OUTP_type_CM_boolean_flg 0.0 1.0 /end CHARACTERISTIC
/begin CHARACTERISTIC KOUTP_DkeyAreaRAPSSta_enum_ovrdflg "" VALUE 0x0000 /* @ECU_Address@KOUTP_DkeyAreaRAPSSta_enum_ovrdflg@ */ Scalar_BOOLEAN 0 SWC_OUTP_type_CM_boolean_flg 0.0 1.0 /end CHARACTERISTIC
/begin CHARACTERISTIC KOUTP_DkeyShowIVISta_enum_ovrdflg "" VALUE 0x0000 /* @ECU_Address@KOUTP_DkeyShowIVISta_enum_ovrdflg@ */ Scalar_BOOLEAN 0 SWC_OUTP_type_CM_boolean_flg 0.0 1.0 /end CHARACTERISTIC
/begin CHARACTERISTIC KOUTP_DrivelineRelease_enum_ovrdflg "" VALUE 0x0000 /* @ECU_Address@KOUTP_DrivelineRelease_enum_ovrdflg@ */ Scalar_BOOLEAN 0 SWC_OUTP_type_CM_boolean_flg 0.0 1.0 /end CHARACTERISTIC
/begin CHARACTERISTIC KOUTP_EHPSRlyDem_enum_ovrdflg "" VALUE 0x0000 /* @ECU_Address@KOUTP_EHPSRlyDem_enum_ovrdflg@ */ Scalar_BOOLEAN 0 SWC_OUTP_type_CM_boolean_flg 0.0 1.0 /end CHARACTERISTIC
/begin CHARACTERISTIC KOUTP_ErrorState_enum_ovrdflg "" VALUE 0x0000 /* @ECU_Address@KOUTP_ErrorState_enum_ovrdflg@ */ Scalar_BOOLEAN 0 SWC_OUTP_type_CM_boolean_flg 0.0 1.0 /end CHARACTERISTIC
/begin CHARACTERISTIC KOUTP_FDCDKCAllowSleep_flg_maxval "" VALUE 0x0000 /* @ECU_Address@KOUTP_FDCDKCAllowSleep_flg_maxval@ */ Scalar_BOOLEAN 0 SWC_OUTP_type_CM_boolean_flg 0.0 1.0 /end CHARACTERISTIC
/begin CHARACTERISTIC KOUTP_FDCDKCAllowSleep_flg_minval "" VALUE 0x0000 /* @ECU_Address@KOUTP_FDCDKCAllowSleep_flg_minval@ */ Scalar_BOOLEAN 0 SWC_OUTP_type_CM_boolean_flg 0.0 1.0 /end CHARACTERISTIC
/begin CHARACTERISTIC KOUTP_FDCDKCAllowSleep_flg_ovrdflg "" VALUE 0x0000 /* @ECU_Address@KOUTP_FDCDKCAllowSleep_flg_ovrdflg@ */ Scalar_BOOLEAN 0 SWC_OUTP_type_CM_boolean_flg 0.0 1.0 /end CHARACTERISTIC
/begin CHARACTERISTIC KOUTP_FDCDKCAllowSleep_flg_ovrdval "" VALUE 0x0000 /* @ECU_Address@KOUTP_FDCDKCAllowSleep_flg_ovrdval@ */ Scalar_BOOLEAN 0 SWC_OUTP_type_CM_boolean_flg 0.0 1.0 /end CHARACTERISTIC
/begin CHARACTERISTIC KOUTP_FogTMSRlyCMD_enum_ovrdflg "" VALUE 0x0000 /* @ECU_Address@KOUTP_FogTMSRlyCMD_enum_ovrdflg@ */ Scalar_BOOLEAN 0 SWC_OUTP_type_CM_boolean_flg 0.0 1.0 /end CHARACTERISTIC
/begin CHARACTERISTIC KOUTP_HVESSCHARGEACT_kW_ovrdflg "" VALUE 0x0000 /* @ECU_Address@KOUTP_HVESSCHARGEACT_kW_ovrdflg@ */ Scalar_BOOLEAN 0 SWC_OUTP_type_CM_boolean_flg 0.0 1.0 /end CHARACTERISTIC
/begin CHARACTERISTIC KOUTP_HVESSCHARGELIM_kW_ovrdflg "" VALUE 0x0000 /* @ECU_Address@KOUTP_HVESSCHARGELIM_kW_ovrdflg@ */ Scalar_BOOLEAN 0 SWC_OUTP_type_CM_boolean_flg 0.0 1.0 /end CHARACTERISTIC
/begin CHARACTERISTIC KOUTP_HVESSENER_Whps_ovrdflg "" VALUE 0x0000 /* @ECU_Address@KOUTP_HVESSENER_Whps_ovrdflg@ */ Scalar_BOOLEAN 0 SWC_OUTP_type_CM_boolean_flg 0.0 1.0 /end CHARACTERISTIC
/begin CHARACTERISTIC KOUTP_HVFailureChkPass_flg_maxval "" VALUE 0x0000 /* @ECU_Address@KOUTP_HVFailureChkPass_flg_maxval@ */ Scalar_BOOLEAN 0 SWC_OUTP_type_CM_boolean_flg 0.0 1.0 /end CHARACTERISTIC
/begin CHARACTERISTIC KOUTP_HVFailureChkPass_flg_minval "" VALUE 0x0000 /* @ECU_Address@KOUTP_HVFailureChkPass_flg_minval@ */ Scalar_BOOLEAN 0 SWC_OUTP_type_CM_boolean_flg 0.0 1.0 /end CHARACTERISTIC
/begin CHARACTERISTIC KOUTP_HVFailureChkPass_flg_ovrdflg "" VALUE 0x0000 /* @ECU_Address@KOUTP_HVFailureChkPass_flg_ovrdflg@ */ Scalar_BOOLEAN 0 SWC_OUTP_type_CM_boolean_flg 0.0 1.0 /end CHARACTERISTIC
/begin CHARACTERISTIC KOUTP_HVFailureChkPass_flg_ovrdval "" VALUE 0x0000 /* @ECU_Address@KOUTP_HVFailureChkPass_flg_ovrdval@ */ Scalar_BOOLEAN 0 SWC_OUTP_type_CM_boolean_flg 0.0 1.0 /end CHARACTERISTIC
/begin CHARACTERISTIC KOUTP_HVILDetectFail_flg_maxval "" VALUE 0x0000 /* @ECU_Address@KOUTP_HVILDetectFail_flg_maxval@ */ Scalar_BOOLEAN 0 SWC_OUTP_type_CM_boolean_flg 0.0 1.0 /end CHARACTERISTIC
/begin CHARACTERISTIC KOUTP_HVILDetectFail_flg_minval "" VALUE 0x0000 /* @ECU_Address@KOUTP_HVILDetectFail_flg_minval@ */ Scalar_BOOLEAN 0 SWC_OUTP_type_CM_boolean_flg 0.0 1.0 /end CHARACTERISTIC
/begin CHARACTERISTIC KOUTP_HVILDetectFail_flg_ovrdflg "" VALUE 0x0000 /* @ECU_Address@KOUTP_HVILDetectFail_flg_ovrdflg@ */ Scalar_BOOLEAN 0 SWC_OUTP_type_CM_boolean_flg 0.0 1.0 /end CHARACTERISTIC
/begin CHARACTERISTIC KOUTP_HVILDetectFail_flg_ovrdval "" VALUE 0x0000 /* @ECU_Address@KOUTP_HVILDetectFail_flg_ovrdval@ */ Scalar_BOOLEAN 0 SWC_OUTP_type_CM_boolean_flg 0.0 1.0 /end CHARACTERISTIC
/begin CHARACTERISTIC KOUTP_HVILFail_flg_maxval "" VALUE 0x0000 /* @ECU_Address@KOUTP_HVILFail_flg_maxval@ */ Scalar_BOOLEAN 0 SWC_OUTP_type_CM_boolean_flg 0.0 1.0 /end CHARACTERISTIC
/begin CHARACTERISTIC KOUTP_HVILFail_flg_minval "" VALUE 0x0000 /* @ECU_Address@KOUTP_HVILFail_flg_minval@ */ Scalar_BOOLEAN 0 SWC_OUTP_type_CM_boolean_flg 0.0 1.0 /end CHARACTERISTIC
/begin CHARACTERISTIC KOUTP_HVILFail_flg_ovrdflg "" VALUE 0x0000 /* @ECU_Address@KOUTP_HVILFail_flg_ovrdflg@ */ Scalar_BOOLEAN 0 SWC_OUTP_type_CM_boolean_flg 0.0 1.0 /end CHARACTERISTIC
/begin CHARACTERISTIC KOUTP_HVILFail_flg_ovrdval "" VALUE 0x0000 /* @ECU_Address@KOUTP_HVILFail_flg_ovrdval@ */ Scalar_BOOLEAN 0 SWC_OUTP_type_CM_boolean_flg 0.0 1.0 /end CHARACTERISTIC
/begin CHARACTERISTIC KOUTP_HVSysReady_enum_ovrdflg "" VALUE 0x0000 /* @ECU_Address@KOUTP_HVSysReady_enum_ovrdflg@ */ Scalar_BOOLEAN 0 SWC_OUTP_type_CM_boolean_flg 0.0 1.0 /end CHARACTERISTIC
/begin CHARACTERISTIC KOUTP_IGNCNTR_cnt_ovrdflg "" VALUE 0x0000 /* @ECU_Address@KOUTP_IGNCNTR_cnt_ovrdflg@ */ Scalar_BOOLEAN 0 SWC_OUTP_type_CM_boolean_flg 0.0 1.0 /end CHARACTERISTIC
/begin CHARACTERISTIC KOUTP_IGNRlyClose_flg_maxval "" VALUE 0x0000 /* @ECU_Address@KOUTP_IGNRlyClose_flg_maxval@ */ Scalar_BOOLEAN 0 SWC_OUTP_type_CM_boolean_flg 0.0 1.0 /end CHARACTERISTIC
/begin CHARACTERISTIC KOUTP_IGNRlyClose_flg_minval "" VALUE 0x0000 /* @ECU_Address@KOUTP_IGNRlyClose_flg_minval@ */ Scalar_BOOLEAN 0 SWC_OUTP_type_CM_boolean_flg 0.0 1.0 /end CHARACTERISTIC
/begin CHARACTERISTIC KOUTP_IGNRlyClose_flg_ovrdflg "" VALUE 0x0000 /* @ECU_Address@KOUTP_IGNRlyClose_flg_ovrdflg@ */ Scalar_BOOLEAN 0 SWC_OUTP_type_CM_boolean_flg 0.0 1.0 /end CHARACTERISTIC
/begin CHARACTERISTIC KOUTP_IGNRlyClose_flg_ovrdval "" VALUE 0x0000 /* @ECU_Address@KOUTP_IGNRlyClose_flg_ovrdval@ */ Scalar_BOOLEAN 0 SWC_OUTP_type_CM_boolean_flg 0.0 1.0 /end CHARACTERISTIC
/begin CHARACTERISTIC KOUTP_IPSAL_sec_ovrdflg "" VALUE 0x0000 /* @ECU_Address@KOUTP_IPSAL_sec_ovrdflg@ */ Scalar_BOOLEAN 0 SWC_OUTP_type_CM_boolean_flg 0.0 1.0 /end CHARACTERISTIC
/begin CHARACTERISTIC KOUTP_IPSAR_sec_ovrdflg "" VALUE 0x0000 /* @ECU_Address@KOUTP_IPSAR_sec_ovrdflg@ */ Scalar_BOOLEAN 0 SWC_OUTP_type_CM_boolean_flg 0.0 1.0 /end CHARACTERISTIC
/begin CHARACTERISTIC KOUTP_IRCRlyClose_flg_maxval "" VALUE 0x0000 /* @ECU_Address@KOUTP_IRCRlyClose_flg_maxval@ */ Scalar_BOOLEAN 0 SWC_OUTP_type_CM_boolean_flg 0.0 1.0 /end CHARACTERISTIC
/begin CHARACTERISTIC KOUTP_IRCRlyClose_flg_minval "" VALUE 0x0000 /* @ECU_Address@KOUTP_IRCRlyClose_flg_minval@ */ Scalar_BOOLEAN 0 SWC_OUTP_type_CM_boolean_flg 0.0 1.0 /end CHARACTERISTIC
/begin CHARACTERISTIC KOUTP_IRCRlyClose_flg_ovrdflg "" VALUE 0x0000 /* @ECU_Address@KOUTP_IRCRlyClose_flg_ovrdflg@ */ Scalar_BOOLEAN 0 SWC_OUTP_type_CM_boolean_flg 0.0 1.0 /end CHARACTERISTIC
/begin CHARACTERISTIC KOUTP_IRCRlyClose_flg_ovrdval "" VALUE 0x0000 /* @ECU_Address@KOUTP_IRCRlyClose_flg_ovrdval@ */ Scalar_BOOLEAN 0 SWC_OUTP_type_CM_boolean_flg 0.0 1.0 /end CHARACTERISTIC
/begin CHARACTERISTIC KOUTP_JudgeKeepUnlockZone_flg_maxval "" VALUE 0x0000 /* @ECU_Address@KOUTP_JudgeKeepUnlockZone_flg_maxval@ */ Scalar_BOOLEAN 0 SWC_OUTP_type_CM_boolean_flg 0.0 1.0 /end CHARACTERISTIC
/begin CHARACTERISTIC KOUTP_JudgeKeepUnlockZone_flg_minval "" VALUE 0x0000 /* @ECU_Address@KOUTP_JudgeKeepUnlockZone_flg_minval@ */ Scalar_BOOLEAN 0 SWC_OUTP_type_CM_boolean_flg 0.0 1.0 /end CHARACTERISTIC
/begin CHARACTERISTIC KOUTP_JudgeKeepUnlockZone_flg_ovrdflg "" VALUE 0x0000 /* @ECU_Address@KOUTP_JudgeKeepUnlockZone_flg_ovrdflg@ */ Scalar_BOOLEAN 0 SWC_OUTP_type_CM_boolean_flg 0.0 1.0 /end CHARACTERISTIC
/begin CHARACTERISTIC KOUTP_JudgeKeepUnlockZone_flg_ovrdval "" VALUE 0x0000 /* @ECU_Address@KOUTP_JudgeKeepUnlockZone_flg_ovrdval@ */ Scalar_BOOLEAN 0 SWC_OUTP_type_CM_boolean_flg 0.0 1.0 /end CHARACTERISTIC
/begin CHARACTERISTIC KOUTP_KeyAreaLockUnlock_enum_ovrdflg "" VALUE 0x0000 /* @ECU_Address@KOUTP_KeyAreaLockUnlock_enum_ovrdflg@ */ Scalar_BOOLEAN 0 SWC_OUTP_type_CM_boolean_flg 0.0 1.0 /end CHARACTERISTIC
/begin CHARACTERISTIC KOUTP_KeyAreaPS_enum_ovrdflg "" VALUE 0x0000 /* @ECU_Address@KOUTP_KeyAreaPS_enum_ovrdflg@ */ Scalar_BOOLEAN 0 SWC_OUTP_type_CM_boolean_flg 0.0 1.0 /end CHARACTERISTIC
/begin CHARACTERISTIC KOUTP_KeyAreaPTG_enum_ovrdflg "" VALUE 0x0000 /* @ECU_Address@KOUTP_KeyAreaPTG_enum_ovrdflg@ */ Scalar_BOOLEAN 0 SWC_OUTP_type_CM_boolean_flg 0.0 1.0 /end CHARACTERISTIC
/begin CHARACTERISTIC KOUTP_KeyAreaSPTGSta_enum_ovrdflg "" VALUE 0x0000 /* @ECU_Address@KOUTP_KeyAreaSPTGSta_enum_ovrdflg@ */ Scalar_BOOLEAN 0 SWC_OUTP_type_CM_boolean_flg 0.0 1.0 /end CHARACTERISTIC
/begin CHARACTERISTIC KOUTP_KeyMissSta_flg_maxval "" VALUE 0x0000 /* @ECU_Address@KOUTP_KeyMissSta_flg_maxval@ */ Scalar_BOOLEAN 0 SWC_OUTP_type_CM_boolean_flg 0.0 1.0 /end CHARACTERISTIC
/begin CHARACTERISTIC KOUTP_KeyMissSta_flg_minval "" VALUE 0x0000 /* @ECU_Address@KOUTP_KeyMissSta_flg_minval@ */ Scalar_BOOLEAN 0 SWC_OUTP_type_CM_boolean_flg 0.0 1.0 /end CHARACTERISTIC
/begin CHARACTERISTIC KOUTP_KeyMissSta_flg_ovrdflg "" VALUE 0x0000 /* @ECU_Address@KOUTP_KeyMissSta_flg_ovrdflg@ */ Scalar_BOOLEAN 0 SWC_OUTP_type_CM_boolean_flg 0.0 1.0 /end CHARACTERISTIC
/begin CHARACTERISTIC KOUTP_KeyMissSta_flg_ovrdval "" VALUE 0x0000 /* @ECU_Address@KOUTP_KeyMissSta_flg_ovrdval@ */ Scalar_BOOLEAN 0 SWC_OUTP_type_CM_boolean_flg 0.0 1.0 /end CHARACTERISTIC
/begin CHARACTERISTIC KOUTP_KeyModeSta_enum_ovrdflg "" VALUE 0x0000 /* @ECU_Address@KOUTP_KeyModeSta_enum_ovrdflg@ */ Scalar_BOOLEAN 0 SWC_OUTP_type_CM_boolean_flg 0.0 1.0 /end CHARACTERISTIC
/begin CHARACTERISTIC KOUTP_KeyNumSta_enum_ovrdflg "" VALUE 0x0000 /* @ECU_Address@KOUTP_KeyNumSta_enum_ovrdflg@ */ Scalar_BOOLEAN 0 SWC_OUTP_type_CM_boolean_flg 0.0 1.0 /end CHARACTERISTIC
/begin CHARACTERISTIC KOUTP_KeyTypeSta_enum_ovrdflg "" VALUE 0x0000 /* @ECU_Address@KOUTP_KeyTypeSta_enum_ovrdflg@ */ Scalar_BOOLEAN 0 SWC_OUTP_type_CM_boolean_flg 0.0 1.0 /end CHARACTERISTIC
/begin CHARACTERISTIC KOUTP_LVBattLowInd_enum_ovrdflg "" VALUE 0x0000 /* @ECU_Address@KOUTP_LVBattLowInd_enum_ovrdflg@ */ Scalar_BOOLEAN 0 SWC_OUTP_type_CM_boolean_flg 0.0 1.0 /end CHARACTERISTIC
/begin CHARACTERISTIC KOUTP_LostHVComActivePwrDown_flg_maxval "" VALUE 0x0000 /* @ECU_Address@KOUTP_LostHVComActivePwrDown_flg_maxval@ */ Scalar_BOOLEAN 0 SWC_OUTP_type_CM_boolean_flg 0.0 1.0 /end CHARACTERISTIC
/begin CHARACTERISTIC KOUTP_LostHVComActivePwrDown_flg_minval "" VALUE 0x0000 /* @ECU_Address@KOUTP_LostHVComActivePwrDown_flg_minval@ */ Scalar_BOOLEAN 0 SWC_OUTP_type_CM_boolean_flg 0.0 1.0 /end CHARACTERISTIC
/begin CHARACTERISTIC KOUTP_LostHVComActivePwrDown_flg_ovrdflg "" VALUE 0x0000 /* @ECU_Address@KOUTP_LostHVComActivePwrDown_flg_ovrdflg@ */ Scalar_BOOLEAN 0 SWC_OUTP_type_CM_boolean_flg 0.0 1.0 /end CHARACTERISTIC
/begin CHARACTERISTIC KOUTP_LostHVComActivePwrDown_flg_ovrdval "" VALUE 0x0000 /* @ECU_Address@KOUTP_LostHVComActivePwrDown_flg_ovrdval@ */ Scalar_BOOLEAN 0 SWC_OUTP_type_CM_boolean_flg 0.0 1.0 /end CHARACTERISTIC
/begin CHARACTERISTIC KOUTP_MAXBATTEMPL_C_ovrdflg "" VALUE 0x0000 /* @ECU_Address@KOUTP_MAXBATTEMPL_C_ovrdflg@ */ Scalar_BOOLEAN 0 SWC_OUTP_type_CM_boolean_flg 0.0 1.0 /end CHARACTERISTIC
/begin CHARACTERISTIC KOUTP_MCUHVLoopDem_enum_ovrdflg "" VALUE 0x0000 /* @ECU_Address@KOUTP_MCUHVLoopDem_enum_ovrdflg@ */ Scalar_BOOLEAN 0 SWC_OUTP_type_CM_boolean_flg 0.0 1.0 /end CHARACTERISTIC
/begin CHARACTERISTIC KOUTP_MILDIST_km_ovrdflg "" VALUE 0x0000 /* @ECU_Address@KOUTP_MILDIST_km_ovrdflg@ */ Scalar_BOOLEAN 0 SWC_OUTP_type_CM_boolean_flg 0.0 1.0 /end CHARACTERISTIC
/begin CHARACTERISTIC KOUTP_MILTIME_min_ovrdflg "" VALUE 0x0000 /* @ECU_Address@KOUTP_MILTIME_min_ovrdflg@ */ Scalar_BOOLEAN 0 SWC_OUTP_type_CM_boolean_flg 0.0 1.0 /end CHARACTERISTIC
/begin CHARACTERISTIC KOUTP_MINBATTEMPL_C_ovrdflg "" VALUE 0x0000 /* @ECU_Address@KOUTP_MINBATTEMPL_C_ovrdflg@ */ Scalar_BOOLEAN 0 SWC_OUTP_type_CM_boolean_flg 0.0 1.0 /end CHARACTERISTIC
/begin CHARACTERISTIC KOUTP_NMmTxReq_flg_maxval "" VALUE 0x0000 /* @ECU_Address@KOUTP_NMmTxReq_flg_maxval@ */ Scalar_BOOLEAN 0 SWC_OUTP_type_CM_boolean_flg 0.0 1.0 /end CHARACTERISTIC
/begin CHARACTERISTIC KOUTP_NMmTxReq_flg_minval "" VALUE 0x0000 /* @ECU_Address@KOUTP_NMmTxReq_flg_minval@ */ Scalar_BOOLEAN 0 SWC_OUTP_type_CM_boolean_flg 0.0 1.0 /end CHARACTERISTIC
/begin CHARACTERISTIC KOUTP_NMmTxReq_flg_ovrdflg "" VALUE 0x0000 /* @ECU_Address@KOUTP_NMmTxReq_flg_ovrdflg@ */ Scalar_BOOLEAN 0 SWC_OUTP_type_CM_boolean_flg 0.0 1.0 /end CHARACTERISTIC
/begin CHARACTERISTIC KOUTP_NMmTxReq_flg_ovrdval "" VALUE 0x0000 /* @ECU_Address@KOUTP_NMmTxReq_flg_ovrdval@ */ Scalar_BOOLEAN 0 SWC_OUTP_type_CM_boolean_flg 0.0 1.0 /end CHARACTERISTIC
/begin CHARACTERISTIC KOUTP_NUMPSATRIPSFLTMEMCLR_cnt_ovrdflg "" VALUE 0x0000 /* @ECU_Address@KOUTP_NUMPSATRIPSFLTMEMCLR_cnt_ovrdflg@ */ Scalar_BOOLEAN 0 SWC_OUTP_type_CM_boolean_flg 0.0 1.0 /end CHARACTERISTIC
/begin CHARACTERISTIC KOUTP_NetworkReq_flg_maxval "" VALUE 0x0000 /* @ECU_Address@KOUTP_NetworkReq_flg_maxval@ */ Scalar_BOOLEAN 0 SWC_OUTP_type_CM_boolean_flg 0.0 1.0 /end CHARACTERISTIC
/begin CHARACTERISTIC KOUTP_NetworkReq_flg_minval "" VALUE 0x0000 /* @ECU_Address@KOUTP_NetworkReq_flg_minval@ */ Scalar_BOOLEAN 0 SWC_OUTP_type_CM_boolean_flg 0.0 1.0 /end CHARACTERISTIC
/begin CHARACTERISTIC KOUTP_NetworkReq_flg_ovrdflg "" VALUE 0x0000 /* @ECU_Address@KOUTP_NetworkReq_flg_ovrdflg@ */ Scalar_BOOLEAN 0 SWC_OUTP_type_CM_boolean_flg 0.0 1.0 /end CHARACTERISTIC
/begin CHARACTERISTIC KOUTP_NetworkReq_flg_ovrdval "" VALUE 0x0000 /* @ECU_Address@KOUTP_NetworkReq_flg_ovrdval@ */ Scalar_BOOLEAN 0 SWC_OUTP_type_CM_boolean_flg 0.0 1.0 /end CHARACTERISTIC
/begin CHARACTERISTIC KOUTP_NodeID_enum_ovrdflg "" VALUE 0x0000 /* @ECU_Address@KOUTP_NodeID_enum_ovrdflg@ */ Scalar_BOOLEAN 0 SWC_OUTP_type_CM_boolean_flg 0.0 1.0 /end CHARACTERISTIC
/begin CHARACTERISTIC KOUTP_ODOMETER_km_ovrdflg "" VALUE 0x0000 /* @ECU_Address@KOUTP_ODOMETER_km_ovrdflg@ */ Scalar_BOOLEAN 0 SWC_OUTP_type_CM_boolean_flg 0.0 1.0 /end CHARACTERISTIC
/begin CHARACTERISTIC KOUTP_OFFL_sec_ovrdflg "" VALUE 0x0000 /* @ECU_Address@KOUTP_OFFL_sec_ovrdflg@ */ Scalar_BOOLEAN 0 SWC_OUTP_type_CM_boolean_flg 0.0 1.0 /end CHARACTERISTIC
/begin CHARACTERISTIC KOUTP_OFFR_sec_ovrdflg "" VALUE 0x0000 /* @ECU_Address@KOUTP_OFFR_sec_ovrdflg@ */ Scalar_BOOLEAN 0 SWC_OUTP_type_CM_boolean_flg 0.0 1.0 /end CHARACTERISTIC
/begin CHARACTERISTIC KOUTP_OVCL_sec_ovrdflg "" VALUE 0x0000 /* @ECU_Address@KOUTP_OVCL_sec_ovrdflg@ */ Scalar_BOOLEAN 0 SWC_OUTP_type_CM_boolean_flg 0.0 1.0 /end CHARACTERISTIC
/begin CHARACTERISTIC KOUTP_OVCR_sec_ovrdflg "" VALUE 0x0000 /* @ECU_Address@KOUTP_OVCR_sec_ovrdflg@ */ Scalar_BOOLEAN 0 SWC_OUTP_type_CM_boolean_flg 0.0 1.0 /end CHARACTERISTIC
/begin CHARACTERISTIC KOUTP_PCommandToBCM_enum_ovrdflg "" VALUE 0x0000 /* @ECU_Address@KOUTP_PCommandToBCM_enum_ovrdflg@ */ Scalar_BOOLEAN 0 SWC_OUTP_type_CM_boolean_flg 0.0 1.0 /end CHARACTERISTIC
/begin CHARACTERISTIC KOUTP_PKELNumerator_kphsqr_ovrdflg "" VALUE 0x0000 /* @ECU_Address@KOUTP_PKELNumerator_kphsqr_ovrdflg@ */ Scalar_BOOLEAN 0 SWC_OUTP_type_CM_boolean_flg 0.0 1.0 /end CHARACTERISTIC
/begin CHARACTERISTIC KOUTP_PKEL_kphsqr_ovrdflg "" VALUE 0x0000 /* @ECU_Address@KOUTP_PKEL_kphsqr_ovrdflg@ */ Scalar_BOOLEAN 0 SWC_OUTP_type_CM_boolean_flg 0.0 1.0 /end CHARACTERISTIC
/begin CHARACTERISTIC KOUTP_PKERNumerator_kphsqr_ovrdflg "" VALUE 0x0000 /* @ECU_Address@KOUTP_PKERNumerator_kphsqr_ovrdflg@ */ Scalar_BOOLEAN 0 SWC_OUTP_type_CM_boolean_flg 0.0 1.0 /end CHARACTERISTIC
/begin CHARACTERISTIC KOUTP_PKER_kphsqr_ovrdflg "" VALUE 0x0000 /* @ECU_Address@KOUTP_PKER_kphsqr_ovrdflg@ */ Scalar_BOOLEAN 0 SWC_OUTP_type_CM_boolean_flg 0.0 1.0 /end CHARACTERISTIC
/begin CHARACTERISTIC KOUTP_PNI_flg_maxval "" VALUE 0x0000 /* @ECU_Address@KOUTP_PNI_flg_maxval@ */ Scalar_BOOLEAN 0 SWC_OUTP_type_CM_boolean_flg 0.0 1.0 /end CHARACTERISTIC
/begin CHARACTERISTIC KOUTP_PNI_flg_minval "" VALUE 0x0000 /* @ECU_Address@KOUTP_PNI_flg_minval@ */ Scalar_BOOLEAN 0 SWC_OUTP_type_CM_boolean_flg 0.0 1.0 /end CHARACTERISTIC
/begin CHARACTERISTIC KOUTP_PNI_flg_ovrdflg "" VALUE 0x0000 /* @ECU_Address@KOUTP_PNI_flg_ovrdflg@ */ Scalar_BOOLEAN 0 SWC_OUTP_type_CM_boolean_flg 0.0 1.0 /end CHARACTERISTIC
/begin CHARACTERISTIC KOUTP_PNI_flg_ovrdval "" VALUE 0x0000 /* @ECU_Address@KOUTP_PNI_flg_ovrdval@ */ Scalar_BOOLEAN 0 SWC_OUTP_type_CM_boolean_flg 0.0 1.0 /end CHARACTERISTIC
/begin CHARACTERISTIC KOUTP_PROTOCOLID_enum_ovrdflg "" VALUE 0x0000 /* @ECU_Address@KOUTP_PROTOCOLID_enum_ovrdflg@ */ Scalar_BOOLEAN 0 SWC_OUTP_type_CM_boolean_flg 0.0 1.0 /end CHARACTERISTIC
/begin CHARACTERISTIC KOUTP_PSAL_sec_ovrdflg "" VALUE 0x0000 /* @ECU_Address@KOUTP_PSAL_sec_ovrdflg@ */ Scalar_BOOLEAN 0 SWC_OUTP_type_CM_boolean_flg 0.0 1.0 /end CHARACTERISTIC
/begin CHARACTERISTIC KOUTP_PSAR_sec_ovrdflg "" VALUE 0x0000 /* @ECU_Address@KOUTP_PSAR_sec_ovrdflg@ */ Scalar_BOOLEAN 0 SWC_OUTP_type_CM_boolean_flg 0.0 1.0 /end CHARACTERISTIC
/begin CHARACTERISTIC KOUTP_ParkingModeCmd_enum_ovrdflg "" VALUE 0x0000 /* @ECU_Address@KOUTP_ParkingModeCmd_enum_ovrdflg@ */ Scalar_BOOLEAN 0 SWC_OUTP_type_CM_boolean_flg 0.0 1.0 /end CHARACTERISTIC
/begin CHARACTERISTIC KOUTP_PowerDownFault_enum_ovrdflg "" VALUE 0x0000 /* @ECU_Address@KOUTP_PowerDownFault_enum_ovrdflg@ */ Scalar_BOOLEAN 0 SWC_OUTP_type_CM_boolean_flg 0.0 1.0 /end CHARACTERISTIC
/begin CHARACTERISTIC KOUTP_PowerDownState_enum_ovrdflg "" VALUE 0x0000 /* @ECU_Address@KOUTP_PowerDownState_enum_ovrdflg@ */ Scalar_BOOLEAN 0 SWC_OUTP_type_CM_boolean_flg 0.0 1.0 /end CHARACTERISTIC
/begin CHARACTERISTIC KOUTP_PowerUpFault_enum_ovrdflg "" VALUE 0x0000 /* @ECU_Address@KOUTP_PowerUpFault_enum_ovrdflg@ */ Scalar_BOOLEAN 0 SWC_OUTP_type_CM_boolean_flg 0.0 1.0 /end CHARACTERISTIC
/begin CHARACTERISTIC KOUTP_PowerUpState_enum_ovrdflg "" VALUE 0x0000 /* @ECU_Address@KOUTP_PowerUpState_enum_ovrdflg@ */ Scalar_BOOLEAN 0 SWC_OUTP_type_CM_boolean_flg 0.0 1.0 /end CHARACTERISTIC
/begin CHARACTERISTIC KOUTP_QTYPSATRIPSL_cnt_ovrdflg "" VALUE 0x0000 /* @ECU_Address@KOUTP_QTYPSATRIPSL_cnt_ovrdflg@ */ Scalar_BOOLEAN 0 SWC_OUTP_type_CM_boolean_flg 0.0 1.0 /end CHARACTERISTIC
/begin CHARACTERISTIC KOUTP_QTYPSATRIPSR_cnt_ovrdflg "" VALUE 0x0000 /* @ECU_Address@KOUTP_QTYPSATRIPSR_cnt_ovrdflg@ */ Scalar_BOOLEAN 0 SWC_OUTP_type_CM_boolean_flg 0.0 1.0 /end CHARACTERISTIC
/begin CHARACTERISTIC KOUTP_RESSCNTDODRNGL_cnt_ovrdflg "" VALUE 0x0000 /* @ECU_Address@KOUTP_RESSCNTDODRNGL_cnt_ovrdflg@ */ Scalar_BOOLEAN 0 SWC_OUTP_type_CM_boolean_flg 0.0 1.0 /end CHARACTERISTIC
/begin CHARACTERISTIC KOUTP_RESSCNTDODRNGR_cnt_ovrdflg "" VALUE 0x0000 /* @ECU_Address@KOUTP_RESSCNTDODRNGR_cnt_ovrdflg@ */ Scalar_BOOLEAN 0 SWC_OUTP_type_CM_boolean_flg 0.0 1.0 /end CHARACTERISTIC
/begin CHARACTERISTIC KOUTP_RESSCNTSDODRNGAXIS_enum_ovrdflg "" VALUE 0x0000 /* @ECU_Address@KOUTP_RESSCNTSDODRNGAXIS_enum_ovrdflg@ */ Scalar_BOOLEAN 0 SWC_OUTP_type_CM_boolean_flg 0.0 1.0 /end CHARACTERISTIC
/begin CHARACTERISTIC KOUTP_RESSTIMESOCCHGRNGL_s_ovrdflg "" VALUE 0x0000 /* @ECU_Address@KOUTP_RESSTIMESOCCHGRNGL_s_ovrdflg@ */ Scalar_BOOLEAN 0 SWC_OUTP_type_CM_boolean_flg 0.0 1.0 /end CHARACTERISTIC
/begin CHARACTERISTIC KOUTP_RESSTIMESOCCHGRNGR_s_ovrdflg "" VALUE 0x0000 /* @ECU_Address@KOUTP_RESSTIMESOCCHGRNGR_s_ovrdflg@ */ Scalar_BOOLEAN 0 SWC_OUTP_type_CM_boolean_flg 0.0 1.0 /end CHARACTERISTIC
/begin CHARACTERISTIC KOUTP_RESSTIMESOCOFFRNGL_s_ovrdflg "" VALUE 0x0000 /* @ECU_Address@KOUTP_RESSTIMESOCOFFRNGL_s_ovrdflg@ */ Scalar_BOOLEAN 0 SWC_OUTP_type_CM_boolean_flg 0.0 1.0 /end CHARACTERISTIC
/begin CHARACTERISTIC KOUTP_RESSTIMESOCOFFRNGR_s_ovrdflg "" VALUE 0x0000 /* @ECU_Address@KOUTP_RESSTIMESOCOFFRNGR_s_ovrdflg@ */ Scalar_BOOLEAN 0 SWC_OUTP_type_CM_boolean_flg 0.0 1.0 /end CHARACTERISTIC
/begin CHARACTERISTIC KOUTP_RESSTIMESOCPSARNGL_s_ovrdflg "" VALUE 0x0000 /* @ECU_Address@KOUTP_RESSTIMESOCPSARNGL_s_ovrdflg@ */ Scalar_BOOLEAN 0 SWC_OUTP_type_CM_boolean_flg 0.0 1.0 /end CHARACTERISTIC
/begin CHARACTERISTIC KOUTP_RESSTIMESOCPSARNGR_s_ovrdflg "" VALUE 0x0000 /* @ECU_Address@KOUTP_RESSTIMESOCPSARNGR_s_ovrdflg@ */ Scalar_BOOLEAN 0 SWC_OUTP_type_CM_boolean_flg 0.0 1.0 /end CHARACTERISTIC
/begin CHARACTERISTIC KOUTP_RESSTIMESOCRNGAXIS_enum_ovrdflg "" VALUE 0x0000 /* @ECU_Address@KOUTP_RESSTIMESOCRNGAXIS_enum_ovrdflg@ */ Scalar_BOOLEAN 0 SWC_OUTP_type_CM_boolean_flg 0.0 1.0 /end CHARACTERISTIC
/begin CHARACTERISTIC KOUTP_RESSTTEMPRNGAXIS_enum_ovrdflg "" VALUE 0x0000 /* @ECU_Address@KOUTP_RESSTTEMPRNGAXIS_enum_ovrdflg@ */ Scalar_BOOLEAN 0 SWC_OUTP_type_CM_boolean_flg 0.0 1.0 /end CHARACTERISTIC
/begin CHARACTERISTIC KOUTP_RESSV2XENNONPSAL_kWh_ovrdflg "" VALUE 0x0000 /* @ECU_Address@KOUTP_RESSV2XENNONPSAL_kWh_ovrdflg@ */ Scalar_BOOLEAN 0 SWC_OUTP_type_CM_boolean_flg 0.0 1.0 /end CHARACTERISTIC
/begin CHARACTERISTIC KOUTP_RESSV2XENNONPSAR_kWh_ovrdflg "" VALUE 0x0000 /* @ECU_Address@KOUTP_RESSV2XENNONPSAR_kWh_ovrdflg@ */ Scalar_BOOLEAN 0 SWC_OUTP_type_CM_boolean_flg 0.0 1.0 /end CHARACTERISTIC
/begin CHARACTERISTIC KOUTP_RUNTM_s_ovrdflg "" VALUE 0x0000 /* @ECU_Address@KOUTP_RUNTM_s_ovrdflg@ */ Scalar_BOOLEAN 0 SWC_OUTP_type_CM_boolean_flg 0.0 1.0 /end CHARACTERISTIC
/begin CHARACTERISTIC KOUTP_ResetCDEODTR_km_ovrdflg "" VALUE 0x0000 /* @ECU_Address@KOUTP_ResetCDEODTR_km_ovrdflg@ */ Scalar_BOOLEAN 0 SWC_OUTP_type_CM_boolean_flg 0.0 1.0 /end CHARACTERISTIC
/begin CHARACTERISTIC KOUTP_RptMsgReq_flg_maxval "" VALUE 0x0000 /* @ECU_Address@KOUTP_RptMsgReq_flg_maxval@ */ Scalar_BOOLEAN 0 SWC_OUTP_type_CM_boolean_flg 0.0 1.0 /end CHARACTERISTIC
/begin CHARACTERISTIC KOUTP_RptMsgReq_flg_minval "" VALUE 0x0000 /* @ECU_Address@KOUTP_RptMsgReq_flg_minval@ */ Scalar_BOOLEAN 0 SWC_OUTP_type_CM_boolean_flg 0.0 1.0 /end CHARACTERISTIC
/begin CHARACTERISTIC KOUTP_RptMsgReq_flg_ovrdflg "" VALUE 0x0000 /* @ECU_Address@KOUTP_RptMsgReq_flg_ovrdflg@ */ Scalar_BOOLEAN 0 SWC_OUTP_type_CM_boolean_flg 0.0 1.0 /end CHARACTERISTIC
/begin CHARACTERISTIC KOUTP_RptMsgReq_flg_ovrdval "" VALUE 0x0000 /* @ECU_Address@KOUTP_RptMsgReq_flg_ovrdval@ */ Scalar_BOOLEAN 0 SWC_OUTP_type_CM_boolean_flg 0.0 1.0 /end CHARACTERISTIC
/begin CHARACTERISTIC KOUTP_STASUP_enum_ovrdflg "" VALUE 0x0000 /* @ECU_Address@KOUTP_STASUP_enum_ovrdflg@ */ Scalar_BOOLEAN 0 SWC_OUTP_type_CM_boolean_flg 0.0 1.0 /end CHARACTERISTIC
/begin CHARACTERISTIC KOUTP_SysNMmSta_enum_ovrdflg "" VALUE 0x0000 /* @ECU_Address@KOUTP_SysNMmSta_enum_ovrdflg@ */ Scalar_BOOLEAN 0 SWC_OUTP_type_CM_boolean_flg 0.0 1.0 /end CHARACTERISTIC
/begin CHARACTERISTIC KOUTP_SysPowerMode_enum_ovrdflg "" VALUE 0x0000 /* @ECU_Address@KOUTP_SysPowerMode_enum_ovrdflg@ */ Scalar_BOOLEAN 0 SWC_OUTP_type_CM_boolean_flg 0.0 1.0 /end CHARACTERISTIC
/begin CHARACTERISTIC KOUTP_TEBPSAL_kWh_ovrdflg "" VALUE 0x0000 /* @ECU_Address@KOUTP_TEBPSAL_kWh_ovrdflg@ */ Scalar_BOOLEAN 0 SWC_OUTP_type_CM_boolean_flg 0.0 1.0 /end CHARACTERISTIC
/begin CHARACTERISTIC KOUTP_TEBPSAR_kWh_ovrdflg "" VALUE 0x0000 /* @ECU_Address@KOUTP_TEBPSAR_kWh_ovrdflg@ */ Scalar_BOOLEAN 0 SWC_OUTP_type_CM_boolean_flg 0.0 1.0 /end CHARACTERISTIC
/begin CHARACTERISTIC KOUTP_TGEOVCL_kWh_ovrdflg "" VALUE 0x0000 /* @ECU_Address@KOUTP_TGEOVCL_kWh_ovrdflg@ */ Scalar_BOOLEAN 0 SWC_OUTP_type_CM_boolean_flg 0.0 1.0 /end CHARACTERISTIC
/begin CHARACTERISTIC KOUTP_TGEOVCR_kWh_ovrdflg "" VALUE 0x0000 /* @ECU_Address@KOUTP_TGEOVCR_kWh_ovrdflg@ */ Scalar_BOOLEAN 0 SWC_OUTP_type_CM_boolean_flg 0.0 1.0 /end CHARACTERISTIC
/begin CHARACTERISTIC KOUTP_TNBCPSAL_Ahr_ovrdflg "" VALUE 0x0000 /* @ECU_Address@KOUTP_TNBCPSAL_Ahr_ovrdflg@ */ Scalar_BOOLEAN 0 SWC_OUTP_type_CM_boolean_flg 0.0 1.0 /end CHARACTERISTIC
/begin CHARACTERISTIC KOUTP_TNBCPSAR_Ahr_ovrdflg "" VALUE 0x0000 /* @ECU_Address@KOUTP_TNBCPSAR_Ahr_ovrdflg@ */ Scalar_BOOLEAN 0 SWC_OUTP_type_CM_boolean_flg 0.0 1.0 /end CHARACTERISTIC
/begin CHARACTERISTIC KOUTP_TNECPSAL_kWh_ovrdflg "" VALUE 0x0000 /* @ECU_Address@KOUTP_TNECPSAL_kWh_ovrdflg@ */ Scalar_BOOLEAN 0 SWC_OUTP_type_CM_boolean_flg 0.0 1.0 /end CHARACTERISTIC
/begin CHARACTERISTIC KOUTP_TNECPSAR_kWh_ovrdflg "" VALUE 0x0000 /* @ECU_Address@KOUTP_TNECPSAR_kWh_ovrdflg@ */ Scalar_BOOLEAN 0 SWC_OUTP_type_CM_boolean_flg 0.0 1.0 /end CHARACTERISTIC
/begin CHARACTERISTIC KOUTP_TimeSNDKCFbk_cnt_ovrdflg "" VALUE 0x0000 /* @ECU_Address@KOUTP_TimeSNDKCFbk_cnt_ovrdflg@ */ Scalar_BOOLEAN 0 SWC_OUTP_type_CM_boolean_flg 0.0 1.0 /end CHARACTERISTIC
/begin CHARACTERISTIC KOUTP_UIDLowPowerSta_enum_ovrdflg "" VALUE 0x0000 /* @ECU_Address@KOUTP_UIDLowPowerSta_enum_ovrdflg@ */ Scalar_BOOLEAN 0 SWC_OUTP_type_CM_boolean_flg 0.0 1.0 /end CHARACTERISTIC
/begin CHARACTERISTIC KOUTP_V2BACPosRlyFit_enum_ovrdflg "" VALUE 0x0000 /* @ECU_Address@KOUTP_V2BACPosRlyFit_enum_ovrdflg@ */ Scalar_BOOLEAN 0 SWC_OUTP_type_CM_boolean_flg 0.0 1.0 /end CHARACTERISTIC
/begin CHARACTERISTIC KOUTP_V2BACPosRlySta_enum_ovrdflg "" VALUE 0x0000 /* @ECU_Address@KOUTP_V2BACPosRlySta_enum_ovrdflg@ */ Scalar_BOOLEAN 0 SWC_OUTP_type_CM_boolean_flg 0.0 1.0 /end CHARACTERISTIC
/begin CHARACTERISTIC KOUTP_V2BAirPosRlyFit_enum_ovrdflg "" VALUE 0x0000 /* @ECU_Address@KOUTP_V2BAirPosRlyFit_enum_ovrdflg@ */ Scalar_BOOLEAN 0 SWC_OUTP_type_CM_boolean_flg 0.0 1.0 /end CHARACTERISTIC
/begin CHARACTERISTIC KOUTP_V2BAirPosRlySta_enum_ovrdflg "" VALUE 0x0000 /* @ECU_Address@KOUTP_V2BAirPosRlySta_enum_ovrdflg@ */ Scalar_BOOLEAN 0 SWC_OUTP_type_CM_boolean_flg 0.0 1.0 /end CHARACTERISTIC
/begin CHARACTERISTIC KOUTP_V2BAux1OnOff_enum_ovrdflg "" VALUE 0x0000 /* @ECU_Address@KOUTP_V2BAux1OnOff_enum_ovrdflg@ */ Scalar_BOOLEAN 0 SWC_OUTP_type_CM_boolean_flg 0.0 1.0 /end CHARACTERISTIC
/begin CHARACTERISTIC KOUTP_V2BAux1RlyFit_enum_ovrdflg "" VALUE 0x0000 /* @ECU_Address@KOUTP_V2BAux1RlyFit_enum_ovrdflg@ */ Scalar_BOOLEAN 0 SWC_OUTP_type_CM_boolean_flg 0.0 1.0 /end CHARACTERISTIC
/begin CHARACTERISTIC KOUTP_V2BAux1RlySta_enum_ovrdflg "" VALUE 0x0000 /* @ECU_Address@KOUTP_V2BAux1RlySta_enum_ovrdflg@ */ Scalar_BOOLEAN 0 SWC_OUTP_type_CM_boolean_flg 0.0 1.0 /end CHARACTERISTIC
/begin CHARACTERISTIC KOUTP_V2BAux2OnOff_enum_ovrdflg "" VALUE 0x0000 /* @ECU_Address@KOUTP_V2BAux2OnOff_enum_ovrdflg@ */ Scalar_BOOLEAN 0 SWC_OUTP_type_CM_boolean_flg 0.0 1.0 /end CHARACTERISTIC
/begin CHARACTERISTIC KOUTP_V2BAux2RlyFit_enum_ovrdflg "" VALUE 0x0000 /* @ECU_Address@KOUTP_V2BAux2RlyFit_enum_ovrdflg@ */ Scalar_BOOLEAN 0 SWC_OUTP_type_CM_boolean_flg 0.0 1.0 /end CHARACTERISTIC
/begin CHARACTERISTIC KOUTP_V2BAux2RlySta_enum_ovrdflg "" VALUE 0x0000 /* @ECU_Address@KOUTP_V2BAux2RlySta_enum_ovrdflg@ */ Scalar_BOOLEAN 0 SWC_OUTP_type_CM_boolean_flg 0.0 1.0 /end CHARACTERISTIC
/begin CHARACTERISTIC KOUTP_V2BAux3OnOff_enum_ovrdflg "" VALUE 0x0000 /* @ECU_Address@KOUTP_V2BAux3OnOff_enum_ovrdflg@ */ Scalar_BOOLEAN 0 SWC_OUTP_type_CM_boolean_flg 0.0 1.0 /end CHARACTERISTIC
/begin CHARACTERISTIC KOUTP_V2BAux3RlyFit_enum_ovrdflg "" VALUE 0x0000 /* @ECU_Address@KOUTP_V2BAux3RlyFit_enum_ovrdflg@ */ Scalar_BOOLEAN 0 SWC_OUTP_type_CM_boolean_flg 0.0 1.0 /end CHARACTERISTIC
/begin CHARACTERISTIC KOUTP_V2BAux3RlySta_enum_ovrdflg "" VALUE 0x0000 /* @ECU_Address@KOUTP_V2BAux3RlySta_enum_ovrdflg@ */ Scalar_BOOLEAN 0 SWC_OUTP_type_CM_boolean_flg 0.0 1.0 /end CHARACTERISTIC
/begin CHARACTERISTIC KOUTP_V2BAux4RlyFit_enum_ovrdflg "" VALUE 0x0000 /* @ECU_Address@KOUTP_V2BAux4RlyFit_enum_ovrdflg@ */ Scalar_BOOLEAN 0 SWC_OUTP_type_CM_boolean_flg 0.0 1.0 /end CHARACTERISTIC
/begin CHARACTERISTIC KOUTP_V2BAux4RlySta_enum_ovrdflg "" VALUE 0x0000 /* @ECU_Address@KOUTP_V2BAux4RlySta_enum_ovrdflg@ */ Scalar_BOOLEAN 0 SWC_OUTP_type_CM_boolean_flg 0.0 1.0 /end CHARACTERISTIC
/begin CHARACTERISTIC KOUTP_V2BDCDCPosRlyFit_enum_ovrdflg "" VALUE 0x0000 /* @ECU_Address@KOUTP_V2BDCDCPosRlyFit_enum_ovrdflg@ */ Scalar_BOOLEAN 0 SWC_OUTP_type_CM_boolean_flg 0.0 1.0 /end CHARACTERISTIC
/begin CHARACTERISTIC KOUTP_V2BDCDCPosRlySta_enum_ovrdflg "" VALUE 0x0000 /* @ECU_Address@KOUTP_V2BDCDCPosRlySta_enum_ovrdflg@ */ Scalar_BOOLEAN 0 SWC_OUTP_type_CM_boolean_flg 0.0 1.0 /end CHARACTERISTIC
/begin CHARACTERISTIC KOUTP_VSS_kph_ovrdflg "" VALUE 0x0000 /* @ECU_Address@KOUTP_VSS_kph_ovrdflg@ */ Scalar_BOOLEAN 0 SWC_OUTP_type_CM_boolean_flg 0.0 1.0 /end CHARACTERISTIC
/begin CHARACTERISTIC KOUTP_VinCode_cnt_ovrdflg "" VALUE 0x0000 /* @ECU_Address@KOUTP_VinCode_cnt_ovrdflg@ */ Scalar_BOOLEAN 0 SWC_OUTP_type_CM_boolean_flg 0.0 1.0 /end CHARACTERISTIC
/begin CHARACTERISTIC KOUTP_WARMUPS_cnt_ovrdflg "" VALUE 0x0000 /* @ECU_Address@KOUTP_WARMUPS_cnt_ovrdflg@ */ Scalar_BOOLEAN 0 SWC_OUTP_type_CM_boolean_flg 0.0 1.0 /end CHARACTERISTIC
/begin CHARACTERISTIC KOUTP_WakeUp_enum_ovrdflg "" VALUE 0x0000 /* @ECU_Address@KOUTP_WakeUp_enum_ovrdflg@ */ Scalar_BOOLEAN 0 SWC_OUTP_type_CM_boolean_flg 0.0 1.0 /end CHARACTERISTIC
/begin CHARACTERISTIC KOUTP_ACHVLoopDem_enum_maxval "" VALUE 0x0000 /* @ECU_Address@KOUTP_ACHVLoopDem_enum_maxval@ */ Scalar_UBYTE 0 SWC_OUTP_type_CM_uint8_enum 0.0 255.0 /end CHARACTERISTIC
/begin CHARACTERISTIC KOUTP_ACHVLoopDem_enum_minval "" VALUE 0x0000 /* @ECU_Address@KOUTP_ACHVLoopDem_enum_minval@ */ Scalar_UBYTE 0 SWC_OUTP_type_CM_uint8_enum 0.0 255.0 /end CHARACTERISTIC
/begin CHARACTERISTIC KOUTP_ACHVLoopDem_enum_ovrdval "" VALUE 0x0000 /* @ECU_Address@KOUTP_ACHVLoopDem_enum_ovrdval@ */ Scalar_UBYTE 0 SWC_OUTP_type_CM_uint8_enum 0.0 255.0 /end CHARACTERISTIC
/begin CHARACTERISTIC KOUTP_ActiveDischargeReq_enum_maxval "" VALUE 0x0000 /* @ECU_Address@KOUTP_ActiveDischargeReq_enum_maxval@ */ Scalar_UBYTE 0 SWC_OUTP_type_CM_uint8_enum 0.0 255.0 /end CHARACTERISTIC
/begin CHARACTERISTIC KOUTP_ActiveDischargeReq_enum_minval "" VALUE 0x0000 /* @ECU_Address@KOUTP_ActiveDischargeReq_enum_minval@ */ Scalar_UBYTE 0 SWC_OUTP_type_CM_uint8_enum 0.0 255.0 /end CHARACTERISTIC
/begin CHARACTERISTIC KOUTP_ActiveDischargeReq_enum_ovrdval "" VALUE 0x0000 /* @ECU_Address@KOUTP_ActiveDischargeReq_enum_ovrdval@ */ Scalar_UBYTE 0 SWC_OUTP_type_CM_uint8_enum 0.0 255.0 /end CHARACTERISTIC
/begin CHARACTERISTIC KOUTP_Awake_enum_maxval "" VALUE 0x0000 /* @ECU_Address@KOUTP_Awake_enum_maxval@ */ Scalar_UBYTE 0 SWC_OUTP_type_CM_uint8_enum 0.0 255.0 /end CHARACTERISTIC
/begin CHARACTERISTIC KOUTP_Awake_enum_minval "" VALUE 0x0000 /* @ECU_Address@KOUTP_Awake_enum_minval@ */ Scalar_UBYTE 0 SWC_OUTP_type_CM_uint8_enum 0.0 255.0 /end CHARACTERISTIC
/begin CHARACTERISTIC KOUTP_Awake_enum_ovrdval "" VALUE 0x0000 /* @ECU_Address@KOUTP_Awake_enum_ovrdval@ */ Scalar_UBYTE 0 SWC_OUTP_type_CM_uint8_enum 0.0 255.0 /end CHARACTERISTIC
/begin CHARACTERISTIC KOUTP_BattHVDem_enum_maxval "" VALUE 0x0000 /* @ECU_Address@KOUTP_BattHVDem_enum_maxval@ */ Scalar_UBYTE 0 SWC_OUTP_type_CM_uint8_enum 0.0 255.0 /end CHARACTERISTIC
/begin CHARACTERISTIC KOUTP_BattHVDem_enum_minval "" VALUE 0x0000 /* @ECU_Address@KOUTP_BattHVDem_enum_minval@ */ Scalar_UBYTE 0 SWC_OUTP_type_CM_uint8_enum 0.0 255.0 /end CHARACTERISTIC
/begin CHARACTERISTIC KOUTP_BattHVDem_enum_ovrdval "" VALUE 0x0000 /* @ECU_Address@KOUTP_BattHVDem_enum_ovrdval@ */ Scalar_UBYTE 0 SWC_OUTP_type_CM_uint8_enum 0.0 255.0 /end CHARACTERISTIC
/begin CHARACTERISTIC KOUTP_CACRlyDem_enum_maxval "" VALUE 0x0000 /* @ECU_Address@KOUTP_CACRlyDem_enum_maxval@ */ Scalar_UBYTE 0 SWC_OUTP_type_CM_uint8_enum 0.0 255.0 /end CHARACTERISTIC
/begin CHARACTERISTIC KOUTP_CACRlyDem_enum_minval "" VALUE 0x0000 /* @ECU_Address@KOUTP_CACRlyDem_enum_minval@ */ Scalar_UBYTE 0 SWC_OUTP_type_CM_uint8_enum 0.0 255.0 /end CHARACTERISTIC
/begin CHARACTERISTIC KOUTP_CACRlyDem_enum_ovrdval "" VALUE 0x0000 /* @ECU_Address@KOUTP_CACRlyDem_enum_ovrdval@ */ Scalar_UBYTE 0 SWC_OUTP_type_CM_uint8_enum 0.0 255.0 /end CHARACTERISTIC
/begin CHARACTERISTIC KOUTP_ChrgFault_enum_maxval "" VALUE 0x0000 /* @ECU_Address@KOUTP_ChrgFault_enum_maxval@ */ Scalar_UBYTE 0 SWC_OUTP_type_CM_uint8_enum 0.0 255.0 /end CHARACTERISTIC
/begin CHARACTERISTIC KOUTP_ChrgFault_enum_minval "" VALUE 0x0000 /* @ECU_Address@KOUTP_ChrgFault_enum_minval@ */ Scalar_UBYTE 0 SWC_OUTP_type_CM_uint8_enum 0.0 255.0 /end CHARACTERISTIC
/begin CHARACTERISTIC KOUTP_ChrgFault_enum_ovrdval "" VALUE 0x0000 /* @ECU_Address@KOUTP_ChrgFault_enum_ovrdval@ */ Scalar_UBYTE 0 SWC_OUTP_type_CM_uint8_enum 0.0 255.0 /end CHARACTERISTIC
/begin CHARACTERISTIC KOUTP_ChrgState_enum_maxval "" VALUE 0x0000 /* @ECU_Address@KOUTP_ChrgState_enum_maxval@ */ Scalar_UBYTE 0 SWC_OUTP_type_CM_uint8_enum 0.0 255.0 /end CHARACTERISTIC
/begin CHARACTERISTIC KOUTP_ChrgState_enum_minval "" VALUE 0x0000 /* @ECU_Address@KOUTP_ChrgState_enum_minval@ */ Scalar_UBYTE 0 SWC_OUTP_type_CM_uint8_enum 0.0 255.0 /end CHARACTERISTIC
/begin CHARACTERISTIC KOUTP_ChrgState_enum_ovrdval "" VALUE 0x0000 /* @ECU_Address@KOUTP_ChrgState_enum_ovrdval@ */ Scalar_UBYTE 0 SWC_OUTP_type_CM_uint8_enum 0.0 255.0 /end CHARACTERISTIC
/begin CHARACTERISTIC KOUTP_DCDCRlyDem_enum_maxval "" VALUE 0x0000 /* @ECU_Address@KOUTP_DCDCRlyDem_enum_maxval@ */ Scalar_UBYTE 0 SWC_OUTP_type_CM_uint8_enum 0.0 255.0 /end CHARACTERISTIC
/begin CHARACTERISTIC KOUTP_DCDCRlyDem_enum_minval "" VALUE 0x0000 /* @ECU_Address@KOUTP_DCDCRlyDem_enum_minval@ */ Scalar_UBYTE 0 SWC_OUTP_type_CM_uint8_enum 0.0 255.0 /end CHARACTERISTIC
/begin CHARACTERISTIC KOUTP_DCDCRlyDem_enum_ovrdval "" VALUE 0x0000 /* @ECU_Address@KOUTP_DCDCRlyDem_enum_ovrdval@ */ Scalar_UBYTE 0 SWC_OUTP_type_CM_uint8_enum 0.0 255.0 /end CHARACTERISTIC
/begin CHARACTERISTIC KOUTP_DISCSta_enum_maxval "" VALUE 0x0000 /* @ECU_Address@KOUTP_DISCSta_enum_maxval@ */ Scalar_UBYTE 0 SWC_OUTP_type_CM_uint8_enum 0.0 255.0 /end CHARACTERISTIC
/begin CHARACTERISTIC KOUTP_DISCSta_enum_minval "" VALUE 0x0000 /* @ECU_Address@KOUTP_DISCSta_enum_minval@ */ Scalar_UBYTE 0 SWC_OUTP_type_CM_uint8_enum 0.0 255.0 /end CHARACTERISTIC
/begin CHARACTERISTIC KOUTP_DISCSta_enum_ovrdval "" VALUE 0x0000 /* @ECU_Address@KOUTP_DISCSta_enum_ovrdval@ */ Scalar_UBYTE 0 SWC_OUTP_type_CM_uint8_enum 0.0 255.0 /end CHARACTERISTIC
/begin CHARACTERISTIC KOUTP_DKCAuthSta_enum_maxval "" VALUE 0x0000 /* @ECU_Address@KOUTP_DKCAuthSta_enum_maxval@ */ Scalar_UBYTE 0 SWC_OUTP_type_CM_uint8_enum 0.0 255.0 /end CHARACTERISTIC
/begin CHARACTERISTIC KOUTP_DKCAuthSta_enum_minval "" VALUE 0x0000 /* @ECU_Address@KOUTP_DKCAuthSta_enum_minval@ */ Scalar_UBYTE 0 SWC_OUTP_type_CM_uint8_enum 0.0 255.0 /end CHARACTERISTIC
/begin CHARACTERISTIC KOUTP_DKCAuthSta_enum_ovrdval "" VALUE 0x0000 /* @ECU_Address@KOUTP_DKCAuthSta_enum_ovrdval@ */ Scalar_UBYTE 0 SWC_OUTP_type_CM_uint8_enum 0.0 255.0 /end CHARACTERISTIC
/begin CHARACTERISTIC KOUTP_DKeyWelcomeSta_enum_maxval "" VALUE 0x0000 /* @ECU_Address@KOUTP_DKeyWelcomeSta_enum_maxval@ */ Scalar_UBYTE 0 SWC_OUTP_type_CM_uint8_enum 0.0 255.0 /end CHARACTERISTIC
/begin CHARACTERISTIC KOUTP_DKeyWelcomeSta_enum_minval "" VALUE 0x0000 /* @ECU_Address@KOUTP_DKeyWelcomeSta_enum_minval@ */ Scalar_UBYTE 0 SWC_OUTP_type_CM_uint8_enum 0.0 255.0 /end CHARACTERISTIC
/begin CHARACTERISTIC KOUTP_DKeyWelcomeSta_enum_ovrdval "" VALUE 0x0000 /* @ECU_Address@KOUTP_DKeyWelcomeSta_enum_ovrdval@ */ Scalar_UBYTE 0 SWC_OUTP_type_CM_uint8_enum 0.0 255.0 /end CHARACTERISTIC
/begin CHARACTERISTIC KOUTP_DkeyAreaRAPSSta_enum_maxval "" VALUE 0x0000 /* @ECU_Address@KOUTP_DkeyAreaRAPSSta_enum_maxval@ */ Scalar_UBYTE 0 SWC_OUTP_type_CM_uint8_enum 0.0 255.0 /end CHARACTERISTIC
/begin CHARACTERISTIC KOUTP_DkeyAreaRAPSSta_enum_minval "" VALUE 0x0000 /* @ECU_Address@KOUTP_DkeyAreaRAPSSta_enum_minval@ */ Scalar_UBYTE 0 SWC_OUTP_type_CM_uint8_enum 0.0 255.0 /end CHARACTERISTIC
/begin CHARACTERISTIC KOUTP_DkeyAreaRAPSSta_enum_ovrdval "" VALUE 0x0000 /* @ECU_Address@KOUTP_DkeyAreaRAPSSta_enum_ovrdval@ */ Scalar_UBYTE 0 SWC_OUTP_type_CM_uint8_enum 0.0 255.0 /end CHARACTERISTIC
/begin CHARACTERISTIC KOUTP_DkeyShowIVISta_enum_maxval "" VALUE 0x0000 /* @ECU_Address@KOUTP_DkeyShowIVISta_enum_maxval@ */ Scalar_UBYTE 0 SWC_OUTP_type_CM_uint8_enum 0.0 255.0 /end CHARACTERISTIC
/begin CHARACTERISTIC KOUTP_DkeyShowIVISta_enum_minval "" VALUE 0x0000 /* @ECU_Address@KOUTP_DkeyShowIVISta_enum_minval@ */ Scalar_UBYTE 0 SWC_OUTP_type_CM_uint8_enum 0.0 255.0 /end CHARACTERISTIC
/begin CHARACTERISTIC KOUTP_DkeyShowIVISta_enum_ovrdval "" VALUE 0x0000 /* @ECU_Address@KOUTP_DkeyShowIVISta_enum_ovrdval@ */ Scalar_UBYTE 0 SWC_OUTP_type_CM_uint8_enum 0.0 255.0 /end CHARACTERISTIC
/begin CHARACTERISTIC KOUTP_DrivelineRelease_enum_maxval "" VALUE 0x0000 /* @ECU_Address@KOUTP_DrivelineRelease_enum_maxval@ */ Scalar_UBYTE 0 SWC_OUTP_type_CM_uint8_enum 0.0 255.0 /end CHARACTERISTIC
/begin CHARACTERISTIC KOUTP_DrivelineRelease_enum_minval "" VALUE 0x0000 /* @ECU_Address@KOUTP_DrivelineRelease_enum_minval@ */ Scalar_UBYTE 0 SWC_OUTP_type_CM_uint8_enum 0.0 255.0 /end CHARACTERISTIC
/begin CHARACTERISTIC KOUTP_DrivelineRelease_enum_ovrdval "" VALUE 0x0000 /* @ECU_Address@KOUTP_DrivelineRelease_enum_ovrdval@ */ Scalar_UBYTE 0 SWC_OUTP_type_CM_uint8_enum 0.0 255.0 /end CHARACTERISTIC
/begin CHARACTERISTIC KOUTP_EHPSRlyDem_enum_maxval "" VALUE 0x0000 /* @ECU_Address@KOUTP_EHPSRlyDem_enum_maxval@ */ Scalar_UBYTE 0 SWC_OUTP_type_CM_uint8_enum 0.0 255.0 /end CHARACTERISTIC
/begin CHARACTERISTIC KOUTP_EHPSRlyDem_enum_minval "" VALUE 0x0000 /* @ECU_Address@KOUTP_EHPSRlyDem_enum_minval@ */ Scalar_UBYTE 0 SWC_OUTP_type_CM_uint8_enum 0.0 255.0 /end CHARACTERISTIC
/begin CHARACTERISTIC KOUTP_EHPSRlyDem_enum_ovrdval "" VALUE 0x0000 /* @ECU_Address@KOUTP_EHPSRlyDem_enum_ovrdval@ */ Scalar_UBYTE 0 SWC_OUTP_type_CM_uint8_enum 0.0 255.0 /end CHARACTERISTIC
/begin CHARACTERISTIC KOUTP_ErrorState_enum_maxval "" VALUE 0x0000 /* @ECU_Address@KOUTP_ErrorState_enum_maxval@ */ Scalar_UBYTE 0 SWC_OUTP_type_CM_uint8_enum 0.0 255.0 /end CHARACTERISTIC
/begin CHARACTERISTIC KOUTP_ErrorState_enum_minval "" VALUE 0x0000 /* @ECU_Address@KOUTP_ErrorState_enum_minval@ */ Scalar_UBYTE 0 SWC_OUTP_type_CM_uint8_enum 0.0 255.0 /end CHARACTERISTIC
/begin CHARACTERISTIC KOUTP_ErrorState_enum_ovrdval "" VALUE 0x0000 /* @ECU_Address@KOUTP_ErrorState_enum_ovrdval@ */ Scalar_UBYTE 0 SWC_OUTP_type_CM_uint8_enum 0.0 255.0 /end CHARACTERISTIC
/begin CHARACTERISTIC KOUTP_FogTMSRlyCMD_enum_maxval "" VALUE 0x0000 /* @ECU_Address@KOUTP_FogTMSRlyCMD_enum_maxval@ */ Scalar_UBYTE 0 SWC_OUTP_type_CM_uint8_enum 0.0 255.0 /end CHARACTERISTIC
/begin CHARACTERISTIC KOUTP_FogTMSRlyCMD_enum_minval "" VALUE 0x0000 /* @ECU_Address@KOUTP_FogTMSRlyCMD_enum_minval@ */ Scalar_UBYTE 0 SWC_OUTP_type_CM_uint8_enum 0.0 255.0 /end CHARACTERISTIC
/begin CHARACTERISTIC KOUTP_FogTMSRlyCMD_enum_ovrdval "" VALUE 0x0000 /* @ECU_Address@KOUTP_FogTMSRlyCMD_enum_ovrdval@ */ Scalar_UBYTE 0 SWC_OUTP_type_CM_uint8_enum 0.0 255.0 /end CHARACTERISTIC
/begin CHARACTERISTIC KOUTP_HVSysReady_enum_maxval "" VALUE 0x0000 /* @ECU_Address@KOUTP_HVSysReady_enum_maxval@ */ Scalar_UBYTE 0 SWC_OUTP_type_CM_uint8_enum 0.0 255.0 /end CHARACTERISTIC
/begin CHARACTERISTIC KOUTP_HVSysReady_enum_minval "" VALUE 0x0000 /* @ECU_Address@KOUTP_HVSysReady_enum_minval@ */ Scalar_UBYTE 0 SWC_OUTP_type_CM_uint8_enum 0.0 255.0 /end CHARACTERISTIC
/begin CHARACTERISTIC KOUTP_HVSysReady_enum_ovrdval "" VALUE 0x0000 /* @ECU_Address@KOUTP_HVSysReady_enum_ovrdval@ */ Scalar_UBYTE 0 SWC_OUTP_type_CM_uint8_enum 0.0 255.0 /end CHARACTERISTIC
/begin CHARACTERISTIC KOUTP_KeyAreaLockUnlock_enum_maxval "" VALUE 0x0000 /* @ECU_Address@KOUTP_KeyAreaLockUnlock_enum_maxval@ */ Scalar_UBYTE 0 SWC_OUTP_type_CM_uint8_enum 0.0 255.0 /end CHARACTERISTIC
/begin CHARACTERISTIC KOUTP_KeyAreaLockUnlock_enum_minval "" VALUE 0x0000 /* @ECU_Address@KOUTP_KeyAreaLockUnlock_enum_minval@ */ Scalar_UBYTE 0 SWC_OUTP_type_CM_uint8_enum 0.0 255.0 /end CHARACTERISTIC
/begin CHARACTERISTIC KOUTP_KeyAreaLockUnlock_enum_ovrdval "" VALUE 0x0000 /* @ECU_Address@KOUTP_KeyAreaLockUnlock_enum_ovrdval@ */ Scalar_UBYTE 0 SWC_OUTP_type_CM_uint8_enum 0.0 255.0 /end CHARACTERISTIC
/begin CHARACTERISTIC KOUTP_KeyAreaPS_enum_maxval "" VALUE 0x0000 /* @ECU_Address@KOUTP_KeyAreaPS_enum_maxval@ */ Scalar_UBYTE 0 SWC_OUTP_type_CM_uint8_enum 0.0 255.0 /end CHARACTERISTIC
/begin CHARACTERISTIC KOUTP_KeyAreaPS_enum_minval "" VALUE 0x0000 /* @ECU_Address@KOUTP_KeyAreaPS_enum_minval@ */ Scalar_UBYTE 0 SWC_OUTP_type_CM_uint8_enum 0.0 255.0 /end CHARACTERISTIC
/begin CHARACTERISTIC KOUTP_KeyAreaPS_enum_ovrdval "" VALUE 0x0000 /* @ECU_Address@KOUTP_KeyAreaPS_enum_ovrdval@ */ Scalar_UBYTE 0 SWC_OUTP_type_CM_uint8_enum 0.0 255.0 /end CHARACTERISTIC
/begin CHARACTERISTIC KOUTP_KeyAreaPTG_enum_maxval "" VALUE 0x0000 /* @ECU_Address@KOUTP_KeyAreaPTG_enum_maxval@ */ Scalar_UBYTE 0 SWC_OUTP_type_CM_uint8_enum 0.0 255.0 /end CHARACTERISTIC
/begin CHARACTERISTIC KOUTP_KeyAreaPTG_enum_minval "" VALUE 0x0000 /* @ECU_Address@KOUTP_KeyAreaPTG_enum_minval@ */ Scalar_UBYTE 0 SWC_OUTP_type_CM_uint8_enum 0.0 255.0 /end CHARACTERISTIC
/begin CHARACTERISTIC KOUTP_KeyAreaPTG_enum_ovrdval "" VALUE 0x0000 /* @ECU_Address@KOUTP_KeyAreaPTG_enum_ovrdval@ */ Scalar_UBYTE 0 SWC_OUTP_type_CM_uint8_enum 0.0 255.0 /end CHARACTERISTIC
/begin CHARACTERISTIC KOUTP_KeyAreaSPTGSta_enum_maxval "" VALUE 0x0000 /* @ECU_Address@KOUTP_KeyAreaSPTGSta_enum_maxval@ */ Scalar_UBYTE 0 SWC_OUTP_type_CM_uint8_enum 0.0 255.0 /end CHARACTERISTIC
/begin CHARACTERISTIC KOUTP_KeyAreaSPTGSta_enum_minval "" VALUE 0x0000 /* @ECU_Address@KOUTP_KeyAreaSPTGSta_enum_minval@ */ Scalar_UBYTE 0 SWC_OUTP_type_CM_uint8_enum 0.0 255.0 /end CHARACTERISTIC
/begin CHARACTERISTIC KOUTP_KeyAreaSPTGSta_enum_ovrdval "" VALUE 0x0000 /* @ECU_Address@KOUTP_KeyAreaSPTGSta_enum_ovrdval@ */ Scalar_UBYTE 0 SWC_OUTP_type_CM_uint8_enum 0.0 255.0 /end CHARACTERISTIC
/begin CHARACTERISTIC KOUTP_KeyModeSta_enum_maxval "" VALUE 0x0000 /* @ECU_Address@KOUTP_KeyModeSta_enum_maxval@ */ Scalar_UBYTE 0 SWC_OUTP_type_CM_uint8_enum 0.0 255.0 /end CHARACTERISTIC
/begin CHARACTERISTIC KOUTP_KeyModeSta_enum_minval "" VALUE 0x0000 /* @ECU_Address@KOUTP_KeyModeSta_enum_minval@ */ Scalar_UBYTE 0 SWC_OUTP_type_CM_uint8_enum 0.0 255.0 /end CHARACTERISTIC
/begin CHARACTERISTIC KOUTP_KeyModeSta_enum_ovrdval "" VALUE 0x0000 /* @ECU_Address@KOUTP_KeyModeSta_enum_ovrdval@ */ Scalar_UBYTE 0 SWC_OUTP_type_CM_uint8_enum 0.0 255.0 /end CHARACTERISTIC
/begin CHARACTERISTIC KOUTP_KeyNumSta_enum_maxval "" VALUE 0x0000 /* @ECU_Address@KOUTP_KeyNumSta_enum_maxval@ */ Scalar_UBYTE 0 SWC_OUTP_type_CM_uint8_enum 0.0 255.0 /end CHARACTERISTIC
/begin CHARACTERISTIC KOUTP_KeyNumSta_enum_minval "" VALUE 0x0000 /* @ECU_Address@KOUTP_KeyNumSta_enum_minval@ */ Scalar_UBYTE 0 SWC_OUTP_type_CM_uint8_enum 0.0 255.0 /end CHARACTERISTIC
/begin CHARACTERISTIC KOUTP_KeyNumSta_enum_ovrdval "" VALUE 0x0000 /* @ECU_Address@KOUTP_KeyNumSta_enum_ovrdval@ */ Scalar_UBYTE 0 SWC_OUTP_type_CM_uint8_enum 0.0 255.0 /end CHARACTERISTIC
/begin CHARACTERISTIC KOUTP_KeyTypeSta_enum_maxval "" VALUE 0x0000 /* @ECU_Address@KOUTP_KeyTypeSta_enum_maxval@ */ Scalar_UBYTE 0 SWC_OUTP_type_CM_uint8_enum 0.0 255.0 /end CHARACTERISTIC
/begin CHARACTERISTIC KOUTP_KeyTypeSta_enum_minval "" VALUE 0x0000 /* @ECU_Address@KOUTP_KeyTypeSta_enum_minval@ */ Scalar_UBYTE 0 SWC_OUTP_type_CM_uint8_enum 0.0 255.0 /end CHARACTERISTIC
/begin CHARACTERISTIC KOUTP_KeyTypeSta_enum_ovrdval "" VALUE 0x0000 /* @ECU_Address@KOUTP_KeyTypeSta_enum_ovrdval@ */ Scalar_UBYTE 0 SWC_OUTP_type_CM_uint8_enum 0.0 255.0 /end CHARACTERISTIC
/begin CHARACTERISTIC KOUTP_LVBattLowInd_enum_maxval "" VALUE 0x0000 /* @ECU_Address@KOUTP_LVBattLowInd_enum_maxval@ */ Scalar_UBYTE 0 SWC_OUTP_type_CM_uint8_enum 0.0 255.0 /end CHARACTERISTIC
/begin CHARACTERISTIC KOUTP_LVBattLowInd_enum_minval "" VALUE 0x0000 /* @ECU_Address@KOUTP_LVBattLowInd_enum_minval@ */ Scalar_UBYTE 0 SWC_OUTP_type_CM_uint8_enum 0.0 255.0 /end CHARACTERISTIC
/begin CHARACTERISTIC KOUTP_LVBattLowInd_enum_ovrdval "" VALUE 0x0000 /* @ECU_Address@KOUTP_LVBattLowInd_enum_ovrdval@ */ Scalar_UBYTE 0 SWC_OUTP_type_CM_uint8_enum 0.0 255.0 /end CHARACTERISTIC
/begin CHARACTERISTIC KOUTP_MCUHVLoopDem_enum_maxval "" VALUE 0x0000 /* @ECU_Address@KOUTP_MCUHVLoopDem_enum_maxval@ */ Scalar_UBYTE 0 SWC_OUTP_type_CM_uint8_enum 0.0 255.0 /end CHARACTERISTIC
/begin CHARACTERISTIC KOUTP_MCUHVLoopDem_enum_minval "" VALUE 0x0000 /* @ECU_Address@KOUTP_MCUHVLoopDem_enum_minval@ */ Scalar_UBYTE 0 SWC_OUTP_type_CM_uint8_enum 0.0 255.0 /end CHARACTERISTIC
/begin CHARACTERISTIC KOUTP_MCUHVLoopDem_enum_ovrdval "" VALUE 0x0000 /* @ECU_Address@KOUTP_MCUHVLoopDem_enum_ovrdval@ */ Scalar_UBYTE 0 SWC_OUTP_type_CM_uint8_enum 0.0 255.0 /end CHARACTERISTIC
/begin CHARACTERISTIC KOUTP_NodeID_enum_maxval "" VALUE 0x0000 /* @ECU_Address@KOUTP_NodeID_enum_maxval@ */ Scalar_UBYTE 0 SWC_OUTP_type_CM_uint8_enum 0.0 255.0 /end CHARACTERISTIC
/begin CHARACTERISTIC KOUTP_NodeID_enum_minval "" VALUE 0x0000 /* @ECU_Address@KOUTP_NodeID_enum_minval@ */ Scalar_UBYTE 0 SWC_OUTP_type_CM_uint8_enum 0.0 255.0 /end CHARACTERISTIC
/begin CHARACTERISTIC KOUTP_NodeID_enum_ovrdval "" VALUE 0x0000 /* @ECU_Address@KOUTP_NodeID_enum_ovrdval@ */ Scalar_UBYTE 0 SWC_OUTP_type_CM_uint8_enum 0.0 255.0 /end CHARACTERISTIC
/begin CHARACTERISTIC KOUTP_PCommandToBCM_enum_maxval "" VALUE 0x0000 /* @ECU_Address@KOUTP_PCommandToBCM_enum_maxval@ */ Scalar_UBYTE 0 SWC_OUTP_type_CM_uint8_enum 0.0 255.0 /end CHARACTERISTIC
/begin CHARACTERISTIC KOUTP_PCommandToBCM_enum_minval "" VALUE 0x0000 /* @ECU_Address@KOUTP_PCommandToBCM_enum_minval@ */ Scalar_UBYTE 0 SWC_OUTP_type_CM_uint8_enum 0.0 255.0 /end CHARACTERISTIC
/begin CHARACTERISTIC KOUTP_PCommandToBCM_enum_ovrdval "" VALUE 0x0000 /* @ECU_Address@KOUTP_PCommandToBCM_enum_ovrdval@ */ Scalar_UBYTE 0 SWC_OUTP_type_CM_uint8_enum 0.0 255.0 /end CHARACTERISTIC
/begin CHARACTERISTIC KOUTP_PROTOCOLID_enum_maxval "" VALUE 0x0000 /* @ECU_Address@KOUTP_PROTOCOLID_enum_maxval@ */ Scalar_UBYTE 0 SWC_OUTP_type_CM_uint8_enum 0.0 255.0 /end CHARACTERISTIC
/begin CHARACTERISTIC KOUTP_PROTOCOLID_enum_minval "" VALUE 0x0000 /* @ECU_Address@KOUTP_PROTOCOLID_enum_minval@ */ Scalar_UBYTE 0 SWC_OUTP_type_CM_uint8_enum 0.0 255.0 /end CHARACTERISTIC
/begin CHARACTERISTIC KOUTP_PROTOCOLID_enum_ovrdval "" VALUE 0x0000 /* @ECU_Address@KOUTP_PROTOCOLID_enum_ovrdval@ */ Scalar_UBYTE 0 SWC_OUTP_type_CM_uint8_enum 0.0 255.0 /end CHARACTERISTIC
/begin CHARACTERISTIC KOUTP_ParkingModeCmd_enum_maxval "" VALUE 0x0000 /* @ECU_Address@KOUTP_ParkingModeCmd_enum_maxval@ */ Scalar_UBYTE 0 SWC_OUTP_type_CM_uint8_enum 0.0 255.0 /end CHARACTERISTIC
/begin CHARACTERISTIC KOUTP_ParkingModeCmd_enum_minval "" VALUE 0x0000 /* @ECU_Address@KOUTP_ParkingModeCmd_enum_minval@ */ Scalar_UBYTE 0 SWC_OUTP_type_CM_uint8_enum 0.0 255.0 /end CHARACTERISTIC
/begin CHARACTERISTIC KOUTP_ParkingModeCmd_enum_ovrdval "" VALUE 0x0000 /* @ECU_Address@KOUTP_ParkingModeCmd_enum_ovrdval@ */ Scalar_UBYTE 0 SWC_OUTP_type_CM_uint8_enum 0.0 255.0 /end CHARACTERISTIC
/begin CHARACTERISTIC KOUTP_PowerDownFault_enum_maxval "" VALUE 0x0000 /* @ECU_Address@KOUTP_PowerDownFault_enum_maxval@ */ Scalar_UBYTE 0 SWC_OUTP_type_CM_uint8_enum 0.0 255.0 /end CHARACTERISTIC
/begin CHARACTERISTIC KOUTP_PowerDownFault_enum_minval "" VALUE 0x0000 /* @ECU_Address@KOUTP_PowerDownFault_enum_minval@ */ Scalar_UBYTE 0 SWC_OUTP_type_CM_uint8_enum 0.0 255.0 /end CHARACTERISTIC
/begin CHARACTERISTIC KOUTP_PowerDownFault_enum_ovrdval "" VALUE 0x0000 /* @ECU_Address@KOUTP_PowerDownFault_enum_ovrdval@ */ Scalar_UBYTE 0 SWC_OUTP_type_CM_uint8_enum 0.0 255.0 /end CHARACTERISTIC
/begin CHARACTERISTIC KOUTP_PowerDownState_enum_maxval "" VALUE 0x0000 /* @ECU_Address@KOUTP_PowerDownState_enum_maxval@ */ Scalar_UBYTE 0 SWC_OUTP_type_CM_uint8_enum 0.0 255.0 /end CHARACTERISTIC
/begin CHARACTERISTIC KOUTP_PowerDownState_enum_minval "" VALUE 0x0000 /* @ECU_Address@KOUTP_PowerDownState_enum_minval@ */ Scalar_UBYTE 0 SWC_OUTP_type_CM_uint8_enum 0.0 255.0 /end CHARACTERISTIC
/begin CHARACTERISTIC KOUTP_PowerDownState_enum_ovrdval "" VALUE 0x0000 /* @ECU_Address@KOUTP_PowerDownState_enum_ovrdval@ */ Scalar_UBYTE 0 SWC_OUTP_type_CM_uint8_enum 0.0 255.0 /end CHARACTERISTIC
/begin CHARACTERISTIC KOUTP_PowerUpFault_enum_maxval "" VALUE 0x0000 /* @ECU_Address@KOUTP_PowerUpFault_enum_maxval@ */ Scalar_UBYTE 0 SWC_OUTP_type_CM_uint8_enum 0.0 255.0 /end CHARACTERISTIC
/begin CHARACTERISTIC KOUTP_PowerUpFault_enum_minval "" VALUE 0x0000 /* @ECU_Address@KOUTP_PowerUpFault_enum_minval@ */ Scalar_UBYTE 0 SWC_OUTP_type_CM_uint8_enum 0.0 255.0 /end CHARACTERISTIC
/begin CHARACTERISTIC KOUTP_PowerUpFault_enum_ovrdval "" VALUE 0x0000 /* @ECU_Address@KOUTP_PowerUpFault_enum_ovrdval@ */ Scalar_UBYTE 0 SWC_OUTP_type_CM_uint8_enum 0.0 255.0 /end CHARACTERISTIC
/begin CHARACTERISTIC KOUTP_PowerUpState_enum_maxval "" VALUE 0x0000 /* @ECU_Address@KOUTP_PowerUpState_enum_maxval@ */ Scalar_UBYTE 0 SWC_OUTP_type_CM_uint8_enum 0.0 255.0 /end CHARACTERISTIC
/begin CHARACTERISTIC KOUTP_PowerUpState_enum_minval "" VALUE 0x0000 /* @ECU_Address@KOUTP_PowerUpState_enum_minval@ */ Scalar_UBYTE 0 SWC_OUTP_type_CM_uint8_enum 0.0 255.0 /end CHARACTERISTIC
/begin CHARACTERISTIC KOUTP_PowerUpState_enum_ovrdval "" VALUE 0x0000 /* @ECU_Address@KOUTP_PowerUpState_enum_ovrdval@ */ Scalar_UBYTE 0 SWC_OUTP_type_CM_uint8_enum 0.0 255.0 /end CHARACTERISTIC
/begin CHARACTERISTIC KOUTP_RESSCNTSDODRNGAXIS_enum_maxval "" VALUE 0x0000 /* @ECU_Address@KOUTP_RESSCNTSDODRNGAXIS_enum_maxval@ */ Scalar_UBYTE 0 SWC_OUTP_type_CM_uint8_enum 0.0 255.0 /end CHARACTERISTIC
/begin CHARACTERISTIC KOUTP_RESSCNTSDODRNGAXIS_enum_minval "" VALUE 0x0000 /* @ECU_Address@KOUTP_RESSCNTSDODRNGAXIS_enum_minval@ */ Scalar_UBYTE 0 SWC_OUTP_type_CM_uint8_enum 0.0 255.0 /end CHARACTERISTIC
/begin CHARACTERISTIC KOUTP_RESSCNTSDODRNGAXIS_enum_ovrdval "" VALUE 0x0000 /* @ECU_Address@KOUTP_RESSCNTSDODRNGAXIS_enum_ovrdval@ */ Scalar_UBYTE 0 SWC_OUTP_type_CM_uint8_enum 0.0 255.0 /end CHARACTERISTIC
/begin CHARACTERISTIC KOUTP_RESSTIMESOCRNGAXIS_enum_maxval "" VALUE 0x0000 /* @ECU_Address@KOUTP_RESSTIMESOCRNGAXIS_enum_maxval@ */ Scalar_UBYTE 0 SWC_OUTP_type_CM_uint8_enum 0.0 255.0 /end CHARACTERISTIC
/begin CHARACTERISTIC KOUTP_RESSTIMESOCRNGAXIS_enum_minval "" VALUE 0x0000 /* @ECU_Address@KOUTP_RESSTIMESOCRNGAXIS_enum_minval@ */ Scalar_UBYTE 0 SWC_OUTP_type_CM_uint8_enum 0.0 255.0 /end CHARACTERISTIC
/begin CHARACTERISTIC KOUTP_RESSTIMESOCRNGAXIS_enum_ovrdval "" VALUE 0x0000 /* @ECU_Address@KOUTP_RESSTIMESOCRNGAXIS_enum_ovrdval@ */ Scalar_UBYTE 0 SWC_OUTP_type_CM_uint8_enum 0.0 255.0 /end CHARACTERISTIC
/begin CHARACTERISTIC KOUTP_RESSTTEMPRNGAXIS_enum_maxval "" VALUE 0x0000 /* @ECU_Address@KOUTP_RESSTTEMPRNGAXIS_enum_maxval@ */ Scalar_UBYTE 0 SWC_OUTP_type_CM_uint8_enum 0.0 255.0 /end CHARACTERISTIC
/begin CHARACTERISTIC KOUTP_RESSTTEMPRNGAXIS_enum_minval "" VALUE 0x0000 /* @ECU_Address@KOUTP_RESSTTEMPRNGAXIS_enum_minval@ */ Scalar_UBYTE 0 SWC_OUTP_type_CM_uint8_enum 0.0 255.0 /end CHARACTERISTIC
/begin CHARACTERISTIC KOUTP_RESSTTEMPRNGAXIS_enum_ovrdval "" VALUE 0x0000 /* @ECU_Address@KOUTP_RESSTTEMPRNGAXIS_enum_ovrdval@ */ Scalar_UBYTE 0 SWC_OUTP_type_CM_uint8_enum 0.0 255.0 /end CHARACTERISTIC
/begin CHARACTERISTIC KOUTP_STASUP_enum_maxval "" VALUE 0x0000 /* @ECU_Address@KOUTP_STASUP_enum_maxval@ */ Scalar_UBYTE 0 SWC_OUTP_type_CM_uint8_enum 0.0 255.0 /end CHARACTERISTIC
/begin CHARACTERISTIC KOUTP_STASUP_enum_minval "" VALUE 0x0000 /* @ECU_Address@KOUTP_STASUP_enum_minval@ */ Scalar_UBYTE 0 SWC_OUTP_type_CM_uint8_enum 0.0 255.0 /end CHARACTERISTIC
/begin CHARACTERISTIC KOUTP_STASUP_enum_ovrdval "" VALUE 0x0000 /* @ECU_Address@KOUTP_STASUP_enum_ovrdval@ */ Scalar_UBYTE 0 SWC_OUTP_type_CM_uint8_enum 0.0 255.0 /end CHARACTERISTIC
/begin CHARACTERISTIC KOUTP_SysNMmSta_enum_maxval "" VALUE 0x0000 /* @ECU_Address@KOUTP_SysNMmSta_enum_maxval@ */ Scalar_UBYTE 0 SWC_OUTP_type_CM_uint8_enum 0.0 255.0 /end CHARACTERISTIC
/begin CHARACTERISTIC KOUTP_SysNMmSta_enum_minval "" VALUE 0x0000 /* @ECU_Address@KOUTP_SysNMmSta_enum_minval@ */ Scalar_UBYTE 0 SWC_OUTP_type_CM_uint8_enum 0.0 255.0 /end CHARACTERISTIC
/begin CHARACTERISTIC KOUTP_SysNMmSta_enum_ovrdval "" VALUE 0x0000 /* @ECU_Address@KOUTP_SysNMmSta_enum_ovrdval@ */ Scalar_UBYTE 0 SWC_OUTP_type_CM_uint8_enum 0.0 255.0 /end CHARACTERISTIC
/begin CHARACTERISTIC KOUTP_SysPowerMode_enum_maxval "" VALUE 0x0000 /* @ECU_Address@KOUTP_SysPowerMode_enum_maxval@ */ Scalar_UBYTE 0 SWC_OUTP_type_CM_uint8_enum 0.0 255.0 /end CHARACTERISTIC
/begin CHARACTERISTIC KOUTP_SysPowerMode_enum_minval "" VALUE 0x0000 /* @ECU_Address@KOUTP_SysPowerMode_enum_minval@ */ Scalar_UBYTE 0 SWC_OUTP_type_CM_uint8_enum 0.0 255.0 /end CHARACTERISTIC
/begin CHARACTERISTIC KOUTP_SysPowerMode_enum_ovrdval "" VALUE 0x0000 /* @ECU_Address@KOUTP_SysPowerMode_enum_ovrdval@ */ Scalar_UBYTE 0 SWC_OUTP_type_CM_uint8_enum 0.0 255.0 /end CHARACTERISTIC
/begin CHARACTERISTIC KOUTP_UIDLowPowerSta_enum_maxval "" VALUE 0x0000 /* @ECU_Address@KOUTP_UIDLowPowerSta_enum_maxval@ */ Scalar_UBYTE 0 SWC_OUTP_type_CM_uint8_enum 0.0 255.0 /end CHARACTERISTIC
/begin CHARACTERISTIC KOUTP_UIDLowPowerSta_enum_minval "" VALUE 0x0000 /* @ECU_Address@KOUTP_UIDLowPowerSta_enum_minval@ */ Scalar_UBYTE 0 SWC_OUTP_type_CM_uint8_enum 0.0 255.0 /end CHARACTERISTIC
/begin CHARACTERISTIC KOUTP_UIDLowPowerSta_enum_ovrdval "" VALUE 0x0000 /* @ECU_Address@KOUTP_UIDLowPowerSta_enum_ovrdval@ */ Scalar_UBYTE 0 SWC_OUTP_type_CM_uint8_enum 0.0 255.0 /end CHARACTERISTIC
/begin CHARACTERISTIC KOUTP_V2BACPosRlyFit_enum_maxval "" VALUE 0x0000 /* @ECU_Address@KOUTP_V2BACPosRlyFit_enum_maxval@ */ Scalar_UBYTE 0 SWC_OUTP_type_CM_uint8_enum 0.0 255.0 /end CHARACTERISTIC
/begin CHARACTERISTIC KOUTP_V2BACPosRlyFit_enum_minval "" VALUE 0x0000 /* @ECU_Address@KOUTP_V2BACPosRlyFit_enum_minval@ */ Scalar_UBYTE 0 SWC_OUTP_type_CM_uint8_enum 0.0 255.0 /end CHARACTERISTIC
/begin CHARACTERISTIC KOUTP_V2BACPosRlyFit_enum_ovrdval "" VALUE 0x0000 /* @ECU_Address@KOUTP_V2BACPosRlyFit_enum_ovrdval@ */ Scalar_UBYTE 0 SWC_OUTP_type_CM_uint8_enum 0.0 255.0 /end CHARACTERISTIC
/begin CHARACTERISTIC KOUTP_V2BACPosRlySta_enum_maxval "" VALUE 0x0000 /* @ECU_Address@KOUTP_V2BACPosRlySta_enum_maxval@ */ Scalar_UBYTE 0 SWC_OUTP_type_CM_uint8_enum 0.0 255.0 /end CHARACTERISTIC
/begin CHARACTERISTIC KOUTP_V2BACPosRlySta_enum_minval "" VALUE 0x0000 /* @ECU_Address@KOUTP_V2BACPosRlySta_enum_minval@ */ Scalar_UBYTE 0 SWC_OUTP_type_CM_uint8_enum 0.0 255.0 /end CHARACTERISTIC
/begin CHARACTERISTIC KOUTP_V2BACPosRlySta_enum_ovrdval "" VALUE 0x0000 /* @ECU_Address@KOUTP_V2BACPosRlySta_enum_ovrdval@ */ Scalar_UBYTE 0 SWC_OUTP_type_CM_uint8_enum 0.0 255.0 /end CHARACTERISTIC
/begin CHARACTERISTIC KOUTP_V2BAirPosRlyFit_enum_maxval "" VALUE 0x0000 /* @ECU_Address@KOUTP_V2BAirPosRlyFit_enum_maxval@ */ Scalar_UBYTE 0 SWC_OUTP_type_CM_uint8_enum 0.0 255.0 /end CHARACTERISTIC
/begin CHARACTERISTIC KOUTP_V2BAirPosRlyFit_enum_minval "" VALUE 0x0000 /* @ECU_Address@KOUTP_V2BAirPosRlyFit_enum_minval@ */ Scalar_UBYTE 0 SWC_OUTP_type_CM_uint8_enum 0.0 255.0 /end CHARACTERISTIC
/begin CHARACTERISTIC KOUTP_V2BAirPosRlyFit_enum_ovrdval "" VALUE 0x0000 /* @ECU_Address@KOUTP_V2BAirPosRlyFit_enum_ovrdval@ */ Scalar_UBYTE 0 SWC_OUTP_type_CM_uint8_enum 0.0 255.0 /end CHARACTERISTIC
/begin CHARACTERISTIC KOUTP_V2BAirPosRlySta_enum_maxval "" VALUE 0x0000 /* @ECU_Address@KOUTP_V2BAirPosRlySta_enum_maxval@ */ Scalar_UBYTE 0 SWC_OUTP_type_CM_uint8_enum 0.0 255.0 /end CHARACTERISTIC
/begin CHARACTERISTIC KOUTP_V2BAirPosRlySta_enum_minval "" VALUE 0x0000 /* @ECU_Address@KOUTP_V2BAirPosRlySta_enum_minval@ */ Scalar_UBYTE 0 SWC_OUTP_type_CM_uint8_enum 0.0 255.0 /end CHARACTERISTIC
/begin CHARACTERISTIC KOUTP_V2BAirPosRlySta_enum_ovrdval "" VALUE 0x0000 /* @ECU_Address@KOUTP_V2BAirPosRlySta_enum_ovrdval@ */ Scalar_UBYTE 0 SWC_OUTP_type_CM_uint8_enum 0.0 255.0 /end CHARACTERISTIC
/begin CHARACTERISTIC KOUTP_V2BAux1OnOff_enum_maxval "" VALUE 0x0000 /* @ECU_Address@KOUTP_V2BAux1OnOff_enum_maxval@ */ Scalar_UBYTE 0 SWC_OUTP_type_CM_uint8_enum 0.0 255.0 /end CHARACTERISTIC
/begin CHARACTERISTIC KOUTP_V2BAux1OnOff_enum_minval "" VALUE 0x0000 /* @ECU_Address@KOUTP_V2BAux1OnOff_enum_minval@ */ Scalar_UBYTE 0 SWC_OUTP_type_CM_uint8_enum 0.0 255.0 /end CHARACTERISTIC
/begin CHARACTERISTIC KOUTP_V2BAux1OnOff_enum_ovrdval "" VALUE 0x0000 /* @ECU_Address@KOUTP_V2BAux1OnOff_enum_ovrdval@ */ Scalar_UBYTE 0 SWC_OUTP_type_CM_uint8_enum 0.0 255.0 /end CHARACTERISTIC
/begin CHARACTERISTIC KOUTP_V2BAux1RlyFit_enum_maxval "" VALUE 0x0000 /* @ECU_Address@KOUTP_V2BAux1RlyFit_enum_maxval@ */ Scalar_UBYTE 0 SWC_OUTP_type_CM_uint8_enum 0.0 255.0 /end CHARACTERISTIC
/begin CHARACTERISTIC KOUTP_V2BAux1RlyFit_enum_minval "" VALUE 0x0000 /* @ECU_Address@KOUTP_V2BAux1RlyFit_enum_minval@ */ Scalar_UBYTE 0 SWC_OUTP_type_CM_uint8_enum 0.0 255.0 /end CHARACTERISTIC
/begin CHARACTERISTIC KOUTP_V2BAux1RlyFit_enum_ovrdval "" VALUE 0x0000 /* @ECU_Address@KOUTP_V2BAux1RlyFit_enum_ovrdval@ */ Scalar_UBYTE 0 SWC_OUTP_type_CM_uint8_enum 0.0 255.0 /end CHARACTERISTIC
/begin CHARACTERISTIC KOUTP_V2BAux1RlySta_enum_maxval "" VALUE 0x0000 /* @ECU_Address@KOUTP_V2BAux1RlySta_enum_maxval@ */ Scalar_UBYTE 0 SWC_OUTP_type_CM_uint8_enum 0.0 255.0 /end CHARACTERISTIC
/begin CHARACTERISTIC KOUTP_V2BAux1RlySta_enum_minval "" VALUE 0x0000 /* @ECU_Address@KOUTP_V2BAux1RlySta_enum_minval@ */ Scalar_UBYTE 0 SWC_OUTP_type_CM_uint8_enum 0.0 255.0 /end CHARACTERISTIC
/begin CHARACTERISTIC KOUTP_V2BAux1RlySta_enum_ovrdval "" VALUE 0x0000 /* @ECU_Address@KOUTP_V2BAux1RlySta_enum_ovrdval@ */ Scalar_UBYTE 0 SWC_OUTP_type_CM_uint8_enum 0.0 255.0 /end CHARACTERISTIC
/begin CHARACTERISTIC KOUTP_V2BAux2OnOff_enum_maxval "" VALUE 0x0000 /* @ECU_Address@KOUTP_V2BAux2OnOff_enum_maxval@ */ Scalar_UBYTE 0 SWC_OUTP_type_CM_uint8_enum 0.0 255.0 /end CHARACTERISTIC
/begin CHARACTERISTIC KOUTP_V2BAux2OnOff_enum_minval "" VALUE 0x0000 /* @ECU_Address@KOUTP_V2BAux2OnOff_enum_minval@ */ Scalar_UBYTE 0 SWC_OUTP_type_CM_uint8_enum 0.0 255.0 /end CHARACTERISTIC
/begin CHARACTERISTIC KOUTP_V2BAux2OnOff_enum_ovrdval "" VALUE 0x0000 /* @ECU_Address@KOUTP_V2BAux2OnOff_enum_ovrdval@ */ Scalar_UBYTE 0 SWC_OUTP_type_CM_uint8_enum 0.0 255.0 /end CHARACTERISTIC
/begin CHARACTERISTIC KOUTP_V2BAux2RlyFit_enum_maxval "" VALUE 0x0000 /* @ECU_Address@KOUTP_V2BAux2RlyFit_enum_maxval@ */ Scalar_UBYTE 0 SWC_OUTP_type_CM_uint8_enum 0.0 255.0 /end CHARACTERISTIC
/begin CHARACTERISTIC KOUTP_V2BAux2RlyFit_enum_minval "" VALUE 0x0000 /* @ECU_Address@KOUTP_V2BAux2RlyFit_enum_minval@ */ Scalar_UBYTE 0 SWC_OUTP_type_CM_uint8_enum 0.0 255.0 /end CHARACTERISTIC
/begin CHARACTERISTIC KOUTP_V2BAux2RlyFit_enum_ovrdval "" VALUE 0x0000 /* @ECU_Address@KOUTP_V2BAux2RlyFit_enum_ovrdval@ */ Scalar_UBYTE 0 SWC_OUTP_type_CM_uint8_enum 0.0 255.0 /end CHARACTERISTIC
/begin CHARACTERISTIC KOUTP_V2BAux2RlySta_enum_maxval "" VALUE 0x0000 /* @ECU_Address@KOUTP_V2BAux2RlySta_enum_maxval@ */ Scalar_UBYTE 0 SWC_OUTP_type_CM_uint8_enum 0.0 255.0 /end CHARACTERISTIC
/begin CHARACTERISTIC KOUTP_V2BAux2RlySta_enum_minval "" VALUE 0x0000 /* @ECU_Address@KOUTP_V2BAux2RlySta_enum_minval@ */ Scalar_UBYTE 0 SWC_OUTP_type_CM_uint8_enum 0.0 255.0 /end CHARACTERISTIC
/begin CHARACTERISTIC KOUTP_V2BAux2RlySta_enum_ovrdval "" VALUE 0x0000 /* @ECU_Address@KOUTP_V2BAux2RlySta_enum_ovrdval@ */ Scalar_UBYTE 0 SWC_OUTP_type_CM_uint8_enum 0.0 255.0 /end CHARACTERISTIC
/begin CHARACTERISTIC KOUTP_V2BAux3OnOff_enum_maxval "" VALUE 0x0000 /* @ECU_Address@KOUTP_V2BAux3OnOff_enum_maxval@ */ Scalar_UBYTE 0 SWC_OUTP_type_CM_uint8_enum 0.0 255.0 /end CHARACTERISTIC
/begin CHARACTERISTIC KOUTP_V2BAux3OnOff_enum_minval "" VALUE 0x0000 /* @ECU_Address@KOUTP_V2BAux3OnOff_enum_minval@ */ Scalar_UBYTE 0 SWC_OUTP_type_CM_uint8_enum 0.0 255.0 /end CHARACTERISTIC
/begin CHARACTERISTIC KOUTP_V2BAux3OnOff_enum_ovrdval "" VALUE 0x0000 /* @ECU_Address@KOUTP_V2BAux3OnOff_enum_ovrdval@ */ Scalar_UBYTE 0 SWC_OUTP_type_CM_uint8_enum 0.0 255.0 /end CHARACTERISTIC
/begin CHARACTERISTIC KOUTP_V2BAux3RlyFit_enum_maxval "" VALUE 0x0000 /* @ECU_Address@KOUTP_V2BAux3RlyFit_enum_maxval@ */ Scalar_UBYTE 0 SWC_OUTP_type_CM_uint8_enum 0.0 255.0 /end CHARACTERISTIC
/begin CHARACTERISTIC KOUTP_V2BAux3RlyFit_enum_minval "" VALUE 0x0000 /* @ECU_Address@KOUTP_V2BAux3RlyFit_enum_minval@ */ Scalar_UBYTE 0 SWC_OUTP_type_CM_uint8_enum 0.0 255.0 /end CHARACTERISTIC
/begin CHARACTERISTIC KOUTP_V2BAux3RlyFit_enum_ovrdval "" VALUE 0x0000 /* @ECU_Address@KOUTP_V2BAux3RlyFit_enum_ovrdval@ */ Scalar_UBYTE 0 SWC_OUTP_type_CM_uint8_enum 0.0 255.0 /end CHARACTERISTIC
/begin CHARACTERISTIC KOUTP_V2BAux3RlySta_enum_maxval "" VALUE 0x0000 /* @ECU_Address@KOUTP_V2BAux3RlySta_enum_maxval@ */ Scalar_UBYTE 0 SWC_OUTP_type_CM_uint8_enum 0.0 255.0 /end CHARACTERISTIC
/begin CHARACTERISTIC KOUTP_V2BAux3RlySta_enum_minval "" VALUE 0x0000 /* @ECU_Address@KOUTP_V2BAux3RlySta_enum_minval@ */ Scalar_UBYTE 0 SWC_OUTP_type_CM_uint8_enum 0.0 255.0 /end CHARACTERISTIC
/begin CHARACTERISTIC KOUTP_V2BAux3RlySta_enum_ovrdval "" VALUE 0x0000 /* @ECU_Address@KOUTP_V2BAux3RlySta_enum_ovrdval@ */ Scalar_UBYTE 0 SWC_OUTP_type_CM_uint8_enum 0.0 255.0 /end CHARACTERISTIC
/begin CHARACTERISTIC KOUTP_V2BAux4RlyFit_enum_maxval "" VALUE 0x0000 /* @ECU_Address@KOUTP_V2BAux4RlyFit_enum_maxval@ */ Scalar_UBYTE 0 SWC_OUTP_type_CM_uint8_enum 0.0 255.0 /end CHARACTERISTIC
/begin CHARACTERISTIC KOUTP_V2BAux4RlyFit_enum_minval "" VALUE 0x0000 /* @ECU_Address@KOUTP_V2BAux4RlyFit_enum_minval@ */ Scalar_UBYTE 0 SWC_OUTP_type_CM_uint8_enum 0.0 255.0 /end CHARACTERISTIC
/begin CHARACTERISTIC KOUTP_V2BAux4RlyFit_enum_ovrdval "" VALUE 0x0000 /* @ECU_Address@KOUTP_V2BAux4RlyFit_enum_ovrdval@ */ Scalar_UBYTE 0 SWC_OUTP_type_CM_uint8_enum 0.0 255.0 /end CHARACTERISTIC
/begin CHARACTERISTIC KOUTP_V2BAux4RlySta_enum_maxval "" VALUE 0x0000 /* @ECU_Address@KOUTP_V2BAux4RlySta_enum_maxval@ */ Scalar_UBYTE 0 SWC_OUTP_type_CM_uint8_enum 0.0 255.0 /end CHARACTERISTIC
/begin CHARACTERISTIC KOUTP_V2BAux4RlySta_enum_minval "" VALUE 0x0000 /* @ECU_Address@KOUTP_V2BAux4RlySta_enum_minval@ */ Scalar_UBYTE 0 SWC_OUTP_type_CM_uint8_enum 0.0 255.0 /end CHARACTERISTIC
/begin CHARACTERISTIC KOUTP_V2BAux4RlySta_enum_ovrdval "" VALUE 0x0000 /* @ECU_Address@KOUTP_V2BAux4RlySta_enum_ovrdval@ */ Scalar_UBYTE 0 SWC_OUTP_type_CM_uint8_enum 0.0 255.0 /end CHARACTERISTIC
/begin CHARACTERISTIC KOUTP_V2BDCDCPosRlyFit_enum_maxval "" VALUE 0x0000 /* @ECU_Address@KOUTP_V2BDCDCPosRlyFit_enum_maxval@ */ Scalar_UBYTE 0 SWC_OUTP_type_CM_uint8_enum 0.0 255.0 /end CHARACTERISTIC
/begin CHARACTERISTIC KOUTP_V2BDCDCPosRlyFit_enum_minval "" VALUE 0x0000 /* @ECU_Address@KOUTP_V2BDCDCPosRlyFit_enum_minval@ */ Scalar_UBYTE 0 SWC_OUTP_type_CM_uint8_enum 0.0 255.0 /end CHARACTERISTIC
/begin CHARACTERISTIC KOUTP_V2BDCDCPosRlyFit_enum_ovrdval "" VALUE 0x0000 /* @ECU_Address@KOUTP_V2BDCDCPosRlyFit_enum_ovrdval@ */ Scalar_UBYTE 0 SWC_OUTP_type_CM_uint8_enum 0.0 255.0 /end CHARACTERISTIC
/begin CHARACTERISTIC KOUTP_V2BDCDCPosRlySta_enum_maxval "" VALUE 0x0000 /* @ECU_Address@KOUTP_V2BDCDCPosRlySta_enum_maxval@ */ Scalar_UBYTE 0 SWC_OUTP_type_CM_uint8_enum 0.0 255.0 /end CHARACTERISTIC
/begin CHARACTERISTIC KOUTP_V2BDCDCPosRlySta_enum_minval "" VALUE 0x0000 /* @ECU_Address@KOUTP_V2BDCDCPosRlySta_enum_minval@ */ Scalar_UBYTE 0 SWC_OUTP_type_CM_uint8_enum 0.0 255.0 /end CHARACTERISTIC
/begin CHARACTERISTIC KOUTP_V2BDCDCPosRlySta_enum_ovrdval "" VALUE 0x0000 /* @ECU_Address@KOUTP_V2BDCDCPosRlySta_enum_ovrdval@ */ Scalar_UBYTE 0 SWC_OUTP_type_CM_uint8_enum 0.0 255.0 /end CHARACTERISTIC
/begin CHARACTERISTIC KOUTP_V2BLifeSig_cnt_maxval "" VALUE 0x0000 /* @ECU_Address@KOUTP_V2BLifeSig_cnt_maxval@ */ Scalar_UBYTE 0 SWC_OUTP_type_CM_uint8_enum 0.0 255.0 /end CHARACTERISTIC
/begin CHARACTERISTIC KOUTP_V2BLifeSig_cnt_minval "" VALUE 0x0000 /* @ECU_Address@KOUTP_V2BLifeSig_cnt_minval@ */ Scalar_UBYTE 0 SWC_OUTP_type_CM_uint8_enum 0.0 255.0 /end CHARACTERISTIC
/begin CHARACTERISTIC KOUTP_VinCode_cnt_maxval "" VALUE 0x0000 /* @ECU_Address@KOUTP_VinCode_cnt_maxval@ */ Scalar_UBYTE 0 SWC_OUTP_type_CM_uint8_cnt 0.0 255.0 /end CHARACTERISTIC
/begin CHARACTERISTIC KOUTP_VinCode_cnt_minval "" VALUE 0x0000 /* @ECU_Address@KOUTP_VinCode_cnt_minval@ */ Scalar_UBYTE 0 SWC_OUTP_type_CM_uint8_cnt 0.0 255.0 /end CHARACTERISTIC
/begin CHARACTERISTIC KOUTP_VinCode_cnt_ovrdval "" VALUE 0x0000 /* @ECU_Address@KOUTP_VinCode_cnt_ovrdval@ */ Scalar_UBYTE 0 SWC_OUTP_type_CM_uint8_enum 0.0 255.0 /end CHARACTERISTIC
/begin CHARACTERISTIC KOUTP_WARMUPS_cnt_maxval "" VALUE 0x0000 /* @ECU_Address@KOUTP_WARMUPS_cnt_maxval@ */ Scalar_UBYTE 0 SWC_OUTP_type_CM_uint8_cnt 0.0 255.0 /end CHARACTERISTIC
/begin CHARACTERISTIC KOUTP_WARMUPS_cnt_minval "" VALUE 0x0000 /* @ECU_Address@KOUTP_WARMUPS_cnt_minval@ */ Scalar_UBYTE 0 SWC_OUTP_type_CM_uint8_cnt 0.0 255.0 /end CHARACTERISTIC
/begin CHARACTERISTIC KOUTP_WARMUPS_cnt_ovrdval "" VALUE 0x0000 /* @ECU_Address@KOUTP_WARMUPS_cnt_ovrdval@ */ Scalar_UBYTE 0 SWC_OUTP_type_CM_uint8_enum 0.0 255.0 /end CHARACTERISTIC
/begin CHARACTERISTIC KOUTP_WakeUp_enum_maxval "" VALUE 0x0000 /* @ECU_Address@KOUTP_WakeUp_enum_maxval@ */ Scalar_UBYTE 0 SWC_OUTP_type_CM_uint8_enum 0.0 255.0 /end CHARACTERISTIC
/begin CHARACTERISTIC KOUTP_WakeUp_enum_minval "" VALUE 0x0000 /* @ECU_Address@KOUTP_WakeUp_enum_minval@ */ Scalar_UBYTE 0 SWC_OUTP_type_CM_uint8_enum 0.0 255.0 /end CHARACTERISTIC
/begin CHARACTERISTIC KOUTP_WakeUp_enum_ovrdval "" VALUE 0x0000 /* @ECU_Address@KOUTP_WakeUp_enum_ovrdval@ */ Scalar_UBYTE 0 SWC_OUTP_type_CM_uint8_enum 0.0 255.0 /end CHARACTERISTIC
/begin COMPU_METHOD SWC_OUTP_type_CM_single_kph "Q = V" RAT_FUNC "%8.6" "kph" COEFFS 0 1 0 0 0 1 /end COMPU_METHOD
/begin COMPU_METHOD SWC_OUTP_type_CM_single_C "Q = V" RAT_FUNC "%8.6" "C" COEFFS 0 1 0 0 0 1 /end COMPU_METHOD
/begin COMPU_METHOD SWC_OUTP_type_CM_single_km "Q = V" RAT_FUNC "%8.6" "km" COEFFS 0 1 0 0 0 1 /end COMPU_METHOD
/begin COMPU_METHOD SWC_OUTP_type_CM_single_A "Q = V" RAT_FUNC "%8.6" "A" COEFFS 0 1 0 0 0 1 /end COMPU_METHOD
/begin COMPU_METHOD SWC_OUTP_type_CM_single_V "Q = V" RAT_FUNC "%8.6" "V" COEFFS 0 1 0 0 0 1 /end COMPU_METHOD
/begin COMPU_METHOD SWC_OUTP_type_CM_single_kWh "Q = V" RAT_FUNC "%8.6" "kWh" COEFFS 0 1 0 0 0 1 /end COMPU_METHOD
/begin COMPU_METHOD SWC_OUTP_type_CM_single_Ahr "Q = V" RAT_FUNC "%8.6" "Ahr" COEFFS 0 1 0 0 0 1 /end COMPU_METHOD
/begin COMPU_METHOD SWC_OUTP_type_CM_single_kW "Q = V" RAT_FUNC "%8.6" "kW" COEFFS 0 1 0 0 0 1 /end COMPU_METHOD
/begin COMPU_METHOD SWC_OUTP_type_CM_single_Whps "Q = V" RAT_FUNC "%8.6" "Whps" COEFFS 0 1 0 0 0 1 /end COMPU_METHOD
/begin COMPU_METHOD SWC_OUTP_type_CM_single_kphsqr "Q = V" RAT_FUNC "%8.6" "kphsqr" COEFFS 0 1 0 0 0 1 /end COMPU_METHOD
/begin COMPU_METHOD SWC_OUTP_type_CM_uint32_sec "Q = V" RAT_FUNC "%10.0" "sec" COEFFS 0 1 0 0 0 1 /end COMPU_METHOD
/begin COMPU_METHOD SWC_OUTP_type_CM_uint32_cnt "Q = V" RAT_FUNC "%10.0" "cnt" COEFFS 0 1 0 0 0 1 /end COMPU_METHOD
/begin COMPU_METHOD SWC_OUTP_type_CM_uint32_s "Q = V" RAT_FUNC "%10.0" "s" COEFFS 0 1 0 0 0 1 /end COMPU_METHOD
/begin COMPU_METHOD SWC_OUTP_type_CM_uint16_min "Q = V" RAT_FUNC "%5.0" "min" COEFFS 0 1 0 0 0 1 /end COMPU_METHOD
/begin COMPU_METHOD SWC_OUTP_type_CM_uint16_cnt "Q = V" RAT_FUNC "%5.0" "cnt" COEFFS 0 1 0 0 0 1 /end COMPU_METHOD
/begin COMPU_METHOD SWC_OUTP_type_CM_uint16_sec "Q = V" RAT_FUNC "%5.0" "sec" COEFFS 0 1 0 0 0 1 /end COMPU_METHOD
/begin COMPU_METHOD SWC_OUTP_type_CM_uint16_s "Q = V" RAT_FUNC "%5.0" "s" COEFFS 0 1 0 0 0 1 /end COMPU_METHOD
/begin COMPU_METHOD SWC_OUTP_type_CM_boolean_flg "Q = V" RAT_FUNC "%1.0" "flg" COEFFS 0 1 0 0 0 1 /end COMPU_METHOD
/begin COMPU_METHOD SWC_OUTP_type_CM_uint8_enum "Q = V" RAT_FUNC "%3.0" "enum" COEFFS 0 1 0 0 0 1 /end COMPU_METHOD
/begin COMPU_METHOD SWC_OUTP_type_CM_uint8_cnt "Q = V" RAT_FUNC "%3.0" "cnt" COEFFS 0 1 0 0 0 1 /end COMPU_METHOD
/begin GROUP S447_Signal_Override "SWC_OUTP_type/run_SWC_OUTP_5ms_sys/OUTP/outpmodule/VDID_HVESSCHARGEACT_kW_Inproc/Signal_Override"
 /begin REF_CHARACTERISTIC KOUTP_HVESSCHARGEACT_kW_ovrdflg KOUTP_HVESSCHARGEACT_kW_ovrdval /end REF_CHARACTERISTIC
/end GROUP
/begin GROUP S448_Signal_Limit "SWC_OUTP_type/run_SWC_OUTP_5ms_sys/OUTP/outpmodule/VDID_HVESSCHARGELIM_kW_Inproc/Signal_Limit"
 /begin REF_CHARACTERISTIC KOUTP_HVESSCHARGELIM_kW_maxval KOUTP_HVESSCHARGELIM_kW_minval /end REF_CHARACTERISTIC
/end GROUP
/begin GROUP S448_Signal_Override "SWC_OUTP_type/run_SWC_OUTP_5ms_sys/OUTP/outpmodule/VDID_HVESSCHARGELIM_kW_Inproc/Signal_Override"
 /begin REF_CHARACTERISTIC KOUTP_HVESSCHARGELIM_kW_ovrdflg KOUTP_HVESSCHARGELIM_kW_ovrdval /end REF_CHARACTERISTIC
/end GROUP
/begin GROUP S449_Signal_Limit "SWC_OUTP_type/run_SWC_OUTP_5ms_sys/OUTP/outpmodule/VDID_HVESSENER_Whps_Inproc/Signal_Limit" /begin REF_CHARACTERISTIC KOUTP_HVESSENER_Whps_maxval KOUTP_HVESSENER_Whps_minval /end REF_CHARACTERISTIC /end GROUP
/begin GROUP S449_Signal_Override "SWC_OUTP_type/run_SWC_OUTP_5ms_sys/OUTP/outpmodule/VDID_HVESSENER_Whps_Inproc/Signal_Override" /begin REF_CHARACTERISTIC KOUTP_HVESSENER_Whps_ovrdflg KOUTP_HVESSENER_Whps_ovrdval /end REF_CHARACTERISTIC /end GROUP
/begin GROUP S450_Signal_Limit "SWC_OUTP_type/run_SWC_OUTP_5ms_sys/OUTP/outpmodule/VDID_IGNCNTR_cnt_Inproc/Signal_Limit" /begin REF_CHARACTERISTIC KOUTP_IGNCNTR_cnt_maxval KOUTP_IGNCNTR_cnt_minval /end REF_CHARACTERISTIC /end GROUP
/begin GROUP S450_Signal_Override "SWC_OUTP_type/run_SWC_OUTP_5ms_sys/OUTP/outpmodule/VDID_IGNCNTR_cnt_Inproc/Signal_Override" /begin REF_CHARACTERISTIC KOUTP_IGNCNTR_cnt_ovrdflg KOUTP_IGNCNTR_cnt_ovrdval /end REF_CHARACTERISTIC /end GROUP
/begin GROUP S451_Signal_Limit "SWC_OUTP_type/run_SWC_OUTP_5ms_sys/OUTP/outpmodule/VDID_IPSAL_sec_Inproc/Signal_Limit" /begin REF_CHARACTERISTIC KOUTP_IPSAL_sec_maxval KOUTP_IPSAL_sec_minval /end REF_CHARACTERISTIC /end GROUP
/begin GROUP S451_Signal_Override "SWC_OUTP_type/run_SWC_OUTP_5ms_sys/OUTP/outpmodule/VDID_IPSAL_sec_Inproc/Signal_Override" /begin REF_CHARACTERISTIC KOUTP_IPSAL_sec_ovrdflg KOUTP_IPSAL_sec_ovrdval /end REF_CHARACTERISTIC /end GROUP
/begin GROUP S452_Signal_Limit "SWC_OUTP_type/run_SWC_OUTP_5ms_sys/OUTP/outpmodule/VDID_IPSAR_sec_Inproc/Signal_Limit" /begin REF_CHARACTERISTIC KOUTP_IPSAR_sec_maxval KOUTP_IPSAR_sec_minval /end REF_CHARACTERISTIC /end GROUP
/begin GROUP S452_Signal_Override "SWC_OUTP_type/run_SWC_OUTP_5ms_sys/OUTP/outpmodule/VDID_IPSAR_sec_Inproc/Signal_Override" /begin REF_CHARACTERISTIC KOUTP_IPSAR_sec_ovrdflg KOUTP_IPSAR_sec_ovrdval /end REF_CHARACTERISTIC /end GROUP
/begin GROUP S453_Signal_Limit "SWC_OUTP_type/run_SWC_OUTP_5ms_sys/OUTP/outpmodule/VDID_MAXBATTEMPL_C_Inproc/Signal_Limit" /begin REF_CHARACTERISTIC KOUTP_MAXBATTEMPL_C_maxval KOUTP_MAXBATTEMPL_C_minval /end REF_CHARACTERISTIC /end GROUP
/begin GROUP S453_Signal_Override "SWC_OUTP_type/run_SWC_OUTP_5ms_sys/OUTP/outpmodule/VDID_MAXBATTEMPL_C_Inproc/Signal_Override" /begin REF_CHARACTERISTIC KOUTP_MAXBATTEMPL_C_ovrdflg KOUTP_MAXBATTEMPL_C_ovrdval /end REF_CHARACTERISTIC /end GROUP
/begin GROUP S454_Signal_Limit "SWC_OUTP_type/run_SWC_OUTP_5ms_sys/OUTP/outpmodule/VDID_MILDIST_km_Inproc/Signal_Limit" /begin REF_CHARACTERISTIC KOUTP_MILDIST_km_maxval KOUTP_MILDIST_km_minval /end REF_CHARACTERISTIC /end GROUP
/begin GROUP S454_Signal_Override "SWC_OUTP_type/run_SWC_OUTP_5ms_sys/OUTP/outpmodule/VDID_MILDIST_km_Inproc/Signal_Override" /begin REF_CHARACTERISTIC KOUTP_MILDIST_km_ovrdflg KOUTP_MILDIST_km_ovrdval /end REF_CHARACTERISTIC /end GROUP
/begin GROUP S455_Signal_Limit "SWC_OUTP_type/run_SWC_OUTP_5ms_sys/OUTP/outpmodule/VDID_MILTIME_min_Inproc/Signal_Limit" /begin REF_CHARACTERISTIC KOUTP_MILTIME_min_maxval KOUTP_MILTIME_min_minval /end REF_CHARACTERISTIC /end GROUP
/begin GROUP S455_Signal_Override "SWC_OUTP_type/run_SWC_OUTP_5ms_sys/OUTP/outpmodule/VDID_MILTIME_min_Inproc/Signal_Override" /begin REF_CHARACTERISTIC KOUTP_MILTIME_min_ovrdflg KOUTP_MILTIME_min_ovrdval /end REF_CHARACTERISTIC /end GROUP
/begin GROUP S456_Signal_Limit "SWC_OUTP_type/run_SWC_OUTP_5ms_sys/OUTP/outpmodule/VDID_MINBATTEMPL_C_Inproc/Signal_Limit" /begin REF_CHARACTERISTIC KOUTP_MINBATTEMPL_C_maxval KOUTP_MINBATTEMPL_C_minval /end REF_CHARACTERISTIC /end GROUP
/begin GROUP S456_Signal_Override "SWC_OUTP_type/run_SWC_OUTP_5ms_sys/OUTP/outpmodule/VDID_MINBATTEMPL_C_Inproc/Signal_Override" /begin REF_CHARACTERISTIC KOUTP_MINBATTEMPL_C_ovrdflg KOUTP_MINBATTEMPL_C_ovrdval /end REF_CHARACTERISTIC /end GROUP
/begin GROUP S457_Signal_Limit "SWC_OUTP_type/run_SWC_OUTP_5ms_sys/OUTP/outpmodule/VDID_NUMPSATRIPSFLTMEMCLR_cnt_Inproc/Signal_Limit"
 /begin REF_CHARACTERISTIC KOUTP_NUMPSATRIPSFLTMEMCLR_cnt_maxval KOUTP_NUMPSATRIPSFLTMEMCLR_cnt_minval /end REF_CHARACTERISTIC
/end GROUP
/begin GROUP S457_Signal_Override "SWC_OUTP_type/run_SWC_OUTP_5ms_sys/OUTP/outpmodule/VDID_NUMPSATRIPSFLTMEMCLR_cnt_Inproc/Signal_Override"
 /begin REF_CHARACTERISTIC KOUTP_NUMPSATRIPSFLTMEMCLR_cnt_ovrdflg KOUTP_NUMPSATRIPSFLTMEMCLR_cnt_ovrdval /end REF_CHARACTERISTIC
/end GROUP
/begin GROUP S458_Signal_Limit "SWC_OUTP_type/run_SWC_OUTP_5ms_sys/OUTP/outpmodule/VDID_ODOMETER_km_Inproc/Signal_Limit" /begin REF_CHARACTERISTIC KOUTP_ODOMETER_km_maxval KOUTP_ODOMETER_km_minval /end REF_CHARACTERISTIC /end GROUP
/begin GROUP S458_Signal_Override "SWC_OUTP_type/run_SWC_OUTP_5ms_sys/OUTP/outpmodule/VDID_ODOMETER_km_Inproc/Signal_Override" /begin REF_CHARACTERISTIC KOUTP_ODOMETER_km_ovrdflg KOUTP_ODOMETER_km_ovrdval /end REF_CHARACTERISTIC /end GROUP
/begin GROUP S459_Signal_Limit "SWC_OUTP_type/run_SWC_OUTP_5ms_sys/OUTP/outpmodule/VDID_OFFL_sec_Inproc/Signal_Limit" /begin REF_CHARACTERISTIC KOUTP_OFFL_sec_maxval KOUTP_OFFL_sec_minval /end REF_CHARACTERISTIC /end GROUP
/begin GROUP S459_Signal_Override "SWC_OUTP_type/run_SWC_OUTP_5ms_sys/OUTP/outpmodule/VDID_OFFL_sec_Inproc/Signal_Override" /begin REF_CHARACTERISTIC KOUTP_OFFL_sec_ovrdflg KOUTP_OFFL_sec_ovrdval /end REF_CHARACTERISTIC /end GROUP
/begin GROUP S460_Signal_Limit "SWC_OUTP_type/run_SWC_OUTP_5ms_sys/OUTP/outpmodule/VDID_OFFR_sec_Inproc/Signal_Limit" /begin REF_CHARACTERISTIC KOUTP_OFFR_sec_maxval KOUTP_OFFR_sec_minval /end REF_CHARACTERISTIC /end GROUP
/begin GROUP S460_Signal_Override "SWC_OUTP_type/run_SWC_OUTP_5ms_sys/OUTP/outpmodule/VDID_OFFR_sec_Inproc/Signal_Override" /begin REF_CHARACTERISTIC KOUTP_OFFR_sec_ovrdflg KOUTP_OFFR_sec_ovrdval /end REF_CHARACTERISTIC /end GROUP
/begin GROUP S461_Signal_Limit "SWC_OUTP_type/run_SWC_OUTP_5ms_sys/OUTP/outpmodule/VDID_OVCL_sec_Inproc/Signal_Limit" /begin REF_CHARACTERISTIC KOUTP_OVCL_sec_maxval KOUTP_OVCL_sec_minval /end REF_CHARACTERISTIC /end GROUP
/begin GROUP S461_Signal_Override "SWC_OUTP_type/run_SWC_OUTP_5ms_sys/OUTP/outpmodule/VDID_OVCL_sec_Inproc/Signal_Override" /begin REF_CHARACTERISTIC KOUTP_OVCL_sec_ovrdflg KOUTP_OVCL_sec_ovrdval /end REF_CHARACTERISTIC /end GROUP
/begin GROUP S462_Signal_Limit "SWC_OUTP_type/run_SWC_OUTP_5ms_sys/OUTP/outpmodule/VDID_OVCR_sec_Inproc/Signal_Limit" /begin REF_CHARACTERISTIC KOUTP_OVCR_sec_maxval KOUTP_OVCR_sec_minval /end REF_CHARACTERISTIC /end GROUP
/begin GROUP S462_Signal_Override "SWC_OUTP_type/run_SWC_OUTP_5ms_sys/OUTP/outpmodule/VDID_OVCR_sec_Inproc/Signal_Override" /begin REF_CHARACTERISTIC KOUTP_OVCR_sec_ovrdflg KOUTP_OVCR_sec_ovrdval /end REF_CHARACTERISTIC /end GROUP
/begin GROUP S463_Signal_Limit "SWC_OUTP_type/run_SWC_OUTP_5ms_sys/OUTP/outpmodule/VDID_PKELNumerator_kphsqr_Inproc/Signal_Limit"
 /begin REF_CHARACTERISTIC KOUTP_PKELNumerator_kphsqr_maxval KOUTP_PKELNumerator_kphsqr_minval /end REF_CHARACTERISTIC
/end GROUP
/begin GROUP S463_Signal_Override "SWC_OUTP_type/run_SWC_OUTP_5ms_sys/OUTP/outpmodule/VDID_PKELNumerator_kphsqr_Inproc/Signal_Override"
 /begin REF_CHARACTERISTIC KOUTP_PKELNumerator_kphsqr_ovrdflg KOUTP_PKELNumerator_kphsqr_ovrdval /end REF_CHARACTERISTIC
/end GROUP
/begin GROUP S464_Signal_Limit "SWC_OUTP_type/run_SWC_OUTP_5ms_sys/OUTP/outpmodule/VDID_PKEL_kphsqr_Inproc/Signal_Limit" /begin REF_CHARACTERISTIC KOUTP_PKEL_kphsqr_maxval KOUTP_PKEL_kphsqr_minval /end REF_CHARACTERISTIC /end GROUP
/begin GROUP S464_Signal_Override "SWC_OUTP_type/run_SWC_OUTP_5ms_sys/OUTP/outpmodule/VDID_PKEL_kphsqr_Inproc/Signal_Override" /begin REF_CHARACTERISTIC KOUTP_PKEL_kphsqr_ovrdflg KOUTP_PKEL_kphsqr_ovrdval /end REF_CHARACTERISTIC /end GROUP
/begin GROUP S465_Signal_Limit "SWC_OUTP_type/run_SWC_OUTP_5ms_sys/OUTP/outpmodule/VDID_PKERNumerator_kphsqr_Inproc/Signal_Limit"
 /begin REF_CHARACTERISTIC KOUTP_PKERNumerator_kphsqr_maxval KOUTP_PKERNumerator_kphsqr_minval /end REF_CHARACTERISTIC
/end GROUP
/begin GROUP S465_Signal_Override "SWC_OUTP_type/run_SWC_OUTP_5ms_sys/OUTP/outpmodule/VDID_PKERNumerator_kphsqr_Inproc/Signal_Override"
 /begin REF_CHARACTERISTIC KOUTP_PKERNumerator_kphsqr_ovrdflg KOUTP_PKERNumerator_kphsqr_ovrdval /end REF_CHARACTERISTIC
/end GROUP
/begin GROUP S466_Signal_Limit "SWC_OUTP_type/run_SWC_OUTP_5ms_sys/OUTP/outpmodule/VDID_PKER_kphsqr_Inproc/Signal_Limit" /begin REF_CHARACTERISTIC KOUTP_PKER_kphsqr_maxval KOUTP_PKER_kphsqr_minval /end REF_CHARACTERISTIC /end GROUP
/begin GROUP S466_Signal_Override "SWC_OUTP_type/run_SWC_OUTP_5ms_sys/OUTP/outpmodule/VDID_PKER_kphsqr_Inproc/Signal_Override" /begin REF_CHARACTERISTIC KOUTP_PKER_kphsqr_ovrdflg KOUTP_PKER_kphsqr_ovrdval /end REF_CHARACTERISTIC /end GROUP
/begin GROUP S467_Signal_Limit "SWC_OUTP_type/run_SWC_OUTP_5ms_sys/OUTP/outpmodule/VDID_PROTOCOLID_enum_Inproc/Signal_Limit" /begin REF_CHARACTERISTIC KOUTP_PROTOCOLID_enum_maxval KOUTP_PROTOCOLID_enum_minval /end REF_CHARACTERISTIC /end GROUP
/begin GROUP S467_Signal_Override "SWC_OUTP_type/run_SWC_OUTP_5ms_sys/OUTP/outpmodule/VDID_PROTOCOLID_enum_Inproc/Signal_Override"
 /begin REF_CHARACTERISTIC KOUTP_PROTOCOLID_enum_ovrdflg KOUTP_PROTOCOLID_enum_ovrdval /end REF_CHARACTERISTIC
/end GROUP
/begin GROUP S468_Signal_Limit "SWC_OUTP_type/run_SWC_OUTP_5ms_sys/OUTP/outpmodule/VDID_PSAL_sec_Inproc/Signal_Limit" /begin REF_CHARACTERISTIC KOUTP_PSAL_sec_maxval KOUTP_PSAL_sec_minval /end REF_CHARACTERISTIC /end GROUP
/begin GROUP S468_Signal_Override "SWC_OUTP_type/run_SWC_OUTP_5ms_sys/OUTP/outpmodule/VDID_PSAL_sec_Inproc/Signal_Override" /begin REF_CHARACTERISTIC KOUTP_PSAL_sec_ovrdflg KOUTP_PSAL_sec_ovrdval /end REF_CHARACTERISTIC /end GROUP
/begin GROUP S469_Signal_Limit "SWC_OUTP_type/run_SWC_OUTP_5ms_sys/OUTP/outpmodule/VDID_PSAR_sec_Inproc/Signal_Limit" /begin REF_CHARACTERISTIC KOUTP_PSAR_sec_maxval KOUTP_PSAR_sec_minval /end REF_CHARACTERISTIC /end GROUP
/begin GROUP S469_Signal_Override "SWC_OUTP_type/run_SWC_OUTP_5ms_sys/OUTP/outpmodule/VDID_PSAR_sec_Inproc/Signal_Override" /begin REF_CHARACTERISTIC KOUTP_PSAR_sec_ovrdflg KOUTP_PSAR_sec_ovrdval /end REF_CHARACTERISTIC /end GROUP
/begin GROUP S470_Signal_Limit "SWC_OUTP_type/run_SWC_OUTP_5ms_sys/OUTP/outpmodule/VDID_QTYPSATRIPSL_cnt_Inproc/Signal_Limit"
 /begin REF_CHARACTERISTIC KOUTP_QTYPSATRIPSL_cnt_maxval KOUTP_QTYPSATRIPSL_cnt_minval /end REF_CHARACTERISTIC
/end GROUP
/begin GROUP S470_Signal_Override "SWC_OUTP_type/run_SWC_OUTP_5ms_sys/OUTP/outpmodule/VDID_QTYPSATRIPSL_cnt_Inproc/Signal_Override"
 /begin REF_CHARACTERISTIC KOUTP_QTYPSATRIPSL_cnt_ovrdflg KOUTP_QTYPSATRIPSL_cnt_ovrdval /end REF_CHARACTERISTIC
/end GROUP
/begin GROUP S471_Signal_Limit "SWC_OUTP_type/run_SWC_OUTP_5ms_sys/OUTP/outpmodule/VDID_QTYPSATRIPSR_cnt_Inproc/Signal_Limit"
 /begin REF_CHARACTERISTIC KOUTP_QTYPSATRIPSR_cnt_maxval KOUTP_QTYPSATRIPSR_cnt_minval /end REF_CHARACTERISTIC
/end GROUP
/begin GROUP S471_Signal_Override "SWC_OUTP_type/run_SWC_OUTP_5ms_sys/OUTP/outpmodule/VDID_QTYPSATRIPSR_cnt_Inproc/Signal_Override"
 /begin REF_CHARACTERISTIC KOUTP_QTYPSATRIPSR_cnt_ovrdflg KOUTP_QTYPSATRIPSR_cnt_ovrdval /end REF_CHARACTERISTIC
/end GROUP
/begin GROUP S472_Signal_Limit "SWC_OUTP_type/run_SWC_OUTP_5ms_sys/OUTP/outpmodule/VDID_RESSCNTDODRNGL_cnt_Inproc/Signal_Limit"
 /begin REF_CHARACTERISTIC KOUTP_RESSCNTDODRNGL_cnt_maxval KOUTP_RESSCNTDODRNGL_cnt_minval /end REF_CHARACTERISTIC
/end GROUP
/begin GROUP S472_Signal_Override "SWC_OUTP_type/run_SWC_OUTP_5ms_sys/OUTP/outpmodule/VDID_RESSCNTDODRNGL_cnt_Inproc/Signal_Override"
 /begin REF_CHARACTERISTIC KOUTP_RESSCNTDODRNGL_cnt_ovrdflg KOUTP_RESSCNTDODRNGL_cnt_ovrdval /end REF_CHARACTERISTIC
/end GROUP
/begin GROUP S473_Signal_Limit "SWC_OUTP_type/run_SWC_OUTP_5ms_sys/OUTP/outpmodule/VDID_RESSCNTDODRNGR_cnt_Inproc/Signal_Limit"
 /begin REF_CHARACTERISTIC KOUTP_RESSCNTDODRNGR_cnt_maxval KOUTP_RESSCNTDODRNGR_cnt_minval /end REF_CHARACTERISTIC
/end GROUP
/begin GROUP S473_Signal_Override "SWC_OUTP_type/run_SWC_OUTP_5ms_sys/OUTP/outpmodule/VDID_RESSCNTDODRNGR_cnt_Inproc/Signal_Override"
 /begin REF_CHARACTERISTIC KOUTP_RESSCNTDODRNGR_cnt_ovrdflg KOUTP_RESSCNTDODRNGR_cnt_ovrdval /end REF_CHARACTERISTIC
/end GROUP
/begin GROUP S474_Signal_Limit "SWC_OUTP_type/run_SWC_OUTP_5ms_sys/OUTP/outpmodule/VDID_RESSCNTSDODRNGAXIS_enum_Inproc/Signal_Limit"
 /begin REF_CHARACTERISTIC KOUTP_RESSCNTSDODRNGAXIS_enum_maxval KOUTP_RESSCNTSDODRNGAXIS_enum_minval /end REF_CHARACTERISTIC
/end GROUP
/begin GROUP S474_Signal_Override "SWC_OUTP_type/run_SWC_OUTP_5ms_sys/OUTP/outpmodule/VDID_RESSCNTSDODRNGAXIS_enum_Inproc/Signal_Override"
 /begin REF_CHARACTERISTIC KOUTP_RESSCNTSDODRNGAXIS_enum_ovrdflg KOUTP_RESSCNTSDODRNGAXIS_enum_ovrdval /end REF_CHARACTERISTIC
/end GROUP
/begin GROUP S475_Signal_Limit "SWC_OUTP_type/run_SWC_OUTP_5ms_sys/OUTP/outpmodule/VDID_RESSTIMESOCCHGRNGL_s_Inproc/Signal_Limit"
 /begin REF_CHARACTERISTIC KOUTP_RESSTIMESOCCHGRNGL_s_maxval KOUTP_RESSTIMESOCCHGRNGL_s_minval /end REF_CHARACTERISTIC
/end GROUP
/begin GROUP S475_Signal_Override "SWC_OUTP_type/run_SWC_OUTP_5ms_sys/OUTP/outpmodule/VDID_RESSTIMESOCCHGRNGL_s_Inproc/Signal_Override"
 /begin REF_CHARACTERISTIC KOUTP_RESSTIMESOCCHGRNGL_s_ovrdflg KOUTP_RESSTIMESOCCHGRNGL_s_ovrdval /end REF_CHARACTERISTIC
/end GROUP
/begin GROUP S476_Signal_Limit "SWC_OUTP_type/run_SWC_OUTP_5ms_sys/OUTP/outpmodule/VDID_RESSTIMESOCCHGRNGR_s_Inproc/Signal_Limit"
 /begin REF_CHARACTERISTIC KOUTP_RESSTIMESOCCHGRNGR_s_maxval KOUTP_RESSTIMESOCCHGRNGR_s_minval /end REF_CHARACTERISTIC
/end GROUP
/begin GROUP S476_Signal_Override "SWC_OUTP_type/run_SWC_OUTP_5ms_sys/OUTP/outpmodule/VDID_RESSTIMESOCCHGRNGR_s_Inproc/Signal_Override"
 /begin REF_CHARACTERISTIC KOUTP_RESSTIMESOCCHGRNGR_s_ovrdflg KOUTP_RESSTIMESOCCHGRNGR_s_ovrdval /end REF_CHARACTERISTIC
/end GROUP
/begin GROUP S477_Signal_Limit "SWC_OUTP_type/run_SWC_OUTP_5ms_sys/OUTP/outpmodule/VDID_RESSTIMESOCOFFRNGL_s_Inproc/Signal_Limit"
 /begin REF_CHARACTERISTIC KOUTP_RESSTIMESOCOFFRNGL_s_maxval KOUTP_RESSTIMESOCOFFRNGL_s_minval /end REF_CHARACTERISTIC
/end GROUP
/begin GROUP S477_Signal_Override "SWC_OUTP_type/run_SWC_OUTP_5ms_sys/OUTP/outpmodule/VDID_RESSTIMESOCOFFRNGL_s_Inproc/Signal_Override"
 /begin REF_CHARACTERISTIC KOUTP_RESSTIMESOCOFFRNGL_s_ovrdflg KOUTP_RESSTIMESOCOFFRNGL_s_ovrdval /end REF_CHARACTERISTIC
/end GROUP
/begin GROUP S478_Signal_Limit "SWC_OUTP_type/run_SWC_OUTP_5ms_sys/OUTP/outpmodule/VDID_RESSTIMESOCOFFRNGR_s_Inproc/Signal_Limit"
 /begin REF_CHARACTERISTIC KOUTP_RESSTIMESOCOFFRNGR_s_maxval KOUTP_RESSTIMESOCOFFRNGR_s_minval /end REF_CHARACTERISTIC
/end GROUP
/begin GROUP S478_Signal_Override "SWC_OUTP_type/run_SWC_OUTP_5ms_sys/OUTP/outpmodule/VDID_RESSTIMESOCOFFRNGR_s_Inproc/Signal_Override"
 /begin REF_CHARACTERISTIC KOUTP_RESSTIMESOCOFFRNGR_s_ovrdflg KOUTP_RESSTIMESOCOFFRNGR_s_ovrdval /end REF_CHARACTERISTIC
/end GROUP
/begin GROUP S479_Signal_Limit "SWC_OUTP_type/run_SWC_OUTP_5ms_sys/OUTP/outpmodule/VDID_RESSTIMESOCPSARNGL_s_Inproc/Signal_Limit"
 /begin REF_CHARACTERISTIC KOUTP_RESSTIMESOCPSARNGL_s_maxval KOUTP_RESSTIMESOCPSARNGL_s_minval /end REF_CHARACTERISTIC
/end GROUP
/begin GROUP S479_Signal_Override "SWC_OUTP_type/run_SWC_OUTP_5ms_sys/OUTP/outpmodule/VDID_RESSTIMESOCPSARNGL_s_Inproc/Signal_Override"
 /begin REF_CHARACTERISTIC KOUTP_RESSTIMESOCPSARNGL_s_ovrdflg KOUTP_RESSTIMESOCPSARNGL_s_ovrdval /end REF_CHARACTERISTIC
/end GROUP
/begin GROUP S480_Signal_Limit "SWC_OUTP_type/run_SWC_OUTP_5ms_sys/OUTP/outpmodule/VDID_RESSTIMESOCPSARNGR_s_Inproc/Signal_Limit"
 /begin REF_CHARACTERISTIC KOUTP_RESSTIMESOCPSARNGR_s_maxval KOUTP_RESSTIMESOCPSARNGR_s_minval /end REF_CHARACTERISTIC
/end GROUP
/begin GROUP S480_Signal_Override "SWC_OUTP_type/run_SWC_OUTP_5ms_sys/OUTP/outpmodule/VDID_RESSTIMESOCPSARNGR_s_Inproc/Signal_Override"
 /begin REF_CHARACTERISTIC KOUTP_RESSTIMESOCPSARNGR_s_ovrdflg KOUTP_RESSTIMESOCPSARNGR_s_ovrdval /end REF_CHARACTERISTIC
/end GROUP
/begin GROUP S481_Signal_Limit "SWC_OUTP_type/run_SWC_OUTP_5ms_sys/OUTP/outpmodule/VDID_RESSTIMESOCRNGAXIS_enum_Inproc/Signal_Limit"
 /begin REF_CHARACTERISTIC KOUTP_RESSTIMESOCRNGAXIS_enum_maxval KOUTP_RESSTIMESOCRNGAXIS_enum_minval /end REF_CHARACTERISTIC
/end GROUP
/begin GROUP S481_Signal_Override "SWC_OUTP_type/run_SWC_OUTP_5ms_sys/OUTP/outpmodule/VDID_RESSTIMESOCRNGAXIS_enum_Inproc/Signal_Override"
 /begin REF_CHARACTERISTIC KOUTP_RESSTIMESOCRNGAXIS_enum_ovrdflg KOUTP_RESSTIMESOCRNGAXIS_enum_ovrdval /end REF_CHARACTERISTIC
/end GROUP
/begin GROUP S482_Signal_Limit "SWC_OUTP_type/run_SWC_OUTP_5ms_sys/OUTP/outpmodule/VDID_RESSTTEMPRNGAXIS_enum_Inproc/Signal_Limit"
 /begin REF_CHARACTERISTIC KOUTP_RESSTTEMPRNGAXIS_enum_maxval KOUTP_RESSTTEMPRNGAXIS_enum_minval /end REF_CHARACTERISTIC
/end GROUP
/begin GROUP S482_Signal_Override "SWC_OUTP_type/run_SWC_OUTP_5ms_sys/OUTP/outpmodule/VDID_RESSTTEMPRNGAXIS_enum_Inproc/Signal_Override"
 /begin REF_CHARACTERISTIC KOUTP_RESSTTEMPRNGAXIS_enum_ovrdflg KOUTP_RESSTTEMPRNGAXIS_enum_ovrdval /end REF_CHARACTERISTIC
/end GROUP
/begin GROUP S483_Signal_Limit "SWC_OUTP_type/run_SWC_OUTP_5ms_sys/OUTP/outpmodule/VDID_RESSV2XENNONPSAL_kWh_Inproc/Signal_Limit"
 /begin REF_CHARACTERISTIC KOUTP_RESSV2XENNONPSAL_kWh_maxval KOUTP_RESSV2XENNONPSAL_kWh_minval /end REF_CHARACTERISTIC
/end GROUP
/begin GROUP S483_Signal_Override "SWC_OUTP_type/run_SWC_OUTP_5ms_sys/OUTP/outpmodule/VDID_RESSV2XENNONPSAL_kWh_Inproc/Signal_Override"
 /begin REF_CHARACTERISTIC KOUTP_RESSV2XENNONPSAL_kWh_ovrdflg KOUTP_RESSV2XENNONPSAL_kWh_ovrdval /end REF_CHARACTERISTIC
/end GROUP
/begin GROUP S484_Signal_Limit "SWC_OUTP_type/run_SWC_OUTP_5ms_sys/OUTP/outpmodule/VDID_RESSV2XENNONPSAR_kWh_Inproc/Signal_Limit"
 /begin REF_CHARACTERISTIC KOUTP_RESSV2XENNONPSAR_kWh_maxval KOUTP_RESSV2XENNONPSAR_kWh_minval /end REF_CHARACTERISTIC
/end GROUP
/begin GROUP S484_Signal_Override "SWC_OUTP_type/run_SWC_OUTP_5ms_sys/OUTP/outpmodule/VDID_RESSV2XENNONPSAR_kWh_Inproc/Signal_Override"
 /begin REF_CHARACTERISTIC KOUTP_RESSV2XENNONPSAR_kWh_ovrdflg KOUTP_RESSV2XENNONPSAR_kWh_ovrdval /end REF_CHARACTERISTIC
/end GROUP
/begin GROUP S485_Signal_Limit "SWC_OUTP_type/run_SWC_OUTP_5ms_sys/OUTP/outpmodule/VDID_RUNTM_s_Inproc/Signal_Limit" /begin REF_CHARACTERISTIC KOUTP_RUNTM_s_maxval KOUTP_RUNTM_s_minval /end REF_CHARACTERISTIC /end GROUP
/begin GROUP S485_Signal_Override "SWC_OUTP_type/run_SWC_OUTP_5ms_sys/OUTP/outpmodule/VDID_RUNTM_s_Inproc/Signal_Override" /begin REF_CHARACTERISTIC KOUTP_RUNTM_s_ovrdflg KOUTP_RUNTM_s_ovrdval /end REF_CHARACTERISTIC /end GROUP
/begin GROUP S486_Signal_Limit "SWC_OUTP_type/run_SWC_OUTP_5ms_sys/OUTP/outpmodule/VDID_ResetCDEODTR_km_Inproc/Signal_Limit" /begin REF_CHARACTERISTIC KOUTP_ResetCDEODTR_km_maxval KOUTP_ResetCDEODTR_km_minval /end REF_CHARACTERISTIC /end GROUP
/begin GROUP S486_Signal_Override "SWC_OUTP_type/run_SWC_OUTP_5ms_sys/OUTP/outpmodule/VDID_ResetCDEODTR_km_Inproc/Signal_Override"
 /begin REF_CHARACTERISTIC KOUTP_ResetCDEODTR_km_ovrdflg KOUTP_ResetCDEODTR_km_ovrdval /end REF_CHARACTERISTIC
/end GROUP
/begin GROUP S487_Signal_Limit "SWC_OUTP_type/run_SWC_OUTP_5ms_sys/OUTP/outpmodule/VDID_STASUP_enum_Inproc/Signal_Limit" /begin REF_CHARACTERISTIC KOUTP_STASUP_enum_maxval KOUTP_STASUP_enum_minval /end REF_CHARACTERISTIC /end GROUP
/begin GROUP S487_Signal_Override "SWC_OUTP_type/run_SWC_OUTP_5ms_sys/OUTP/outpmodule/VDID_STASUP_enum_Inproc/Signal_Override" /begin REF_CHARACTERISTIC KOUTP_STASUP_enum_ovrdflg KOUTP_STASUP_enum_ovrdval /end REF_CHARACTERISTIC /end GROUP
/begin GROUP S488_Signal_Limit "SWC_OUTP_type/run_SWC_OUTP_5ms_sys/OUTP/outpmodule/VDID_TEBPSAL_kWh_Inproc/Signal_Limit" /begin REF_CHARACTERISTIC KOUTP_TEBPSAL_kWh_maxval KOUTP_TEBPSAL_kWh_minval /end REF_CHARACTERISTIC /end GROUP
/begin GROUP S488_Signal_Override "SWC_OUTP_type/run_SWC_OUTP_5ms_sys/OUTP/outpmodule/VDID_TEBPSAL_kWh_Inproc/Signal_Override" /begin REF_CHARACTERISTIC KOUTP_TEBPSAL_kWh_ovrdflg KOUTP_TEBPSAL_kWh_ovrdval /end REF_CHARACTERISTIC /end GROUP
/begin GROUP S489_Signal_Limit "SWC_OUTP_type/run_SWC_OUTP_5ms_sys/OUTP/outpmodule/VDID_TEBPSAR_kWh_Inproc/Signal_Limit" /begin REF_CHARACTERISTIC KOUTP_TEBPSAR_kWh_maxval KOUTP_TEBPSAR_kWh_minval /end REF_CHARACTERISTIC /end GROUP
/begin GROUP S489_Signal_Override "SWC_OUTP_type/run_SWC_OUTP_5ms_sys/OUTP/outpmodule/VDID_TEBPSAR_kWh_Inproc/Signal_Override" /begin REF_CHARACTERISTIC KOUTP_TEBPSAR_kWh_ovrdflg KOUTP_TEBPSAR_kWh_ovrdval /end REF_CHARACTERISTIC /end GROUP
/begin GROUP S490_Signal_Limit "SWC_OUTP_type/run_SWC_OUTP_5ms_sys/OUTP/outpmodule/VDID_TGEOVCL_kWh_Inproc/Signal_Limit" /begin REF_CHARACTERISTIC KOUTP_TGEOVCL_kWh_maxval KOUTP_TGEOVCL_kWh_minval /end REF_CHARACTERISTIC /end GROUP
/begin GROUP S490_Signal_Override "SWC_OUTP_type/run_SWC_OUTP_5ms_sys/OUTP/outpmodule/VDID_TGEOVCL_kWh_Inproc/Signal_Override" /begin REF_CHARACTERISTIC KOUTP_TGEOVCL_kWh_ovrdflg KOUTP_TGEOVCL_kWh_ovrdval /end REF_CHARACTERISTIC /end GROUP
/begin GROUP S491_Signal_Limit "SWC_OUTP_type/run_SWC_OUTP_5ms_sys/OUTP/outpmodule/VDID_TGEOVCR_kWh_Inproc/Signal_Limit" /begin REF_CHARACTERISTIC KOUTP_TGEOVCR_kWh_maxval KOUTP_TGEOVCR_kWh_minval /end REF_CHARACTERISTIC /end GROUP
/begin GROUP S491_Signal_Override "SWC_OUTP_type/run_SWC_OUTP_5ms_sys/OUTP/outpmodule/VDID_TGEOVCR_kWh_Inproc/Signal_Override" /begin REF_CHARACTERISTIC KOUTP_TGEOVCR_kWh_ovrdflg KOUTP_TGEOVCR_kWh_ovrdval /end REF_CHARACTERISTIC /end GROUP
/begin GROUP S492_Signal_Limit "SWC_OUTP_type/run_SWC_OUTP_5ms_sys/OUTP/outpmodule/VDID_TNBCPSAL_Ahr_Inproc/Signal_Limit" /begin REF_CHARACTERISTIC KOUTP_TNBCPSAL_Ahr_maxval KOUTP_TNBCPSAL_Ahr_minval /end REF_CHARACTERISTIC /end GROUP
/begin GROUP S492_Signal_Override "SWC_OUTP_type/run_SWC_OUTP_5ms_sys/OUTP/outpmodule/VDID_TNBCPSAL_Ahr_Inproc/Signal_Override" /begin REF_CHARACTERISTIC KOUTP_TNBCPSAL_Ahr_ovrdflg KOUTP_TNBCPSAL_Ahr_ovrdval /end REF_CHARACTERISTIC /end GROUP
/begin GROUP S493_Signal_Limit "SWC_OUTP_type/run_SWC_OUTP_5ms_sys/OUTP/outpmodule/VDID_TNBCPSAR_Ahr_Inproc/Signal_Limit" /begin REF_CHARACTERISTIC KOUTP_TNBCPSAR_Ahr_maxval KOUTP_TNBCPSAR_Ahr_minval /end REF_CHARACTERISTIC /end GROUP
/begin GROUP S493_Signal_Override "SWC_OUTP_type/run_SWC_OUTP_5ms_sys/OUTP/outpmodule/VDID_TNBCPSAR_Ahr_Inproc/Signal_Override" /begin REF_CHARACTERISTIC KOUTP_TNBCPSAR_Ahr_ovrdflg KOUTP_TNBCPSAR_Ahr_ovrdval /end REF_CHARACTERISTIC /end GROUP
/begin GROUP S494_Signal_Limit "SWC_OUTP_type/run_SWC_OUTP_5ms_sys/OUTP/outpmodule/VDID_TNECPSAL_kWh_Inproc/Signal_Limit" /begin REF_CHARACTERISTIC KOUTP_TNECPSAL_kWh_maxval KOUTP_TNECPSAL_kWh_minval /end REF_CHARACTERISTIC /end GROUP
/begin GROUP S494_Signal_Override "SWC_OUTP_type/run_SWC_OUTP_5ms_sys/OUTP/outpmodule/VDID_TNECPSAL_kWh_Inproc/Signal_Override" /begin REF_CHARACTERISTIC KOUTP_TNECPSAL_kWh_ovrdflg KOUTP_TNECPSAL_kWh_ovrdval /end REF_CHARACTERISTIC /end GROUP
/begin GROUP S495_Signal_Limit "SWC_OUTP_type/run_SWC_OUTP_5ms_sys/OUTP/outpmodule/VDID_TNECPSAR_kWh_Inproc/Signal_Limit" /begin REF_CHARACTERISTIC KOUTP_TNECPSAR_kWh_maxval KOUTP_TNECPSAR_kWh_minval /end REF_CHARACTERISTIC /end GROUP
/begin GROUP S495_Signal_Override "SWC_OUTP_type/run_SWC_OUTP_5ms_sys/OUTP/outpmodule/VDID_TNECPSAR_kWh_Inproc/Signal_Override" /begin REF_CHARACTERISTIC KOUTP_TNECPSAR_kWh_ovrdflg KOUTP_TNECPSAR_kWh_ovrdval /end REF_CHARACTERISTIC /end GROUP
/begin GROUP S496_Signal_Limit "SWC_OUTP_type/run_SWC_OUTP_5ms_sys/OUTP/outpmodule/VDID_VSS_kph_Inproc/Signal_Limit" /begin REF_CHARACTERISTIC KOUTP_VSS_kph_maxval KOUTP_VSS_kph_minval /end REF_CHARACTERISTIC /end GROUP
/begin GROUP S496_Signal_Override "SWC_OUTP_type/run_SWC_OUTP_5ms_sys/OUTP/outpmodule/VDID_VSS_kph_Inproc/Signal_Override" /begin REF_CHARACTERISTIC KOUTP_VSS_kph_ovrdflg KOUTP_VSS_kph_ovrdval /end REF_CHARACTERISTIC /end GROUP
/begin GROUP S497_Signal_Limit "SWC_OUTP_type/run_SWC_OUTP_5ms_sys/OUTP/outpmodule/VDID_VinCode_cnt_Inproc/Signal_Limit" /begin REF_CHARACTERISTIC KOUTP_VinCode_cnt_maxval KOUTP_VinCode_cnt_minval /end REF_CHARACTERISTIC /end GROUP
/begin GROUP S497_Signal_Override "SWC_OUTP_type/run_SWC_OUTP_5ms_sys/OUTP/outpmodule/VDID_VinCode_cnt_Inproc/Signal_Override" /begin REF_CHARACTERISTIC KOUTP_VinCode_cnt_ovrdflg KOUTP_VinCode_cnt_ovrdval /end REF_CHARACTERISTIC /end GROUP
/begin GROUP S498_Signal_Limit "SWC_OUTP_type/run_SWC_OUTP_5ms_sys/OUTP/outpmodule/VDID_WARMUPS_cnt_Inproc/Signal_Limit" /begin REF_CHARACTERISTIC KOUTP_WARMUPS_cnt_maxval KOUTP_WARMUPS_cnt_minval /end REF_CHARACTERISTIC /end GROUP
/begin GROUP S498_Signal_Override "SWC_OUTP_type/run_SWC_OUTP_5ms_sys/OUTP/outpmodule/VDID_WARMUPS_cnt_Inproc/Signal_Override" /begin REF_CHARACTERISTIC KOUTP_WARMUPS_cnt_ovrdflg KOUTP_WARMUPS_cnt_ovrdval /end REF_CHARACTERISTIC /end GROUP
/begin GROUP S499_Signal_Limit "SWC_OUTP_type/run_SWC_OUTP_5ms_sys/OUTP/outpmodule/VDKC_DKCAuthSta_enum_Inproc/Signal_Limit" /begin REF_CHARACTERISTIC KOUTP_DKCAuthSta_enum_maxval KOUTP_DKCAuthSta_enum_minval /end REF_CHARACTERISTIC /end GROUP
/begin GROUP S499_Signal_Override "SWC_OUTP_type/run_SWC_OUTP_5ms_sys/OUTP/outpmodule/VDKC_DKCAuthSta_enum_Inproc/Signal_Override"
 /begin REF_CHARACTERISTIC KOUTP_DKCAuthSta_enum_ovrdflg KOUTP_DKCAuthSta_enum_ovrdval /end REF_CHARACTERISTIC
/end GROUP
/begin GROUP S500_Signal_Limit "SWC_OUTP_type/run_SWC_OUTP_5ms_sys/OUTP/outpmodule/VDKC_DKCTimeSN_cnt_Inproc/Signal_Limit" /begin REF_CHARACTERISTIC KOUTP_DKCTimeSN_cnt_maxval KOUTP_DKCTimeSN_cnt_minval /end REF_CHARACTERISTIC /end GROUP
/begin GROUP S500_Signal_Override "SWC_OUTP_type/run_SWC_OUTP_5ms_sys/OUTP/outpmodule/VDKC_DKCTimeSN_cnt_Inproc/Signal_Override" /begin REF_CHARACTERISTIC KOUTP_DKCTimeSN_cnt_ovrdflg KOUTP_DKCTimeSN_cnt_ovrdval /end REF_CHARACTERISTIC /end GROUP
/begin GROUP S501_Signal_Limit "SWC_OUTP_type/run_SWC_OUTP_5ms_sys/OUTP/outpmodule/VDKC_DKeyWelcomeSta_enum_Inproc/Signal_Limit"
 /begin REF_CHARACTERISTIC KOUTP_DKeyWelcomeSta_enum_maxval KOUTP_DKeyWelcomeSta_enum_minval /end REF_CHARACTERISTIC
/end GROUP
/begin GROUP S501_Signal_Override "SWC_OUTP_type/run_SWC_OUTP_5ms_sys/OUTP/outpmodule/VDKC_DKeyWelcomeSta_enum_Inproc/Signal_Override"
 /begin REF_CHARACTERISTIC KOUTP_DKeyWelcomeSta_enum_ovrdflg KOUTP_DKeyWelcomeSta_enum_ovrdval /end REF_CHARACTERISTIC
/end GROUP
/begin GROUP S502_Signal_Limit "SWC_OUTP_type/run_SWC_OUTP_5ms_sys/OUTP/outpmodule/VDKC_DkeyAreaRAPSSta_enum_Inproc/Signal_Limit"
 /begin REF_CHARACTERISTIC KOUTP_DkeyAreaRAPSSta_enum_maxval KOUTP_DkeyAreaRAPSSta_enum_minval /end REF_CHARACTERISTIC
/end GROUP
/begin GROUP S502_Signal_Override "SWC_OUTP_type/run_SWC_OUTP_5ms_sys/OUTP/outpmodule/VDKC_DkeyAreaRAPSSta_enum_Inproc/Signal_Override"
 /begin REF_CHARACTERISTIC KOUTP_DkeyAreaRAPSSta_enum_ovrdflg KOUTP_DkeyAreaRAPSSta_enum_ovrdval /end REF_CHARACTERISTIC
/end GROUP
/begin GROUP S503_Signal_Limit "SWC_OUTP_type/run_SWC_OUTP_5ms_sys/OUTP/outpmodule/VDKC_DkeyShowIVISta_enum_Inproc/Signal_Limit"
 /begin REF_CHARACTERISTIC KOUTP_DkeyShowIVISta_enum_maxval KOUTP_DkeyShowIVISta_enum_minval /end REF_CHARACTERISTIC
/end GROUP
/begin GROUP S503_Signal_Override "SWC_OUTP_type/run_SWC_OUTP_5ms_sys/OUTP/outpmodule/VDKC_DkeyShowIVISta_enum_Inproc/Signal_Override"
 /begin REF_CHARACTERISTIC KOUTP_DkeyShowIVISta_enum_ovrdflg KOUTP_DkeyShowIVISta_enum_ovrdval /end REF_CHARACTERISTIC
/end GROUP
/begin GROUP S504_Signal_Limit "SWC_OUTP_type/run_SWC_OUTP_5ms_sys/OUTP/outpmodule/VDKC_FDCDKCAllowSleep_flg_Inproc/Signal_Limit"
 /begin REF_CHARACTERISTIC KOUTP_FDCDKCAllowSleep_flg_maxval KOUTP_FDCDKCAllowSleep_flg_minval /end REF_CHARACTERISTIC
/end GROUP
/begin GROUP S504_Signal_Override "SWC_OUTP_type/run_SWC_OUTP_5ms_sys/OUTP/outpmodule/VDKC_FDCDKCAllowSleep_flg_Inproc/Signal_Override"
 /begin REF_CHARACTERISTIC KOUTP_FDCDKCAllowSleep_flg_ovrdflg KOUTP_FDCDKCAllowSleep_flg_ovrdval /end REF_CHARACTERISTIC
/end GROUP
/begin GROUP S505_Signal_Limit "SWC_OUTP_type/run_SWC_OUTP_5ms_sys/OUTP/outpmodule/VDKC_JudgeKeepUnlockZone_flg_Inproc/Signal_Limit"
 /begin REF_CHARACTERISTIC KOUTP_JudgeKeepUnlockZone_flg_maxval KOUTP_JudgeKeepUnlockZone_flg_minval /end REF_CHARACTERISTIC
/end GROUP
/begin GROUP S505_Signal_Override "SWC_OUTP_type/run_SWC_OUTP_5ms_sys/OUTP/outpmodule/VDKC_JudgeKeepUnlockZone_flg_Inproc/Signal_Override"
 /begin REF_CHARACTERISTIC KOUTP_JudgeKeepUnlockZone_flg_ovrdflg KOUTP_JudgeKeepUnlockZone_flg_ovrdval /end REF_CHARACTERISTIC
/end GROUP
/begin GROUP S506_Signal_Limit "SWC_OUTP_type/run_SWC_OUTP_5ms_sys/OUTP/outpmodule/VDKC_KeyAreaLockUnlock_enum_Inproc/Signal_Limit"
 /begin REF_CHARACTERISTIC KOUTP_KeyAreaLockUnlock_enum_maxval KOUTP_KeyAreaLockUnlock_enum_minval /end REF_CHARACTERISTIC
/end GROUP
/begin GROUP S506_Signal_Override "SWC_OUTP_type/run_SWC_OUTP_5ms_sys/OUTP/outpmodule/VDKC_KeyAreaLockUnlock_enum_Inproc/Signal_Override"
 /begin REF_CHARACTERISTIC KOUTP_KeyAreaLockUnlock_enum_ovrdflg KOUTP_KeyAreaLockUnlock_enum_ovrdval /end REF_CHARACTERISTIC
/end GROUP
/begin GROUP S507_Signal_Limit "SWC_OUTP_type/run_SWC_OUTP_5ms_sys/OUTP/outpmodule/VDKC_KeyAreaPS_enum_Inproc/Signal_Limit" /begin REF_CHARACTERISTIC KOUTP_KeyAreaPS_enum_maxval KOUTP_KeyAreaPS_enum_minval /end REF_CHARACTERISTIC /end GROUP
/begin GROUP S507_Signal_Override "SWC_OUTP_type/run_SWC_OUTP_5ms_sys/OUTP/outpmodule/VDKC_KeyAreaPS_enum_Inproc/Signal_Override" /begin REF_CHARACTERISTIC KOUTP_KeyAreaPS_enum_ovrdflg KOUTP_KeyAreaPS_enum_ovrdval /end REF_CHARACTERISTIC /end GROUP
/begin GROUP S508_Signal_Limit "SWC_OUTP_type/run_SWC_OUTP_5ms_sys/OUTP/outpmodule/VDKC_KeyAreaPTG_enum_Inproc/Signal_Limit" /begin REF_CHARACTERISTIC KOUTP_KeyAreaPTG_enum_maxval KOUTP_KeyAreaPTG_enum_minval /end REF_CHARACTERISTIC /end GROUP
/begin GROUP S508_Signal_Override "SWC_OUTP_type/run_SWC_OUTP_5ms_sys/OUTP/outpmodule/VDKC_KeyAreaPTG_enum_Inproc/Signal_Override"
 /begin REF_CHARACTERISTIC KOUTP_KeyAreaPTG_enum_ovrdflg KOUTP_KeyAreaPTG_enum_ovrdval /end REF_CHARACTERISTIC
/end GROUP
/begin GROUP S509_Signal_Limit "SWC_OUTP_type/run_SWC_OUTP_5ms_sys/OUTP/outpmodule/VDKC_KeyAreaSPTGSta_enum_Inproc/Signal_Limit"
 /begin REF_CHARACTERISTIC KOUTP_KeyAreaSPTGSta_enum_maxval KOUTP_KeyAreaSPTGSta_enum_minval /end REF_CHARACTERISTIC
/end GROUP
/begin GROUP S509_Signal_Override "SWC_OUTP_type/run_SWC_OUTP_5ms_sys/OUTP/outpmodule/VDKC_KeyAreaSPTGSta_enum_Inproc/Signal_Override"
 /begin REF_CHARACTERISTIC KOUTP_KeyAreaSPTGSta_enum_ovrdflg KOUTP_KeyAreaSPTGSta_enum_ovrdval /end REF_CHARACTERISTIC
/end GROUP
/begin GROUP S510_Signal_Limit "SWC_OUTP_type/run_SWC_OUTP_5ms_sys/OUTP/outpmodule/VDKC_KeyMissSta_flg_Inproc/Signal_Limit" /begin REF_CHARACTERISTIC KOUTP_KeyMissSta_flg_maxval KOUTP_KeyMissSta_flg_minval /end REF_CHARACTERISTIC /end GROUP
/begin GROUP S510_Signal_Override "SWC_OUTP_type/run_SWC_OUTP_5ms_sys/OUTP/outpmodule/VDKC_KeyMissSta_flg_Inproc/Signal_Override" /begin REF_CHARACTERISTIC KOUTP_KeyMissSta_flg_ovrdflg KOUTP_KeyMissSta_flg_ovrdval /end REF_CHARACTERISTIC /end GROUP
/begin GROUP S511_Signal_Limit "SWC_OUTP_type/run_SWC_OUTP_5ms_sys/OUTP/outpmodule/VDKC_KeyModeSta_enum_Inproc/Signal_Limit" /begin REF_CHARACTERISTIC KOUTP_KeyModeSta_enum_maxval KOUTP_KeyModeSta_enum_minval /end REF_CHARACTERISTIC /end GROUP
/begin GROUP S511_Signal_Override "SWC_OUTP_type/run_SWC_OUTP_5ms_sys/OUTP/outpmodule/VDKC_KeyModeSta_enum_Inproc/Signal_Override"
 /begin REF_CHARACTERISTIC KOUTP_KeyModeSta_enum_ovrdflg KOUTP_KeyModeSta_enum_ovrdval /end REF_CHARACTERISTIC
/end GROUP
/begin GROUP S512_Signal_Limit "SWC_OUTP_type/run_SWC_OUTP_5ms_sys/OUTP/outpmodule/VDKC_KeyNumSta_enum_Inproc/Signal_Limit" /begin REF_CHARACTERISTIC KOUTP_KeyNumSta_enum_maxval KOUTP_KeyNumSta_enum_minval /end REF_CHARACTERISTIC /end GROUP
/begin GROUP S512_Signal_Override "SWC_OUTP_type/run_SWC_OUTP_5ms_sys/OUTP/outpmodule/VDKC_KeyNumSta_enum_Inproc/Signal_Override" /begin REF_CHARACTERISTIC KOUTP_KeyNumSta_enum_ovrdflg KOUTP_KeyNumSta_enum_ovrdval /end REF_CHARACTERISTIC /end GROUP
/begin GROUP S513_Signal_Limit "SWC_OUTP_type/run_SWC_OUTP_5ms_sys/OUTP/outpmodule/VDKC_KeyTypeSta_enum_Inproc/Signal_Limit" /begin REF_CHARACTERISTIC KOUTP_KeyTypeSta_enum_maxval KOUTP_KeyTypeSta_enum_minval /end REF_CHARACTERISTIC /end GROUP
/begin GROUP S513_Signal_Override "SWC_OUTP_type/run_SWC_OUTP_5ms_sys/OUTP/outpmodule/VDKC_KeyTypeSta_enum_Inproc/Signal_Override"
 /begin REF_CHARACTERISTIC KOUTP_KeyTypeSta_enum_ovrdflg KOUTP_KeyTypeSta_enum_ovrdval /end REF_CHARACTERISTIC
/end GROUP
/begin GROUP S514_Signal_Limit "SWC_OUTP_type/run_SWC_OUTP_5ms_sys/OUTP/outpmodule/VDKC_PCommandToBCM_enum_Inproc/Signal_Limit"
 /begin REF_CHARACTERISTIC KOUTP_PCommandToBCM_enum_maxval KOUTP_PCommandToBCM_enum_minval /end REF_CHARACTERISTIC
/end GROUP
/begin GROUP S514_Signal_Override "SWC_OUTP_type/run_SWC_OUTP_5ms_sys/OUTP/outpmodule/VDKC_PCommandToBCM_enum_Inproc/Signal_Override"
 /begin REF_CHARACTERISTIC KOUTP_PCommandToBCM_enum_ovrdflg KOUTP_PCommandToBCM_enum_ovrdval /end REF_CHARACTERISTIC
/end GROUP
/begin GROUP S515_Signal_Limit "SWC_OUTP_type/run_SWC_OUTP_5ms_sys/OUTP/outpmodule/VDKC_ParkingModeCmd_enum_Inproc/Signal_Limit"
 /begin REF_CHARACTERISTIC KOUTP_ParkingModeCmd_enum_maxval KOUTP_ParkingModeCmd_enum_minval /end REF_CHARACTERISTIC
/end GROUP
/begin GROUP S515_Signal_Override "SWC_OUTP_type/run_SWC_OUTP_5ms_sys/OUTP/outpmodule/VDKC_ParkingModeCmd_enum_Inproc/Signal_Override"
 /begin REF_CHARACTERISTIC KOUTP_ParkingModeCmd_enum_ovrdflg KOUTP_ParkingModeCmd_enum_ovrdval /end REF_CHARACTERISTIC
/end GROUP
/begin GROUP S516_Signal_Limit "SWC_OUTP_type/run_SWC_OUTP_5ms_sys/OUTP/outpmodule/VDKC_TimeSNDKCFbk_cnt_Inproc/Signal_Limit"
 /begin REF_CHARACTERISTIC KOUTP_TimeSNDKCFbk_cnt_maxval KOUTP_TimeSNDKCFbk_cnt_minval /end REF_CHARACTERISTIC
/end GROUP
/begin GROUP S516_Signal_Override "SWC_OUTP_type/run_SWC_OUTP_5ms_sys/OUTP/outpmodule/VDKC_TimeSNDKCFbk_cnt_Inproc/Signal_Override"
 /begin REF_CHARACTERISTIC KOUTP_TimeSNDKCFbk_cnt_ovrdflg KOUTP_TimeSNDKCFbk_cnt_ovrdval /end REF_CHARACTERISTIC
/end GROUP
/begin GROUP S517_Signal_Limit "SWC_OUTP_type/run_SWC_OUTP_5ms_sys/OUTP/outpmodule/VDKC_UIDLowPowerSta_enum_Inproc/Signal_Limit"
 /begin REF_CHARACTERISTIC KOUTP_UIDLowPowerSta_enum_maxval KOUTP_UIDLowPowerSta_enum_minval /end REF_CHARACTERISTIC
/end GROUP
/begin GROUP S517_Signal_Override "SWC_OUTP_type/run_SWC_OUTP_5ms_sys/OUTP/outpmodule/VDKC_UIDLowPowerSta_enum_Inproc/Signal_Override"
 /begin REF_CHARACTERISTIC KOUTP_UIDLowPowerSta_enum_ovrdflg KOUTP_UIDLowPowerSta_enum_ovrdval /end REF_CHARACTERISTIC
/end GROUP
/begin GROUP S518_Signal_Limit "SWC_OUTP_type/run_SWC_OUTP_5ms_sys/OUTP/outpmodule/VDSC_DISCButtSta_flg_Inproc/Signal_Limit" /begin REF_CHARACTERISTIC KOUTP_DISCButtSta_flg_maxval KOUTP_DISCButtSta_flg_minval /end REF_CHARACTERISTIC /end GROUP
/begin GROUP S518_Signal_Override "SWC_OUTP_type/run_SWC_OUTP_5ms_sys/OUTP/outpmodule/VDSC_DISCButtSta_flg_Inproc/Signal_Override"
 /begin REF_CHARACTERISTIC KOUTP_DISCButtSta_flg_ovrdflg KOUTP_DISCButtSta_flg_ovrdval /end REF_CHARACTERISTIC
/end GROUP
/begin GROUP S519_Signal_Limit "SWC_OUTP_type/run_SWC_OUTP_5ms_sys/OUTP/outpmodule/VDSC_DISCSta_enum_Inproc/Signal_Limit" /begin REF_CHARACTERISTIC KOUTP_DISCSta_enum_maxval KOUTP_DISCSta_enum_minval /end REF_CHARACTERISTIC /end GROUP
/begin GROUP S519_Signal_Override "SWC_OUTP_type/run_SWC_OUTP_5ms_sys/OUTP/outpmodule/VDSC_DISCSta_enum_Inproc/Signal_Override" /begin REF_CHARACTERISTIC KOUTP_DISCSta_enum_ovrdflg KOUTP_DISCSta_enum_ovrdval /end REF_CHARACTERISTIC /end GROUP
/begin GROUP S520_Signal_Limit "SWC_OUTP_type/run_SWC_OUTP_5ms_sys/OUTP/outpmodule/VDSC_DISCTargetSpd_kph_Inproc/Signal_Limit"
 /begin REF_CHARACTERISTIC KOUTP_DISCTargetSpd_kph_maxval KOUTP_DISCTargetSpd_kph_minval /end REF_CHARACTERISTIC
/end GROUP
/begin GROUP S520_Signal_Override "SWC_OUTP_type/run_SWC_OUTP_5ms_sys/OUTP/outpmodule/VDSC_DISCTargetSpd_kph_Inproc/Signal_Override"
 /begin REF_CHARACTERISTIC KOUTP_DISCTargetSpd_kph_ovrdflg KOUTP_DISCTargetSpd_kph_ovrdval /end REF_CHARACTERISTIC
/end GROUP
/begin GROUP S521_Signal_Limit "SWC_OUTP_type/run_SWC_OUTP_5ms_sys/OUTP/outpmodule/VDSC_DISCTurn_flg_Inproc/Signal_Limit" /begin REF_CHARACTERISTIC KOUTP_DISCTurn_flg_maxval KOUTP_DISCTurn_flg_minval /end REF_CHARACTERISTIC /end GROUP
/begin GROUP S521_Signal_Override "SWC_OUTP_type/run_SWC_OUTP_5ms_sys/OUTP/outpmodule/VDSC_DISCTurn_flg_Inproc/Signal_Override" /begin REF_CHARACTERISTIC KOUTP_DISCTurn_flg_ovrdflg KOUTP_DISCTurn_flg_ovrdval /end REF_CHARACTERISTIC /end GROUP
/begin GROUP S522_Signal_Limit "SWC_OUTP_type/run_SWC_OUTP_5ms_sys/OUTP/outpmodule/VNMM_ActiveWU_flg_Inproc/Signal_Limit" /begin REF_CHARACTERISTIC KOUTP_ActiveWU_flg_maxval KOUTP_ActiveWU_flg_minval /end REF_CHARACTERISTIC /end GROUP
/begin GROUP S522_Signal_Override "SWC_OUTP_type/run_SWC_OUTP_5ms_sys/OUTP/outpmodule/VNMM_ActiveWU_flg_Inproc/Signal_Override" /begin REF_CHARACTERISTIC KOUTP_ActiveWU_flg_ovrdflg KOUTP_ActiveWU_flg_ovrdval /end REF_CHARACTERISTIC /end GROUP
/begin GROUP S523_Signal_Limit "SWC_OUTP_type/run_SWC_OUTP_5ms_sys/OUTP/outpmodule/VNMM_AllCANTxReq_flg_Inproc/Signal_Limit" /begin REF_CHARACTERISTIC KOUTP_AllCANTxReq_flg_maxval KOUTP_AllCANTxReq_flg_minval /end REF_CHARACTERISTIC /end GROUP
/begin GROUP S523_Signal_Override "SWC_OUTP_type/run_SWC_OUTP_5ms_sys/OUTP/outpmodule/VNMM_AllCANTxReq_flg_Inproc/Signal_Override"
 /begin REF_CHARACTERISTIC KOUTP_AllCANTxReq_flg_ovrdflg KOUTP_AllCANTxReq_flg_ovrdval /end REF_CHARACTERISTIC
/end GROUP
/begin GROUP S524_Signal_Limit "SWC_OUTP_type/run_SWC_OUTP_5ms_sys/OUTP/outpmodule/VNMM_Awake_enum_Inproc/Signal_Limit" /begin REF_CHARACTERISTIC KOUTP_Awake_enum_maxval KOUTP_Awake_enum_minval /end REF_CHARACTERISTIC /end GROUP
/begin GROUP S524_Signal_Override "SWC_OUTP_type/run_SWC_OUTP_5ms_sys/OUTP/outpmodule/VNMM_Awake_enum_Inproc/Signal_Override" /begin REF_CHARACTERISTIC KOUTP_Awake_enum_ovrdflg KOUTP_Awake_enum_ovrdval /end REF_CHARACTERISTIC /end GROUP
/begin GROUP S525_Signal_Limit "SWC_OUTP_type/run_SWC_OUTP_5ms_sys/OUTP/outpmodule/VNMM_CSB_flg_Inproc/Signal_Limit" /begin REF_CHARACTERISTIC KOUTP_CSB_flg_maxval KOUTP_CSB_flg_minval /end REF_CHARACTERISTIC /end GROUP
/begin GROUP S525_Signal_Override "SWC_OUTP_type/run_SWC_OUTP_5ms_sys/OUTP/outpmodule/VNMM_CSB_flg_Inproc/Signal_Override" /begin REF_CHARACTERISTIC KOUTP_CSB_flg_ovrdflg KOUTP_CSB_flg_ovrdval /end REF_CHARACTERISTIC /end GROUP
/begin GROUP S526_Signal_Limit "SWC_OUTP_type/run_SWC_OUTP_5ms_sys/OUTP/outpmodule/VNMM_ErrorState_enum_Inproc/Signal_Limit" /begin REF_CHARACTERISTIC KOUTP_ErrorState_enum_maxval KOUTP_ErrorState_enum_minval /end REF_CHARACTERISTIC /end GROUP
/begin GROUP S526_Signal_Override "SWC_OUTP_type/run_SWC_OUTP_5ms_sys/OUTP/outpmodule/VNMM_ErrorState_enum_Inproc/Signal_Override"
 /begin REF_CHARACTERISTIC KOUTP_ErrorState_enum_ovrdflg KOUTP_ErrorState_enum_ovrdval /end REF_CHARACTERISTIC
/end GROUP
/begin GROUP S527_Signal_Limit "SWC_OUTP_type/run_SWC_OUTP_5ms_sys/OUTP/outpmodule/VNMM_NMmTxReq_flg_Inproc/Signal_Limit" /begin REF_CHARACTERISTIC KOUTP_NMmTxReq_flg_maxval KOUTP_NMmTxReq_flg_minval /end REF_CHARACTERISTIC /end GROUP
/begin GROUP S527_Signal_Override "SWC_OUTP_type/run_SWC_OUTP_5ms_sys/OUTP/outpmodule/VNMM_NMmTxReq_flg_Inproc/Signal_Override" /begin REF_CHARACTERISTIC KOUTP_NMmTxReq_flg_ovrdflg KOUTP_NMmTxReq_flg_ovrdval /end REF_CHARACTERISTIC /end GROUP
/begin GROUP S528_Signal_Limit "SWC_OUTP_type/run_SWC_OUTP_5ms_sys/OUTP/outpmodule/VNMM_NetworkReq_flg_Inproc/Signal_Limit" /begin REF_CHARACTERISTIC KOUTP_NetworkReq_flg_maxval KOUTP_NetworkReq_flg_minval /end REF_CHARACTERISTIC /end GROUP
/begin GROUP S528_Signal_Override "SWC_OUTP_type/run_SWC_OUTP_5ms_sys/OUTP/outpmodule/VNMM_NetworkReq_flg_Inproc/Signal_Override" /begin REF_CHARACTERISTIC KOUTP_NetworkReq_flg_ovrdflg KOUTP_NetworkReq_flg_ovrdval /end REF_CHARACTERISTIC /end GROUP
/begin GROUP S529_Signal_Limit "SWC_OUTP_type/run_SWC_OUTP_5ms_sys/OUTP/outpmodule/VNMM_NodeID_enum_Inproc/Signal_Limit" /begin REF_CHARACTERISTIC KOUTP_NodeID_enum_maxval KOUTP_NodeID_enum_minval /end REF_CHARACTERISTIC /end GROUP
/begin GROUP S529_Signal_Override "SWC_OUTP_type/run_SWC_OUTP_5ms_sys/OUTP/outpmodule/VNMM_NodeID_enum_Inproc/Signal_Override" /begin REF_CHARACTERISTIC KOUTP_NodeID_enum_ovrdflg KOUTP_NodeID_enum_ovrdval /end REF_CHARACTERISTIC /end GROUP
/begin GROUP S530_Signal_Limit "SWC_OUTP_type/run_SWC_OUTP_5ms_sys/OUTP/outpmodule/VNMM_PNI_flg_Inproc/Signal_Limit" /begin REF_CHARACTERISTIC KOUTP_PNI_flg_maxval KOUTP_PNI_flg_minval /end REF_CHARACTERISTIC /end GROUP
/begin GROUP S530_Signal_Override "SWC_OUTP_type/run_SWC_OUTP_5ms_sys/OUTP/outpmodule/VNMM_PNI_flg_Inproc/Signal_Override" /begin REF_CHARACTERISTIC KOUTP_PNI_flg_ovrdflg KOUTP_PNI_flg_ovrdval /end REF_CHARACTERISTIC /end GROUP
/begin GROUP S531_Signal_Limit "SWC_OUTP_type/run_SWC_OUTP_5ms_sys/OUTP/outpmodule/VNMM_RptMsgReq_flg_Inproc/Signal_Limit" /begin REF_CHARACTERISTIC KOUTP_RptMsgReq_flg_maxval KOUTP_RptMsgReq_flg_minval /end REF_CHARACTERISTIC /end GROUP
/begin GROUP S531_Signal_Override "SWC_OUTP_type/run_SWC_OUTP_5ms_sys/OUTP/outpmodule/VNMM_RptMsgReq_flg_Inproc/Signal_Override" /begin REF_CHARACTERISTIC KOUTP_RptMsgReq_flg_ovrdflg KOUTP_RptMsgReq_flg_ovrdval /end REF_CHARACTERISTIC /end GROUP
/begin GROUP S532_Signal_Limit "SWC_OUTP_type/run_SWC_OUTP_5ms_sys/OUTP/outpmodule/VNMM_SysNMmSta_enum_Inproc/Signal_Limit" /begin REF_CHARACTERISTIC KOUTP_SysNMmSta_enum_maxval KOUTP_SysNMmSta_enum_minval /end REF_CHARACTERISTIC /end GROUP
/begin GROUP S532_Signal_Override "SWC_OUTP_type/run_SWC_OUTP_5ms_sys/OUTP/outpmodule/VNMM_SysNMmSta_enum_Inproc/Signal_Override" /begin REF_CHARACTERISTIC KOUTP_SysNMmSta_enum_ovrdflg KOUTP_SysNMmSta_enum_ovrdval /end REF_CHARACTERISTIC /end GROUP
/begin GROUP S533_Signal_Limit "SWC_OUTP_type/run_SWC_OUTP_5ms_sys/OUTP/outpmodule/VNMM_WakeUp_enum_Inproc/Signal_Limit" /begin REF_CHARACTERISTIC KOUTP_WakeUp_enum_maxval KOUTP_WakeUp_enum_minval /end REF_CHARACTERISTIC /end GROUP
/begin GROUP S533_Signal_Override "SWC_OUTP_type/run_SWC_OUTP_5ms_sys/OUTP/outpmodule/VNMM_WakeUp_enum_Inproc/Signal_Override" /begin REF_CHARACTERISTIC KOUTP_WakeUp_enum_ovrdflg KOUTP_WakeUp_enum_ovrdval /end REF_CHARACTERISTIC /end GROUP
/begin GROUP S534_Signal_Limit "SWC_OUTP_type/run_SWC_OUTP_5ms_sys/OUTP/outpmodule/VPMM_ACHVLoopDem_enum_Inproc/Signal_Limit"
 /begin REF_CHARACTERISTIC KOUTP_ACHVLoopDem_enum_maxval KOUTP_ACHVLoopDem_enum_minval /end REF_CHARACTERISTIC
/end GROUP
/begin GROUP S534_Signal_Override "SWC_OUTP_type/run_SWC_OUTP_5ms_sys/OUTP/outpmodule/VPMM_ACHVLoopDem_enum_Inproc/Signal_Override"
 /begin REF_CHARACTERISTIC KOUTP_ACHVLoopDem_enum_ovrdflg KOUTP_ACHVLoopDem_enum_ovrdval /end REF_CHARACTERISTIC
/end GROUP
/begin GROUP S535_Signal_Limit "SWC_OUTP_type/run_SWC_OUTP_5ms_sys/OUTP/outpmodule/VPMM_ActiveDischargeReq_enum_Inproc/Signal_Limit"
 /begin REF_CHARACTERISTIC KOUTP_ActiveDischargeReq_enum_maxval KOUTP_ActiveDischargeReq_enum_minval /end REF_CHARACTERISTIC
/end GROUP
/begin GROUP S535_Signal_Override "SWC_OUTP_type/run_SWC_OUTP_5ms_sys/OUTP/outpmodule/VPMM_ActiveDischargeReq_enum_Inproc/Signal_Override"
 /begin REF_CHARACTERISTIC KOUTP_ActiveDischargeReq_enum_ovrdflg KOUTP_ActiveDischargeReq_enum_ovrdval /end REF_CHARACTERISTIC
/end GROUP
/begin GROUP S536_Signal_Limit "SWC_OUTP_type/run_SWC_OUTP_5ms_sys/OUTP/outpmodule/VPMM_BattHVDem_enum_Inproc/Signal_Limit" /begin REF_CHARACTERISTIC KOUTP_BattHVDem_enum_maxval KOUTP_BattHVDem_enum_minval /end REF_CHARACTERISTIC /end GROUP
/begin GROUP S536_Signal_Override "SWC_OUTP_type/run_SWC_OUTP_5ms_sys/OUTP/outpmodule/VPMM_BattHVDem_enum_Inproc/Signal_Override" /begin REF_CHARACTERISTIC KOUTP_BattHVDem_enum_ovrdflg KOUTP_BattHVDem_enum_ovrdval /end REF_CHARACTERISTIC /end GROUP
/begin GROUP S537_Signal_Limit "SWC_OUTP_type/run_SWC_OUTP_5ms_sys/OUTP/outpmodule/VPMM_CACRlyDem_enum_Inproc/Signal_Limit" /begin REF_CHARACTERISTIC KOUTP_CACRlyDem_enum_maxval KOUTP_CACRlyDem_enum_minval /end REF_CHARACTERISTIC /end GROUP
/begin GROUP S537_Signal_Override "SWC_OUTP_type/run_SWC_OUTP_5ms_sys/OUTP/outpmodule/VPMM_CACRlyDem_enum_Inproc/Signal_Override" /begin REF_CHARACTERISTIC KOUTP_CACRlyDem_enum_ovrdflg KOUTP_CACRlyDem_enum_ovrdval /end REF_CHARACTERISTIC /end GROUP
/begin GROUP S538_Signal_Limit "SWC_OUTP_type/run_SWC_OUTP_5ms_sys/OUTP/outpmodule/VPMM_ChrgBCUHVFail_flg_Inproc/Signal_Limit"
 /begin REF_CHARACTERISTIC KOUTP_ChrgBCUHVFail_flg_maxval KOUTP_ChrgBCUHVFail_flg_minval /end REF_CHARACTERISTIC
/end GROUP
/begin GROUP S538_Signal_Override "SWC_OUTP_type/run_SWC_OUTP_5ms_sys/OUTP/outpmodule/VPMM_ChrgBCUHVFail_flg_Inproc/Signal_Override"
 /begin REF_CHARACTERISTIC KOUTP_ChrgBCUHVFail_flg_ovrdflg KOUTP_ChrgBCUHVFail_flg_ovrdval /end REF_CHARACTERISTIC
/end GROUP
/begin GROUP S539_Signal_Limit "SWC_OUTP_type/run_SWC_OUTP_5ms_sys/OUTP/outpmodule/VPMM_ChrgFault_enum_Inproc/Signal_Limit" /begin REF_CHARACTERISTIC KOUTP_ChrgFault_enum_maxval KOUTP_ChrgFault_enum_minval /end REF_CHARACTERISTIC /end GROUP
/begin GROUP S539_Signal_Override "SWC_OUTP_type/run_SWC_OUTP_5ms_sys/OUTP/outpmodule/VPMM_ChrgFault_enum_Inproc/Signal_Override" /begin REF_CHARACTERISTIC KOUTP_ChrgFault_enum_ovrdflg KOUTP_ChrgFault_enum_ovrdval /end REF_CHARACTERISTIC /end GROUP
/begin GROUP S540_Signal_Limit "SWC_OUTP_type/run_SWC_OUTP_5ms_sys/OUTP/outpmodule/VPMM_ChrgPowerUpFail_flg_Inproc/Signal_Limit"
 /begin REF_CHARACTERISTIC KOUTP_ChrgPowerUpFail_flg_maxval KOUTP_ChrgPowerUpFail_flg_minval /end REF_CHARACTERISTIC
/end GROUP
/begin GROUP S540_Signal_Override "SWC_OUTP_type/run_SWC_OUTP_5ms_sys/OUTP/outpmodule/VPMM_ChrgPowerUpFail_flg_Inproc/Signal_Override"
 /begin REF_CHARACTERISTIC KOUTP_ChrgPowerUpFail_flg_ovrdflg KOUTP_ChrgPowerUpFail_flg_ovrdval /end REF_CHARACTERISTIC
/end GROUP
/begin GROUP S541_Signal_Limit "SWC_OUTP_type/run_SWC_OUTP_5ms_sys/OUTP/outpmodule/VPMM_ChrgState_enum_Inproc/Signal_Limit" /begin REF_CHARACTERISTIC KOUTP_ChrgState_enum_maxval KOUTP_ChrgState_enum_minval /end REF_CHARACTERISTIC /end GROUP
/begin GROUP S541_Signal_Override "SWC_OUTP_type/run_SWC_OUTP_5ms_sys/OUTP/outpmodule/VPMM_ChrgState_enum_Inproc/Signal_Override" /begin REF_CHARACTERISTIC KOUTP_ChrgState_enum_ovrdflg KOUTP_ChrgState_enum_ovrdval /end REF_CHARACTERISTIC /end GROUP
/begin GROUP S542_Signal_Limit "SWC_OUTP_type/run_SWC_OUTP_5ms_sys/OUTP/outpmodule/VPMM_DCCurr_A_Inproc/Signal_Limit" /begin REF_CHARACTERISTIC KOUTP_DCCurr_A_maxval KOUTP_DCCurr_A_minval /end REF_CHARACTERISTIC /end GROUP
/begin GROUP S542_Signal_Override "SWC_OUTP_type/run_SWC_OUTP_5ms_sys/OUTP/outpmodule/VPMM_DCCurr_A_Inproc/Signal_Override" /begin REF_CHARACTERISTIC KOUTP_DCCurr_A_ovrdflg KOUTP_DCCurr_A_ovrdval /end REF_CHARACTERISTIC /end GROUP
/begin GROUP S543_Signal_Limit "SWC_OUTP_type/run_SWC_OUTP_5ms_sys/OUTP/outpmodule/VPMM_DCDCRlyDem_enum_Inproc/Signal_Limit" /begin REF_CHARACTERISTIC KOUTP_DCDCRlyDem_enum_maxval KOUTP_DCDCRlyDem_enum_minval /end REF_CHARACTERISTIC /end GROUP
/begin GROUP S543_Signal_Override "SWC_OUTP_type/run_SWC_OUTP_5ms_sys/OUTP/outpmodule/VPMM_DCDCRlyDem_enum_Inproc/Signal_Override"
 /begin REF_CHARACTERISTIC KOUTP_DCDCRlyDem_enum_ovrdflg KOUTP_DCDCRlyDem_enum_ovrdval /end REF_CHARACTERISTIC
/end GROUP
/begin GROUP S544_Signal_Limit "SWC_OUTP_type/run_SWC_OUTP_5ms_sys/OUTP/outpmodule/VPMM_DCVol_V_Inproc/Signal_Limit" /begin REF_CHARACTERISTIC KOUTP_DCVol_V_maxval KOUTP_DCVol_V_minval /end REF_CHARACTERISTIC /end GROUP
/begin GROUP S544_Signal_Override "SWC_OUTP_type/run_SWC_OUTP_5ms_sys/OUTP/outpmodule/VPMM_DCVol_V_Inproc/Signal_Override" /begin REF_CHARACTERISTIC KOUTP_DCVol_V_ovrdflg KOUTP_DCVol_V_ovrdval /end REF_CHARACTERISTIC /end GROUP
/begin GROUP S545_Signal_Limit "SWC_OUTP_type/run_SWC_OUTP_5ms_sys/OUTP/outpmodule/VPMM_DrivelineRelease_enum_Inproc/Signal_Limit"
 /begin REF_CHARACTERISTIC KOUTP_DrivelineRelease_enum_maxval KOUTP_DrivelineRelease_enum_minval /end REF_CHARACTERISTIC
/end GROUP
/begin GROUP S545_Signal_Override "SWC_OUTP_type/run_SWC_OUTP_5ms_sys/OUTP/outpmodule/VPMM_DrivelineRelease_enum_Inproc/Signal_Override"
 /begin REF_CHARACTERISTIC KOUTP_DrivelineRelease_enum_ovrdflg KOUTP_DrivelineRelease_enum_ovrdval /end REF_CHARACTERISTIC
/end GROUP
/begin GROUP S546_Signal_Limit "SWC_OUTP_type/run_SWC_OUTP_5ms_sys/OUTP/outpmodule/VPMM_EHPSRlyDem_enum_Inproc/Signal_Limit" /begin REF_CHARACTERISTIC KOUTP_EHPSRlyDem_enum_maxval KOUTP_EHPSRlyDem_enum_minval /end REF_CHARACTERISTIC /end GROUP
/begin GROUP S546_Signal_Override "SWC_OUTP_type/run_SWC_OUTP_5ms_sys/OUTP/outpmodule/VPMM_EHPSRlyDem_enum_Inproc/Signal_Override"
 /begin REF_CHARACTERISTIC KOUTP_EHPSRlyDem_enum_ovrdflg KOUTP_EHPSRlyDem_enum_ovrdval /end REF_CHARACTERISTIC
/end GROUP
/begin GROUP S547_Signal_Limit "SWC_OUTP_type/run_SWC_OUTP_5ms_sys/OUTP/outpmodule/VPMM_FogTMSRlyCMD_enum_Inproc/Signal_Limit"
 /begin REF_CHARACTERISTIC KOUTP_FogTMSRlyCMD_enum_maxval KOUTP_FogTMSRlyCMD_enum_minval /end REF_CHARACTERISTIC
/end GROUP
/begin GROUP S547_Signal_Override "SWC_OUTP_type/run_SWC_OUTP_5ms_sys/OUTP/outpmodule/VPMM_FogTMSRlyCMD_enum_Inproc/Signal_Override"
 /begin REF_CHARACTERISTIC KOUTP_FogTMSRlyCMD_enum_ovrdflg KOUTP_FogTMSRlyCMD_enum_ovrdval /end REF_CHARACTERISTIC
/end GROUP
/begin GROUP S548_Signal_Limit "SWC_OUTP_type/run_SWC_OUTP_5ms_sys/OUTP/outpmodule/VPMM_HVFailureChkPass_flg_Inproc/Signal_Limit"
 /begin REF_CHARACTERISTIC KOUTP_HVFailureChkPass_flg_maxval KOUTP_HVFailureChkPass_flg_minval /end REF_CHARACTERISTIC
/end GROUP
/begin GROUP S548_Signal_Override "SWC_OUTP_type/run_SWC_OUTP_5ms_sys/OUTP/outpmodule/VPMM_HVFailureChkPass_flg_Inproc/Signal_Override"
 /begin REF_CHARACTERISTIC KOUTP_HVFailureChkPass_flg_ovrdflg KOUTP_HVFailureChkPass_flg_ovrdval /end REF_CHARACTERISTIC
/end GROUP
/begin GROUP S549_Signal_Limit "SWC_OUTP_type/run_SWC_OUTP_5ms_sys/OUTP/outpmodule/VPMM_HVILDetectFail_flg_Inproc/Signal_Limit"
 /begin REF_CHARACTERISTIC KOUTP_HVILDetectFail_flg_maxval KOUTP_HVILDetectFail_flg_minval /end REF_CHARACTERISTIC
/end GROUP
/begin GROUP S549_Signal_Override "SWC_OUTP_type/run_SWC_OUTP_5ms_sys/OUTP/outpmodule/VPMM_HVILDetectFail_flg_Inproc/Signal_Override"
 /begin REF_CHARACTERISTIC KOUTP_HVILDetectFail_flg_ovrdflg KOUTP_HVILDetectFail_flg_ovrdval /end REF_CHARACTERISTIC
/end GROUP
/begin GROUP S550_Signal_Limit "SWC_OUTP_type/run_SWC_OUTP_5ms_sys/OUTP/outpmodule/VPMM_HVILFail_flg_Inproc/Signal_Limit" /begin REF_CHARACTERISTIC KOUTP_HVILFail_flg_maxval KOUTP_HVILFail_flg_minval /end REF_CHARACTERISTIC /end GROUP
/begin GROUP S550_Signal_Override "SWC_OUTP_type/run_SWC_OUTP_5ms_sys/OUTP/outpmodule/VPMM_HVILFail_flg_Inproc/Signal_Override" /begin REF_CHARACTERISTIC KOUTP_HVILFail_flg_ovrdflg KOUTP_HVILFail_flg_ovrdval /end REF_CHARACTERISTIC /end GROUP
/begin GROUP S551_Signal_Limit "SWC_OUTP_type/run_SWC_OUTP_5ms_sys/OUTP/outpmodule/VPMM_HVSysReady_enum_Inproc/Signal_Limit" /begin REF_CHARACTERISTIC KOUTP_HVSysReady_enum_maxval KOUTP_HVSysReady_enum_minval /end REF_CHARACTERISTIC /end GROUP
/begin GROUP S551_Signal_Override "SWC_OUTP_type/run_SWC_OUTP_5ms_sys/OUTP/outpmodule/VPMM_HVSysReady_enum_Inproc/Signal_Override"
 /begin REF_CHARACTERISTIC KOUTP_HVSysReady_enum_ovrdflg KOUTP_HVSysReady_enum_ovrdval /end REF_CHARACTERISTIC
/end GROUP
/begin GROUP S552_Signal_Limit "SWC_OUTP_type/run_SWC_OUTP_5ms_sys/OUTP/outpmodule/VPMM_IGNRlyClose_flg_Inproc/Signal_Limit" /begin REF_CHARACTERISTIC KOUTP_IGNRlyClose_flg_maxval KOUTP_IGNRlyClose_flg_minval /end REF_CHARACTERISTIC /end GROUP
/begin GROUP S552_Signal_Override "SWC_OUTP_type/run_SWC_OUTP_5ms_sys/OUTP/outpmodule/VPMM_IGNRlyClose_flg_Inproc/Signal_Override"
 /begin REF_CHARACTERISTIC KOUTP_IGNRlyClose_flg_ovrdflg KOUTP_IGNRlyClose_flg_ovrdval /end REF_CHARACTERISTIC
/end GROUP
/begin GROUP S553_Signal_Limit "SWC_OUTP_type/run_SWC_OUTP_5ms_sys/OUTP/outpmodule/VPMM_IRCRlyClose_flg_Inproc/Signal_Limit" /begin REF_CHARACTERISTIC KOUTP_IRCRlyClose_flg_maxval KOUTP_IRCRlyClose_flg_minval /end REF_CHARACTERISTIC /end GROUP
/begin GROUP S553_Signal_Override "SWC_OUTP_type/run_SWC_OUTP_5ms_sys/OUTP/outpmodule/VPMM_IRCRlyClose_flg_Inproc/Signal_Override"
 /begin REF_CHARACTERISTIC KOUTP_IRCRlyClose_flg_ovrdflg KOUTP_IRCRlyClose_flg_ovrdval /end REF_CHARACTERISTIC
/end GROUP
/begin GROUP S554_Signal_Limit "SWC_OUTP_type/run_SWC_OUTP_5ms_sys/OUTP/outpmodule/VPMM_LVBattLowInd_enum_Inproc/Signal_Limit"
 /begin REF_CHARACTERISTIC KOUTP_LVBattLowInd_enum_maxval KOUTP_LVBattLowInd_enum_minval /end REF_CHARACTERISTIC
/end GROUP
/begin GROUP S554_Signal_Override "SWC_OUTP_type/run_SWC_OUTP_5ms_sys/OUTP/outpmodule/VPMM_LVBattLowInd_enum_Inproc/Signal_Override"
 /begin REF_CHARACTERISTIC KOUTP_LVBattLowInd_enum_ovrdflg KOUTP_LVBattLowInd_enum_ovrdval /end REF_CHARACTERISTIC
/end GROUP
/begin GROUP S555_Signal_Limit "SWC_OUTP_type/run_SWC_OUTP_5ms_sys/OUTP/outpmodule/VPMM_LostHVComActivePwrDown_flg_Inproc/Signal_Limit"
 /begin REF_CHARACTERISTIC KOUTP_LostHVComActivePwrDown_flg_maxval KOUTP_LostHVComActivePwrDown_flg_minval /end REF_CHARACTERISTIC
/end GROUP
/begin GROUP S555_Signal_Override "SWC_OUTP_type/run_SWC_OUTP_5ms_sys/OUTP/outpmodule/VPMM_LostHVComActivePwrDown_flg_Inproc/Signal_Override"
 /begin REF_CHARACTERISTIC KOUTP_LostHVComActivePwrDown_flg_ovrdflg KOUTP_LostHVComActivePwrDown_flg_ovrdval /end REF_CHARACTERISTIC
/end GROUP
/begin GROUP S556_Signal_Limit "SWC_OUTP_type/run_SWC_OUTP_5ms_sys/OUTP/outpmodule/VPMM_MCUHVLoopDem_enum_Inproc/Signal_Limit"
 /begin REF_CHARACTERISTIC KOUTP_MCUHVLoopDem_enum_maxval KOUTP_MCUHVLoopDem_enum_minval /end REF_CHARACTERISTIC
/end GROUP
/begin GROUP S556_Signal_Override "SWC_OUTP_type/run_SWC_OUTP_5ms_sys/OUTP/outpmodule/VPMM_MCUHVLoopDem_enum_Inproc/Signal_Override"
 /begin REF_CHARACTERISTIC KOUTP_MCUHVLoopDem_enum_ovrdflg KOUTP_MCUHVLoopDem_enum_ovrdval /end REF_CHARACTERISTIC
/end GROUP
/begin GROUP S557_Signal_Limit "SWC_OUTP_type/run_SWC_OUTP_5ms_sys/OUTP/outpmodule/VPMM_PowerDownFault_enum_Inproc/Signal_Limit"
 /begin REF_CHARACTERISTIC KOUTP_PowerDownFault_enum_maxval KOUTP_PowerDownFault_enum_minval /end REF_CHARACTERISTIC
/end GROUP
/begin GROUP S557_Signal_Override "SWC_OUTP_type/run_SWC_OUTP_5ms_sys/OUTP/outpmodule/VPMM_PowerDownFault_enum_Inproc/Signal_Override"
 /begin REF_CHARACTERISTIC KOUTP_PowerDownFault_enum_ovrdflg KOUTP_PowerDownFault_enum_ovrdval /end REF_CHARACTERISTIC
/end GROUP
/begin GROUP S558_Signal_Limit "SWC_OUTP_type/run_SWC_OUTP_5ms_sys/OUTP/outpmodule/VPMM_PowerDownState_enum_Inproc/Signal_Limit"
 /begin REF_CHARACTERISTIC KOUTP_PowerDownState_enum_maxval KOUTP_PowerDownState_enum_minval /end REF_CHARACTERISTIC
/end GROUP
/begin GROUP S558_Signal_Override "SWC_OUTP_type/run_SWC_OUTP_5ms_sys/OUTP/outpmodule/VPMM_PowerDownState_enum_Inproc/Signal_Override"
 /begin REF_CHARACTERISTIC KOUTP_PowerDownState_enum_ovrdflg KOUTP_PowerDownState_enum_ovrdval /end REF_CHARACTERISTIC
/end GROUP
/begin GROUP S559_Signal_Limit "SWC_OUTP_type/run_SWC_OUTP_5ms_sys/OUTP/outpmodule/VPMM_PowerUpFault_enum_Inproc/Signal_Limit"
 /begin REF_CHARACTERISTIC KOUTP_PowerUpFault_enum_maxval KOUTP_PowerUpFault_enum_minval /end REF_CHARACTERISTIC
/end GROUP
/begin GROUP S559_Signal_Override "SWC_OUTP_type/run_SWC_OUTP_5ms_sys/OUTP/outpmodule/VPMM_PowerUpFault_enum_Inproc/Signal_Override"
 /begin REF_CHARACTERISTIC KOUTP_PowerUpFault_enum_ovrdflg KOUTP_PowerUpFault_enum_ovrdval /end REF_CHARACTERISTIC
/end GROUP
/begin GROUP S560_Signal_Limit "SWC_OUTP_type/run_SWC_OUTP_5ms_sys/OUTP/outpmodule/VPMM_PowerUpState_enum_Inproc/Signal_Limit"
 /begin REF_CHARACTERISTIC KOUTP_PowerUpState_enum_maxval KOUTP_PowerUpState_enum_minval /end REF_CHARACTERISTIC
/end GROUP
/begin GROUP S560_Signal_Override "SWC_OUTP_type/run_SWC_OUTP_5ms_sys/OUTP/outpmodule/VPMM_PowerUpState_enum_Inproc/Signal_Override"
 /begin REF_CHARACTERISTIC KOUTP_PowerUpState_enum_ovrdflg KOUTP_PowerUpState_enum_ovrdval /end REF_CHARACTERISTIC
/end GROUP
/begin GROUP S561_Signal_Limit "SWC_OUTP_type/run_SWC_OUTP_5ms_sys/OUTP/outpmodule/VPMM_SysPowerMode_enum_Inproc/Signal_Limit"
 /begin REF_CHARACTERISTIC KOUTP_SysPowerMode_enum_maxval KOUTP_SysPowerMode_enum_minval /end REF_CHARACTERISTIC
/end GROUP
/begin GROUP S561_Signal_Override "SWC_OUTP_type/run_SWC_OUTP_5ms_sys/OUTP/outpmodule/VPMM_SysPowerMode_enum_Inproc/Signal_Override"
 /begin REF_CHARACTERISTIC KOUTP_SysPowerMode_enum_ovrdflg KOUTP_SysPowerMode_enum_ovrdval /end REF_CHARACTERISTIC
/end GROUP
/begin GROUP S562_Signal_Limit "SWC_OUTP_type/run_SWC_OUTP_5ms_sys/OUTP/outpmodule/VPMM_V2BACPosRlyFit_enum_Inproc/Signal_Limit"
 /begin REF_CHARACTERISTIC KOUTP_V2BACPosRlyFit_enum_maxval KOUTP_V2BACPosRlyFit_enum_minval /end REF_CHARACTERISTIC
/end GROUP
/begin GROUP S562_Signal_Override "SWC_OUTP_type/run_SWC_OUTP_5ms_sys/OUTP/outpmodule/VPMM_V2BACPosRlyFit_enum_Inproc/Signal_Override"
 /begin REF_CHARACTERISTIC KOUTP_V2BACPosRlyFit_enum_ovrdflg KOUTP_V2BACPosRlyFit_enum_ovrdval /end REF_CHARACTERISTIC
/end GROUP
/begin GROUP S563_Signal_Limit "SWC_OUTP_type/run_SWC_OUTP_5ms_sys/OUTP/outpmodule/VPMM_V2BACPosRlySta_enum_Inproc/Signal_Limit"
 /begin REF_CHARACTERISTIC KOUTP_V2BACPosRlySta_enum_maxval KOUTP_V2BACPosRlySta_enum_minval /end REF_CHARACTERISTIC
/end GROUP
/begin GROUP S563_Signal_Override "SWC_OUTP_type/run_SWC_OUTP_5ms_sys/OUTP/outpmodule/VPMM_V2BACPosRlySta_enum_Inproc/Signal_Override"
 /begin REF_CHARACTERISTIC KOUTP_V2BACPosRlySta_enum_ovrdflg KOUTP_V2BACPosRlySta_enum_ovrdval /end REF_CHARACTERISTIC
/end GROUP
/begin GROUP S564_Signal_Limit "SWC_OUTP_type/run_SWC_OUTP_5ms_sys/OUTP/outpmodule/VPMM_V2BAirPosRlyFit_enum_Inproc/Signal_Limit"
 /begin REF_CHARACTERISTIC KOUTP_V2BAirPosRlyFit_enum_maxval KOUTP_V2BAirPosRlyFit_enum_minval /end REF_CHARACTERISTIC
/end GROUP
/begin GROUP S564_Signal_Override "SWC_OUTP_type/run_SWC_OUTP_5ms_sys/OUTP/outpmodule/VPMM_V2BAirPosRlyFit_enum_Inproc/Signal_Override"
 /begin REF_CHARACTERISTIC KOUTP_V2BAirPosRlyFit_enum_ovrdflg KOUTP_V2BAirPosRlyFit_enum_ovrdval /end REF_CHARACTERISTIC
/end GROUP
/begin GROUP S565_Signal_Limit "SWC_OUTP_type/run_SWC_OUTP_5ms_sys/OUTP/outpmodule/VPMM_V2BAirPosRlySta_enum_Inproc/Signal_Limit"
 /begin REF_CHARACTERISTIC KOUTP_V2BAirPosRlySta_enum_maxval KOUTP_V2BAirPosRlySta_enum_minval /end REF_CHARACTERISTIC
/end GROUP
/begin GROUP S565_Signal_Override "SWC_OUTP_type/run_SWC_OUTP_5ms_sys/OUTP/outpmodule/VPMM_V2BAirPosRlySta_enum_Inproc/Signal_Override"
 /begin REF_CHARACTERISTIC KOUTP_V2BAirPosRlySta_enum_ovrdflg KOUTP_V2BAirPosRlySta_enum_ovrdval /end REF_CHARACTERISTIC
/end GROUP
/begin GROUP S566_Signal_Limit "SWC_OUTP_type/run_SWC_OUTP_5ms_sys/OUTP/outpmodule/VPMM_V2BAux1OnOff_enum_Inproc/Signal_Limit"
 /begin REF_CHARACTERISTIC KOUTP_V2BAux1OnOff_enum_maxval KOUTP_V2BAux1OnOff_enum_minval /end REF_CHARACTERISTIC
/end GROUP
/begin GROUP S566_Signal_Override "SWC_OUTP_type/run_SWC_OUTP_5ms_sys/OUTP/outpmodule/VPMM_V2BAux1OnOff_enum_Inproc/Signal_Override"
 /begin REF_CHARACTERISTIC KOUTP_V2BAux1OnOff_enum_ovrdflg KOUTP_V2BAux1OnOff_enum_ovrdval /end REF_CHARACTERISTIC
/end GROUP
/begin GROUP S567_Signal_Limit "SWC_OUTP_type/run_SWC_OUTP_5ms_sys/OUTP/outpmodule/VPMM_V2BAux1RlyFit_enum_Inproc/Signal_Limit"
 /begin REF_CHARACTERISTIC KOUTP_V2BAux1RlyFit_enum_maxval KOUTP_V2BAux1RlyFit_enum_minval /end REF_CHARACTERISTIC
/end GROUP
/begin GROUP S567_Signal_Override "SWC_OUTP_type/run_SWC_OUTP_5ms_sys/OUTP/outpmodule/VPMM_V2BAux1RlyFit_enum_Inproc/Signal_Override"
 /begin REF_CHARACTERISTIC KOUTP_V2BAux1RlyFit_enum_ovrdflg KOUTP_V2BAux1RlyFit_enum_ovrdval /end REF_CHARACTERISTIC
/end GROUP
/begin GROUP S568_Signal_Limit "SWC_OUTP_type/run_SWC_OUTP_5ms_sys/OUTP/outpmodule/VPMM_V2BAux1RlySta_enum_Inproc/Signal_Limit"
 /begin REF_CHARACTERISTIC KOUTP_V2BAux1RlySta_enum_maxval KOUTP_V2BAux1RlySta_enum_minval /end REF_CHARACTERISTIC
/end GROUP
/begin GROUP S568_Signal_Override "SWC_OUTP_type/run_SWC_OUTP_5ms_sys/OUTP/outpmodule/VPMM_V2BAux1RlySta_enum_Inproc/Signal_Override"
 /begin REF_CHARACTERISTIC KOUTP_V2BAux1RlySta_enum_ovrdflg KOUTP_V2BAux1RlySta_enum_ovrdval /end REF_CHARACTERISTIC
/end GROUP
/begin GROUP S569_Signal_Limit "SWC_OUTP_type/run_SWC_OUTP_5ms_sys/OUTP/outpmodule/VPMM_V2BAux2OnOff_enum_Inproc/Signal_Limit"
 /begin REF_CHARACTERISTIC KOUTP_V2BAux2OnOff_enum_maxval KOUTP_V2BAux2OnOff_enum_minval /end REF_CHARACTERISTIC
/end GROUP
/begin GROUP S569_Signal_Override "SWC_OUTP_type/run_SWC_OUTP_5ms_sys/OUTP/outpmodule/VPMM_V2BAux2OnOff_enum_Inproc/Signal_Override"
 /begin REF_CHARACTERISTIC KOUTP_V2BAux2OnOff_enum_ovrdflg KOUTP_V2BAux2OnOff_enum_ovrdval /end REF_CHARACTERISTIC
/end GROUP
/begin GROUP S570_Signal_Limit "SWC_OUTP_type/run_SWC_OUTP_5ms_sys/OUTP/outpmodule/VPMM_V2BAux2RlyFit_enum_Inproc/Signal_Limit"
 /begin REF_CHARACTERISTIC KOUTP_V2BAux2RlyFit_enum_maxval KOUTP_V2BAux2RlyFit_enum_minval /end REF_CHARACTERISTIC
/end GROUP
/begin GROUP S570_Signal_Override "SWC_OUTP_type/run_SWC_OUTP_5ms_sys/OUTP/outpmodule/VPMM_V2BAux2RlyFit_enum_Inproc/Signal_Override"
 /begin REF_CHARACTERISTIC KOUTP_V2BAux2RlyFit_enum_ovrdflg KOUTP_V2BAux2RlyFit_enum_ovrdval /end REF_CHARACTERISTIC
/end GROUP
/begin GROUP S571_Signal_Limit "SWC_OUTP_type/run_SWC_OUTP_5ms_sys/OUTP/outpmodule/VPMM_V2BAux2RlySta_enum_Inproc/Signal_Limit"
 /begin REF_CHARACTERISTIC KOUTP_V2BAux2RlySta_enum_maxval KOUTP_V2BAux2RlySta_enum_minval /end REF_CHARACTERISTIC
/end GROUP
/begin GROUP S571_Signal_Override "SWC_OUTP_type/run_SWC_OUTP_5ms_sys/OUTP/outpmodule/VPMM_V2BAux2RlySta_enum_Inproc/Signal_Override"
 /begin REF_CHARACTERISTIC KOUTP_V2BAux2RlySta_enum_ovrdflg KOUTP_V2BAux2RlySta_enum_ovrdval /end REF_CHARACTERISTIC
/end GROUP
/begin GROUP S572_Signal_Limit "SWC_OUTP_type/run_SWC_OUTP_5ms_sys/OUTP/outpmodule/VPMM_V2BAux3OnOff_enum_Inproc/Signal_Limit"
 /begin REF_CHARACTERISTIC KOUTP_V2BAux3OnOff_enum_maxval KOUTP_V2BAux3OnOff_enum_minval /end REF_CHARACTERISTIC
/end GROUP
/begin GROUP S572_Signal_Override "SWC_OUTP_type/run_SWC_OUTP_5ms_sys/OUTP/outpmodule/VPMM_V2BAux3OnOff_enum_Inproc/Signal_Override"
 /begin REF_CHARACTERISTIC KOUTP_V2BAux3OnOff_enum_ovrdflg KOUTP_V2BAux3OnOff_enum_ovrdval /end REF_CHARACTERISTIC
/end GROUP
/begin GROUP S573_Signal_Limit "SWC_OUTP_type/run_SWC_OUTP_5ms_sys/OUTP/outpmodule/VPMM_V2BAux3RlyFit_enum_Inproc/Signal_Limit"
 /begin REF_CHARACTERISTIC KOUTP_V2BAux3RlyFit_enum_maxval KOUTP_V2BAux3RlyFit_enum_minval /end REF_CHARACTERISTIC
/end GROUP
/begin GROUP S573_Signal_Override "SWC_OUTP_type/run_SWC_OUTP_5ms_sys/OUTP/outpmodule/VPMM_V2BAux3RlyFit_enum_Inproc/Signal_Override"
 /begin REF_CHARACTERISTIC KOUTP_V2BAux3RlyFit_enum_ovrdflg KOUTP_V2BAux3RlyFit_enum_ovrdval /end REF_CHARACTERISTIC
/end GROUP
/begin GROUP S574_Signal_Limit "SWC_OUTP_type/run_SWC_OUTP_5ms_sys/OUTP/outpmodule/VPMM_V2BAux3RlySta_enum_Inproc/Signal_Limit"
 /begin REF_CHARACTERISTIC KOUTP_V2BAux3RlySta_enum_maxval KOUTP_V2BAux3RlySta_enum_minval /end REF_CHARACTERISTIC
/end GROUP
/begin GROUP S574_Signal_Override "SWC_OUTP_type/run_SWC_OUTP_5ms_sys/OUTP/outpmodule/VPMM_V2BAux3RlySta_enum_Inproc/Signal_Override"
 /begin REF_CHARACTERISTIC KOUTP_V2BAux3RlySta_enum_ovrdflg KOUTP_V2BAux3RlySta_enum_ovrdval /end REF_CHARACTERISTIC
/end GROUP
/begin GROUP S575_Signal_Limit "SWC_OUTP_type/run_SWC_OUTP_5ms_sys/OUTP/outpmodule/VPMM_V2BAux4RlyFit_enum_Inproc/Signal_Limit"
 /begin REF_CHARACTERISTIC KOUTP_V2BAux4RlyFit_enum_maxval KOUTP_V2BAux4RlyFit_enum_minval /end REF_CHARACTERISTIC
/end GROUP
/begin GROUP S575_Signal_Override "SWC_OUTP_type/run_SWC_OUTP_5ms_sys/OUTP/outpmodule/VPMM_V2BAux4RlyFit_enum_Inproc/Signal_Override"
 /begin REF_CHARACTERISTIC KOUTP_V2BAux4RlyFit_enum_ovrdflg KOUTP_V2BAux4RlyFit_enum_ovrdval /end REF_CHARACTERISTIC
/end GROUP
/begin GROUP S576_Signal_Limit "SWC_OUTP_type/run_SWC_OUTP_5ms_sys/OUTP/outpmodule/VPMM_V2BAux4RlySta_enum_Inproc/Signal_Limit"
 /begin REF_CHARACTERISTIC KOUTP_V2BAux4RlySta_enum_maxval KOUTP_V2BAux4RlySta_enum_minval /end REF_CHARACTERISTIC
/end GROUP
/begin GROUP S576_Signal_Override "SWC_OUTP_type/run_SWC_OUTP_5ms_sys/OUTP/outpmodule/VPMM_V2BAux4RlySta_enum_Inproc/Signal_Override"
 /begin REF_CHARACTERISTIC KOUTP_V2BAux4RlySta_enum_ovrdflg KOUTP_V2BAux4RlySta_enum_ovrdval /end REF_CHARACTERISTIC
/end GROUP
/begin GROUP S577_Signal_Limit "SWC_OUTP_type/run_SWC_OUTP_5ms_sys/OUTP/outpmodule/VPMM_V2BDCDCPosRlyFit_enum_Inproc/Signal_Limit"
 /begin REF_CHARACTERISTIC KOUTP_V2BDCDCPosRlyFit_enum_maxval KOUTP_V2BDCDCPosRlyFit_enum_minval /end REF_CHARACTERISTIC
/end GROUP
/begin GROUP S577_Signal_Override "SWC_OUTP_type/run_SWC_OUTP_5ms_sys/OUTP/outpmodule/VPMM_V2BDCDCPosRlyFit_enum_Inproc/Signal_Override"
 /begin REF_CHARACTERISTIC KOUTP_V2BDCDCPosRlyFit_enum_ovrdflg KOUTP_V2BDCDCPosRlyFit_enum_ovrdval /end REF_CHARACTERISTIC
/end GROUP
/begin GROUP S578_Signal_Limit "SWC_OUTP_type/run_SWC_OUTP_5ms_sys/OUTP/outpmodule/VPMM_V2BDCDCPosRlySta_enum_Inproc/Signal_Limit"
 /begin REF_CHARACTERISTIC KOUTP_V2BDCDCPosRlySta_enum_maxval KOUTP_V2BDCDCPosRlySta_enum_minval /end REF_CHARACTERISTIC
/end GROUP
/begin GROUP S578_Signal_Override "SWC_OUTP_type/run_SWC_OUTP_5ms_sys/OUTP/outpmodule/VPMM_V2BDCDCPosRlySta_enum_Inproc/Signal_Override"
 /begin REF_CHARACTERISTIC KOUTP_V2BDCDCPosRlySta_enum_ovrdflg KOUTP_V2BDCDCPosRlySta_enum_ovrdval /end REF_CHARACTERISTIC
/end GROUP
/begin GROUP S579_Signal_Limit "SWC_OUTP_type/run_SWC_OUTP_5ms_sys/OUTP/outpmodule/VPMM_V2BLifeSig_cnt_Inproc/Signal_Limit" /begin REF_CHARACTERISTIC KOUTP_V2BLifeSig_cnt_maxval KOUTP_V2BLifeSig_cnt_minval /end REF_CHARACTERISTIC /end GROUP
/end MODULE
/end PROJECT
