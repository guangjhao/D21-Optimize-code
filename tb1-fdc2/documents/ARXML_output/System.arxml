[part 2 of 2: package /SysEnv_ARPkg]
AUTOSAR XML (schema 4-3-0)
package /SysEnv_ARPkg  (continued)
  system System_FDC: category=SYSTEM_DESCRIPTION, ecu-extract-version=1.0.0, system-version=1.0.0  (continued)
    119 x system mapping:  (continued)
      MAP_R_CAN4_ZONE_DR_VCU: sender-receiver-to-signal-group-mapping{communication-direction=IN, data-element=SWC_FDC.root_FDC.R_CAN4_ZONE_DR_VCU.CAN4_SG_ZONE_DR_VCU, signal-group=CAN4_SG_ZONE_DR_VCU, type-mapping=sender-rec-record-type-mapping=record-element-mappings=[{implementation-record-element=CAN4_APTC_Err, system-signal=CAN4_APTC_Err}, {implementation-record-element=CAN4_ZoneDrMalfunLevel, system-signal=CAN4_ZoneDrMalfunLevel}, {implementation-record-element=CAN4_ZDR_VCU_PwrSupply_Sta, system-signal=CAN4_ZDR_VCU_PwrSupply_Sta}, {implementation-record-element=CAN4_ZDR_VCU_HWReset_Sta, system-signal=CAN4_ZDR_VCU_HWReset_Sta}, {implementation-record-element=CAN4_ZDR_SYS_CSWRetryCnt_Sta, system-signal=CAN4_ZDR_SYS_CSWRetryCnt_Sta}, {implementation-record-element=CAN4_ZDR_SYS_BSWSleepReq_Sta, system-signal=CAN4_ZDR_SYS_BSWSleepReq_Sta}, {implementation-record-element=CAN4_ZDR_SYS_APMRetryCnt_Sta, system-signal=CAN4_ZDR_SYS_APMRetryCnt_Sta}, {implementation-record-element=CAN4_Tincar_Err, system-signal=CAN4_Tincar_Err}, {implementation-record-element=CAN4_Tincar, system-signal=CAN4_Tincar}, {implementation-record-element=CAN4_Tevap_Err, system-signal=CAN4_Tevap_Err}, {implementation-record-element=CAN4_Tevap, system-signal=CAN4_Tevap}, {implementation-record-element=CAN4_T_Foot_Rr_Err, system-signal=CAN4_T_Foot_Rr_Err}, {implementation-record-element=CAN4_T_Foot_Rr, system-signal=CAN4_T_Foot_Rr}, {implementation-record-element=CAN4_T_Foot_R_Err, system-signal=CAN4_T_Foot_R_Err}, {implementation-record-element=CAN4_T_Foot_R, system-signal=CAN4_T_Foot_R}, {implementation-record-element=CAN4_T_Foot_L_Err, system-signal=CAN4_T_Foot_L_Err}, {implementation-record-element=CAN4_T_Foot_L, system-signal=CAN4_T_Foot_L}, {implementation-record-element=CAN4_T_Face_Rr_Err, system-signal=CAN4_T_Face_Rr_Err}, {implementation-record-element=CAN4_T_Face_Rr, system-signal=CAN4_T_Face_Rr}, {implementation-record-element=CAN4_T_Face_R_Err, system-signal=CAN4_T_Face_R_Err}, {implementation-record-element=CAN4_T_Face_R, system-signal=CAN4_T_Face_R}, {implementation-record-element=CAN4_T_Face_L_Err, system-signal=CAN4_T_Face_L_Err}, {implementation-record-element=CAN4_T_Face_L, system-signal=CAN4_T_Face_L}, {implementation-record-element=CAN4_SolarR_Err, system-signal=CAN4_SolarR_Err}, {implementation-record-element=CAN4_SolarR, system-signal=CAN4_SolarR}, {implementation-record-element=CAN4_SolarL_Err, system-signal=CAN4_SolarL_Err}, {implementation-record-element=CAN4_SolarL, system-signal=CAN4_SolarL}, {implementation-record-element=CAN4_RegenSW_Err, system-signal=CAN4_RegenSW_Err}, {implementation-record-element=CAN4_DrTHCMFault, system-signal=CAN4_DrTHCMFault}, {implementation-record-element=CAN4_DrStdAErrSta, system-signal=CAN4_DrStdAErrSta}, {implementation-record-element=CAN4_DrSCPSysErrLmp, system-signal=CAN4_DrSCPSysErrLmp}, {implementation-record-element=CAN4_DrPwrWindowECUFault, system-signal=CAN4_DrPwrWindowECUFault}, {implementation-record-element=CAN4_DrPwrWinErrSta, system-signal=CAN4_DrPwrWinErrSta}, {implementation-record-element=CAN4_DrPwrStdbyACurr, system-signal=CAN4_DrPwrStdbyACurr}, {implementation-record-element=CAN4_DrPwrSta, system-signal=CAN4_DrPwrSta}, {implementation-record-element=CAN4_DrPwrONA2Curr, system-signal=CAN4_DrPwrONA2Curr}, {implementation-record-element=CAN4_DrPwrONA1Curr, system-signal=CAN4_DrPwrONA1Curr}, {implementation-record-element=CAN4_DrPwrInformationSta, system-signal=CAN4_DrPwrInformationSta}, {implementation-record-element=CAN4_DrPowerTemp2, system-signal=CAN4_DrPowerTemp2}, {implementation-record-element=CAN4_DrPowerTemp1, system-signal=CAN4_DrPowerTemp1}, {implementation-record-element=CAN4_DrPMMSysErrLmp, system-signal=CAN4_DrPMMSysErrLmp}, {implementation-record-element=CAN4_DrPMMLimpHomeActReq, system-signal=CAN4_DrPMMLimpHomeActReq}, {implementation-record-element=CAN4_DrPMMLVOutPErrLmp, system-signal=CAN4_DrPMMLVOutPErrLmp}, {implementation-record-element=CAN4_DrONA1ErrSta, system-signal=CAN4_DrONA1ErrSta}, {implementation-record-element=CAN4_DrInfoFault, system-signal=CAN4_DrInfoFault}, {implementation-record-element=CAN4_DrInfoErrSta, system-signal=CAN4_DrInfoErrSta}, {implementation-record-element=CAN4_DrIVIFault, system-signal=CAN4_DrIVIFault}, {implementation-record-element=CAN4_DrEOBDFault, system-signal=CAN4_DrEOBDFault}, {implementation-record-element=CAN4_DrCtrlTemp, system-signal=CAN4_DrCtrlTemp}, {implementation-record-element=CAN4_DrCtrlBDVolt, system-signal=CAN4_DrCtrlBDVolt}, {implementation-record-element=CAN4_DrColumnSWFault, system-signal=CAN4_DrColumnSWFault}, {implementation-record-element=CAN4_DrAuBoxPwrN2Curr, system-signal=CAN4_DrAuBoxPwrN2Curr}, {implementation-record-element=CAN4_DrAuBoxPwrN1Curr, system-signal=CAN4_DrAuBoxPwrN1Curr}, {implementation-record-element=CAN4_DrAPWStaErr, system-signal=CAN4_DrAPWStaErr}, {implementation-record-element=CAN4_DrAPWLINErr, system-signal=CAN4_DrAPWLINErr}, {implementation-record-element=CAN4_DrADASCurr, system-signal=CAN4_DrADASCurr}, {implementation-record-element=CAN4_Blower_FB, system-signal=CAN4_Blower_FB}, {implementation-record-element=CAN4_Blower_Err, system-signal=CAN4_Blower_Err}]}
      MAP_R_CAN4_ZONE_FR1: sender-receiver-to-signal-group-mapping{communication-direction=IN, data-element=SWC_FDC.root_FDC.R_CAN4_ZONE_FR1.CAN4_SG_ZONE_FR1, signal-group=CAN4_SG_ZONE_FR1, type-mapping=sender-rec-record-type-mapping=record-element-mappings=[{implementation-record-element=CAN4_BDC_1_MoveEnable, system-signal=CAN4_BDC_1_MoveEnable}, {implementation-record-element=CAN4_ZFR_THCM_PsEVentActZ_Sta, system-signal=CAN4_ZFR_THCM_PsEVentActZ_Sta}, {implementation-record-element=CAN4_ZFR_THCM_PsEVentActY_Sta, system-signal=CAN4_ZFR_THCM_PsEVentActY_Sta}, {implementation-record-element=CAN4_ZFR_THCM_DrEVentActZ_Sta, system-signal=CAN4_ZFR_THCM_DrEVentActZ_Sta}, {implementation-record-element=CAN4_ZFR_THCM_DrEVentActY_Sta, system-signal=CAN4_ZFR_THCM_DrEVentActY_Sta}, {implementation-record-element=CAN4_ZFR_THCM_CREVentActZ_Sta, system-signal=CAN4_ZFR_THCM_CREVentActZ_Sta}, {implementation-record-element=CAN4_ZFR_THCM_CREVentActY_Sta, system-signal=CAN4_ZFR_THCM_CREVentActY_Sta}, {implementation-record-element=CAN4_ZFR_THCM_CLEVentActZ_Sta, system-signal=CAN4_ZFR_THCM_CLEVentActZ_Sta}, {implementation-record-element=CAN4_ZFR_THCM_CLEVentActY_Sta, system-signal=CAN4_ZFR_THCM_CLEVentActY_Sta}, {implementation-record-element=CAN4_ZFR_EChrg_Sys_Sta, system-signal=CAN4_ZFR_EChrg_Sys_Sta}, {implementation-record-element=CAN4_ZFR_EChrg_Active_Sta, system-signal=CAN4_ZFR_EChrg_Active_Sta}, {implementation-record-element=CAN4_ZFR_BCM_ChargerDoorSW_Sta, system-signal=CAN4_ZFR_BCM_ChargerDoorSW_Sta}, {implementation-record-element=CAN4_TrailerModeSta, system-signal=CAN4_TrailerModeSta}, {implementation-record-element=CAN4_TrailerCheck, system-signal=CAN4_TrailerCheck}, {implementation-record-element=CAN4_Rposition_Lamp_Warning, system-signal=CAN4_Rposition_Lamp_Warning}, {implementation-record-element=CAN4_RL_BeamErr, system-signal=CAN4_RL_BeamErr}, {implementation-record-element=CAN4_RLB_Warning, system-signal=CAN4_RLB_Warning}, {implementation-record-element=CAN4_RH_BeamErr, system-signal=CAN4_RH_BeamErr}, {implementation-record-element=CAN4_RDRL_Warning, system-signal=CAN4_RDRL_Warning}, {implementation-record-element=CAN4_RDRLErr, system-signal=CAN4_RDRLErr}, {implementation-record-element=CAN4_RAHB_Warning, system-signal=CAN4_RAHB_Warning}, {implementation-record-element=CAN4_RADB_Warning, system-signal=CAN4_RADB_Warning}, {implementation-record-element=CAN4_RADB_Operation_Status, system-signal=CAN4_RADB_Operation_Status}, {implementation-record-element=CAN4_RADB_Hibeam_Indication, system-signal=CAN4_RADB_Hibeam_Indication}, {implementation-record-element=CAN4_RADBErr, system-signal=CAN4_RADBErr}, {implementation-record-element=CAN4_Lposition_Lamp_Warning, system-signal=CAN4_Lposition_Lamp_Warning}, {implementation-record-element=CAN4_LL_BeamErr, system-signal=CAN4_LL_BeamErr}, {implementation-record-element=CAN4_LLB_Warning, system-signal=CAN4_LLB_Warning}, {implementation-record-element=CAN4_LH_BeamErr, system-signal=CAN4_LH_BeamErr}, {implementation-record-element=CAN4_LDRL_Warning, system-signal=CAN4_LDRL_Warning}, {implementation-record-element=CAN4_LDRLErr, system-signal=CAN4_LDRLErr}, {implementation-record-element=CAN4_LAHB_Warning, system-signal=CAN4_LAHB_Warning}, {implementation-record-element=CAN4_LADB_Warning, system-signal=CAN4_LADB_Warning}, {implementation-record-element=CAN4_LADB_Operation_Status, system-signal=CAN4_LADB_Operation_Status}, {implementation-record-element=CAN4_LADB_Hibeam_Indication, system-signal=CAN4_LADB_Hibeam_Indication}, {implementation-record-element=CAN4_LADBErr, system-signal=CAN4_LADBErr}, {implementation-record-element=CAN4_FWiperProtection, system-signal=CAN4_FWiperProtection}, {implementation-record-element=CAN4_FWiperAS, system-signal=CAN4_FWiperAS}, {implementation-record-element=CAN4_FRTurn_Light_Warning, system-signal=CAN4_FRTurn_Light_Warning}, {implementation-record-element=CAN4_FRTurnLampC, system-signal=CAN4_FRTurnLampC}, {implementation-record-element=CAN4_FRTurnLPErr, system-signal=CAN4_FRTurnLPErr}, {implementation-record-element=CAN4_FRPosLPErr, system-signal=CAN4_FRPosLPErr}, {implementation-record-element=CAN4_FLTurn_Light_Warning, system-signal=CAN4_FLTurn_Light_Warning}, {implementation-record-element=CAN4_FLTurnLampC, system-signal=CAN4_FLTurnLampC}, {implementation-record-element=CAN4_FLTurnLPErr, system-signal=CAN4_FLTurnLPErr}, {implementation-record-element=CAN4_FLPosLPErr, system-signal=CAN4_FLPosLPErr}, {implementation-record-element=CAN4_EXV_Cmd_Set_Rq, system-signal=CAN4_EXV_Cmd_Set_Rq}, {implementation-record-element=CAN4_EXV_Cmd_Move_Enbl, system-signal=CAN4_EXV_Cmd_Move_Enbl}, {implementation-record-element=CAN4_EXV_Cmd_Init_Rq, system-signal=CAN4_EXV_Cmd_Init_Rq}, {implementation-record-element=CAN4_EXV2_Cmd_Set_Rq, system-signal=CAN4_EXV2_Cmd_Set_Rq}, {implementation-record-element=CAN4_EXV2_Cmd_Move_Enbl, system-signal=CAN4_EXV2_Cmd_Move_Enbl}, {implementation-record-element=CAN4_EXV2_Cmd_Init_Rq, system-signal=CAN4_EXV2_Cmd_Init_Rq}, {implementation-record-element=CAN4_EWP3_RPM_Target_EWP_Rq, system-signal=CAN4_EWP3_RPM_Target_EWP_Rq}, {implementation-record-element=CAN4_EWP3_Default_Operation_EWP_Rq, system-signal=CAN4_EWP3_Default_Operation_EWP_Rq}, {implementation-record-element=CAN4_EWP2_RPM_Target_EWP_Rq, system-signal=CAN4_EWP2_RPM_Target_EWP_Rq}, {implementation-record-element=CAN4_EWP2_Default_Operation_EWP_Rq, system-signal=CAN4_EWP2_Default_Operation_EWP_Rq}, {implementation-record-element=CAN4_EWP1_RPM_Target_EWP_Rq, system-signal=CAN4_EWP1_RPM_Target_EWP_Rq}, {implementation-record-element=CAN4_EWP1_Default_Operation_EWP_Rq, system-signal=CAN4_EWP1_Default_Operation_EWP_Rq}, {implementation-record-element=CAN4_CompProEN, system-signal=CAN4_CompProEN}, {implementation-record-element=CAN4_ChargeInletLockSta, system-signal=CAN4_ChargeInletLockSta}, {implementation-record-element=CAN4_CCV4_ReqMovePos, system-signal=CAN4_CCV4_ReqMovePos}, {implementation-record-element=CAN4_CCV4_MoveEnable, system-signal=CAN4_CCV4_MoveEnable}, {implementation-record-element=CAN4_CCM_SpdCmd, system-signal=CAN4_CCM_SpdCmd}, {implementation-record-element=CAN4_BMSReqTapPosHSC6, system-signal=CAN4_BMSReqTapPosHSC6}, {implementation-record-element=CAN4_BMSReqRlngCtrHSC6, system-signal=CAN4_BMSReqRlngCtrHSC6}, {implementation-record-element=CAN4_BMSReqPwrHSC6, system-signal=CAN4_BMSReqPwrHSC6}, {implementation-record-element=CAN4_BMSReqPWMHSC6, system-signal=CAN4_BMSReqPWMHSC6}, {implementation-record-element=CAN4_BMSReqMdHSC6, system-signal=CAN4_BMSReqMdHSC6}, {implementation-record-element=CAN4_BMSPackVol_h6HSC6, system-signal=CAN4_BMSPackVol_h6HSC6}, {implementation-record-element=CAN4_BMSInptClntTemHSC6, system-signal=CAN4_BMSInptClntTemHSC6}, {implementation-record-element=CAN4_BMSEnbPTCHSC6, system-signal=CAN4_BMSEnbPTCHSC6}, {implementation-record-element=CAN4_BMSChksmHSC6, system-signal=CAN4_BMSChksmHSC6}, {implementation-record-element=CAN4_BDC_1_ReqMovePos, system-signal=CAN4_BDC_1_ReqMovePos}]}
      MAP_R_CAN4_ZONE_FR_VCU: sender-receiver-to-signal-group-mapping{communication-direction=IN, data-element=SWC_FDC.root_FDC.R_CAN4_ZONE_FR_VCU.CAN4_SG_ZONE_FR_VCU, signal-group=CAN4_SG_ZONE_FR_VCU, type-mapping=sender-rec-record-type-mapping=record-element-mappings=[{implementation-record-element=CAN4_Bat_In_Temp, system-signal=CAN4_Bat_In_Temp}, {implementation-record-element=CAN4_ZoneFrMalfunLevel, system-signal=CAN4_ZoneFrMalfunLevel}, {implementation-record-element=CAN4_ZFR_VCU_PwrSupply_Sta, system-signal=CAN4_ZFR_VCU_PwrSupply_Sta}, {implementation-record-element=CAN4_ZFR_VCU_HWReset_Sta, system-signal=CAN4_ZFR_VCU_HWReset_Sta}, {implementation-record-element=CAN4_ZFR_SYS_MCURetryCnt_Sta, system-signal=CAN4_ZFR_SYS_MCURetryCnt_Sta}, {implementation-record-element=CAN4_ZFR_SYS_BSWSleepReq_Sta, system-signal=CAN4_ZFR_SYS_BSWSleepReq_Sta}, {implementation-record-element=CAN4_ZFR_SYS_BMSCCURetryCnt_Sta, system-signal=CAN4_ZFR_SYS_BMSCCURetryCnt_Sta}, {implementation-record-element=CAN4_WPTC_Err, system-signal=CAN4_WPTC_Err}, {implementation-record-element=CAN4_Tamb_Err, system-signal=CAN4_Tamb_Err}, {implementation-record-element=CAN4_Tamb, system-signal=CAN4_Tamb}, {implementation-record-element=CAN4_TWV_Err, system-signal=CAN4_TWV_Err}, {implementation-record-element=CAN4_SOV3_Err, system-signal=CAN4_SOV3_Err}, {implementation-record-element=CAN4_SOV2_Err, system-signal=CAN4_SOV2_Err}, {implementation-record-element=CAN4_SOV1_Err, system-signal=CAN4_SOV1_Err}, {implementation-record-element=CAN4_SOTXV_Err, system-signal=CAN4_SOTXV_Err}, {implementation-record-element=CAN4_PT_Low_T2_Err, system-signal=CAN4_PT_Low_T2_Err}, {implementation-record-element=CAN4_PT_Low_T2, system-signal=CAN4_PT_Low_T2}, {implementation-record-element=CAN4_PT_Low_T1_Err, system-signal=CAN4_PT_Low_T1_Err}, {implementation-record-element=CAN4_PT_Low_T1, system-signal=CAN4_PT_Low_T1}, {implementation-record-element=CAN4_PT_Low_P2_Err, system-signal=CAN4_PT_Low_P2_Err}, {implementation-record-element=CAN4_PT_Low_P2, system-signal=CAN4_PT_Low_P2}, {implementation-record-element=CAN4_PT_Low_P1_Err, system-signal=CAN4_PT_Low_P1_Err}, {implementation-record-element=CAN4_PT_Low_P1, system-signal=CAN4_PT_Low_P1}, {implementation-record-element=CAN4_PT_High_Tact_Err, system-signal=CAN4_PT_High_Tact_Err}, {implementation-record-element=CAN4_PT_High_Tact, system-signal=CAN4_PT_High_Tact}, {implementation-record-element=CAN4_PT_High_T, system-signal=CAN4_PT_High_T}, {implementation-record-element=CAN4_PT_High_P_Err, system-signal=CAN4_PT_High_P_Err}, {implementation-record-element=CAN4_PT_High_P, system-signal=CAN4_PT_High_P}, {implementation-record-element=CAN4_Motor_Out_Temp_Err, system-signal=CAN4_Motor_Out_Temp_Err}, {implementation-record-element=CAN4_Motor_Out_Temp, system-signal=CAN4_Motor_Out_Temp}, {implementation-record-element=CAN4_Motor_In_Temp_Err, system-signal=CAN4_Motor_In_Temp_Err}, {implementation-record-element=CAN4_Motor_In_Temp, system-signal=CAN4_Motor_In_Temp}, {implementation-record-element=CAN4_FrStdA2PErr, system-signal=CAN4_FrStdA2PErr}, {implementation-record-element=CAN4_FrStdA2PCErr, system-signal=CAN4_FrStdA2PCErr}, {implementation-record-element=CAN4_FrStdA1PCErr, system-signal=CAN4_FrStdA1PCErr}, {implementation-record-element=CAN4_FrPwrStdbyA2PlusFault, system-signal=CAN4_FrPwrStdbyA2PlusFault}, {implementation-record-element=CAN4_FrPwrStdbyA2PlusCurr, system-signal=CAN4_FrPwrStdbyA2PlusCurr}, {implementation-record-element=CAN4_FrPwrStdbyA2Curr, system-signal=CAN4_FrPwrStdbyA2Curr}, {implementation-record-element=CAN4_FrPwrStdbyA1PlusFault, system-signal=CAN4_FrPwrStdbyA1PlusFault}, {implementation-record-element=CAN4_FrPwrStdbyA1PlusCurr, system-signal=CAN4_FrPwrStdbyA1PlusCurr}, {implementation-record-element=CAN4_FrPwrStdbyA1Fault, system-signal=CAN4_FrPwrStdbyA1Fault}, {implementation-record-element=CAN4_FrPwrSta, system-signal=CAN4_FrPwrSta}, {implementation-record-element=CAN4_FrPwrONA3Curr, system-signal=CAN4_FrPwrONA3Curr}, {implementation-record-element=CAN4_FrPwrONA2Curr, system-signal=CAN4_FrPwrONA2Curr}, {implementation-record-element=CAN4_FrPwrONA1Fault, system-signal=CAN4_FrPwrONA1Fault}, {implementation-record-element=CAN4_FrPowerTemp2, system-signal=CAN4_FrPowerTemp2}, {implementation-record-element=CAN4_FrPowerTemp1, system-signal=CAN4_FrPowerTemp1}, {implementation-record-element=CAN4_FrPMMSysErrLmp, system-signal=CAN4_FrPMMSysErrLmp}, {implementation-record-element=CAN4_FrPMMLimpHomeActReq, system-signal=CAN4_FrPMMLimpHomeActReq}, {implementation-record-element=CAN4_FrPMMLVOutPErrLmp, system-signal=CAN4_FrPMMLVOutPErrLmp}, {implementation-record-element=CAN4_FrIRC_2Curr, system-signal=CAN4_FrIRC_2Curr}, {implementation-record-element=CAN4_FrIRC_1Curr, system-signal=CAN4_FrIRC_1Curr}, {implementation-record-element=CAN4_FrEDU_INVERTERFault, system-signal=CAN4_FrEDU_INVERTERFault}, {implementation-record-element=CAN4_FrEDU_INVERTERCurr, system-signal=CAN4_FrEDU_INVERTERCurr}, {implementation-record-element=CAN4_FrEDUErr, system-signal=CAN4_FrEDUErr}, {implementation-record-element=CAN4_FrCtrlTemp, system-signal=CAN4_FrCtrlTemp}, {implementation-record-element=CAN4_FrCtrlBDVolt, system-signal=CAN4_FrCtrlBDVolt}, {implementation-record-element=CAN4_FrBMS_CCU_CIRFault, system-signal=CAN4_FrBMS_CCU_CIRFault}, {implementation-record-element=CAN4_FrBMS_CCU_CIRCurr, system-signal=CAN4_FrBMS_CCU_CIRCurr}, {implementation-record-element=CAN4_FrBMSCCUCErr, system-signal=CAN4_FrBMSCCUCErr}, {implementation-record-element=CAN4_Fan_Err, system-signal=CAN4_Fan_Err}, {implementation-record-element=CAN4_FWV_Err, system-signal=CAN4_FWV_Err}, {implementation-record-element=CAN4_EXV2_Err, system-signal=CAN4_EXV2_Err}, {implementation-record-element=CAN4_EXV1_Err, system-signal=CAN4_EXV1_Err}, {implementation-record-element=CAN4_EWP3_Err, system-signal=CAN4_EWP3_Err}, {implementation-record-element=CAN4_EWP2_Err, system-signal=CAN4_EWP2_Err}, {implementation-record-element=CAN4_EWP1_Err, system-signal=CAN4_EWP1_Err}, {implementation-record-element=CAN4_EACProtectEnable, system-signal=CAN4_EACProtectEnable}, {implementation-record-element=CAN4_COMP_Err, system-signal=CAN4_COMP_Err}, {implementation-record-element=CAN4_Bat_Out_Temp_Err, system-signal=CAN4_Bat_Out_Temp_Err}, {implementation-record-element=CAN4_Bat_Out_Temp, system-signal=CAN4_Bat_Out_Temp}, {implementation-record-element=CAN4_Bat_In_Temp_Err, system-signal=CAN4_Bat_In_Temp_Err}]}
      MAP_R_CAN4_zGW_APTC1: sender-receiver-to-signal-group-mapping{communication-direction=IN, data-element=SWC_FDC.root_FDC.R_CAN4_zGW_APTC1.CAN4_SG_zGW_APTC1, signal-group=CAN4_SG_zGW_APTC1, type-mapping=sender-rec-record-type-mapping=record-element-mappings=[{implementation-record-element=CAN4_FrntPTCBusLineHiV, system-signal=CAN4_FrntPTCBusLineHiV}, {implementation-record-element=CAN4_FrntPTCSupplierCod, system-signal=CAN4_FrntPTCSupplierCod}, {implementation-record-element=CAN4_FrntPTCSts, system-signal=CAN4_FrntPTCSts}, {implementation-record-element=CAN4_FrntPTCSWVers, system-signal=CAN4_FrntPTCSWVers}, {implementation-record-element=CAN4_FrntPTCRiOverAFlt, system-signal=CAN4_FrntPTCRiOverAFlt}, {implementation-record-element=CAN4_FrntPTCRiOpentCircFlt, system-signal=CAN4_FrntPTCRiOpentCircFlt}, {implementation-record-element=CAN4_FrntPTCRiIGBTTSnsrFlt, system-signal=CAN4_FrntPTCRiIGBTTSnsrFlt}, {implementation-record-element=CAN4_FrntPTCRiIGBTT, system-signal=CAN4_FrntPTCRiIGBTT}, {implementation-record-element=CAN4_FrntPTCRiIGBTShoCircFlt, system-signal=CAN4_FrntPTCRiIGBTShoCircFlt}, {implementation-record-element=CAN4_FrntPTCRiIGBTOverTFlt, system-signal=CAN4_FrntPTCRiIGBTOverTFlt}, {implementation-record-element=CAN4_FrntPTCRiCoreTSnsrFlt, system-signal=CAN4_FrntPTCRiCoreTSnsrFlt}, {implementation-record-element=CAN4_FrntPTCRiCoreT, system-signal=CAN4_FrntPTCRiCoreT}, {implementation-record-element=CAN4_FrntPTCRiCoreOverTFlt, system-signal=CAN4_FrntPTCRiCoreOverTFlt}, {implementation-record-element=CAN4_FrntPTCRiBusLineC, system-signal=CAN4_FrntPTCRiBusLineC}, {implementation-record-element=CAN4_FrntPTCRiActHeatPwr, system-signal=CAN4_FrntPTCRiActHeatPwr}, {implementation-record-element=CAN4_FrntPTCRearRiOverAFlt, system-signal=CAN4_FrntPTCRearRiOverAFlt}, {implementation-record-element=CAN4_FrntPTCRearRiOpentCircFlt, system-signal=CAN4_FrntPTCRearRiOpentCircFlt}, {implementation-record-element=CAN4_FrntPTCRearRiIGBTShoCFlt, system-signal=CAN4_FrntPTCRearRiIGBTShoCFlt}, {implementation-record-element=CAN4_FrntPTCRearRiCoreTSnsrFlt, system-signal=CAN4_FrntPTCRearRiCoreTSnsrFlt}, {implementation-record-element=CAN4_FrntPTCRearRiCoreT, system-signal=CAN4_FrntPTCRearRiCoreT}, {implementation-record-element=CAN4_FrntPTCRearRiCoreOverTFlt, system-signal=CAN4_FrntPTCRearRiCoreOverTFlt}, {implementation-record-element=CAN4_FrntPTCRearRiBusLineC, system-signal=CAN4_FrntPTCRearRiBusLineC}, {implementation-record-element=CAN4_FrntPTCRearRiActHeatPwr, system-signal=CAN4_FrntPTCRearRiActHeatPwr}, {implementation-record-element=CAN4_FrntPTCRearLeOverAFlt, system-signal=CAN4_FrntPTCRearLeOverAFlt}, {implementation-record-element=CAN4_FrntPTCRearLeOpentCircFlt, system-signal=CAN4_FrntPTCRearLeOpentCircFlt}, {implementation-record-element=CAN4_FrntPTCRearLeIGBTShoCFlt, system-signal=CAN4_FrntPTCRearLeIGBTShoCFlt}, {implementation-record-element=CAN4_FrntPTCRearLeCoreTSnsrFlt, system-signal=CAN4_FrntPTCRearLeCoreTSnsrFlt}, {implementation-record-element=CAN4_FrntPTCRearLeCoreT, system-signal=CAN4_FrntPTCRearLeCoreT}, {implementation-record-element=CAN4_FrntPTCRearLeCoreOverTFlt, system-signal=CAN4_FrntPTCRearLeCoreOverTFlt}, {implementation-record-element=CAN4_FrntPTCRearLeBusLineC, system-signal=CAN4_FrntPTCRearLeBusLineC}, {implementation-record-element=CAN4_FrntPTCRearLeActHeatPwr, system-signal=CAN4_FrntPTCRearLeActHeatPwr}, {implementation-record-element=CAN4_FrntPTCPCBTSnsrFlt, system-signal=CAN4_FrntPTCPCBTSnsrFlt}, {implementation-record-element=CAN4_FrntPTCPCBT, system-signal=CAN4_FrntPTCPCBT}, {implementation-record-element=CAN4_FrntPTCPCBOverTFlt, system-signal=CAN4_FrntPTCPCBOverTFlt}, {implementation-record-element=CAN4_FrntPTCLeOverAFlt, system-signal=CAN4_FrntPTCLeOverAFlt}, {implementation-record-element=CAN4_FrntPTCLeOpentCircFlt, system-signal=CAN4_FrntPTCLeOpentCircFlt}, {implementation-record-element=CAN4_FrntPTCLeIGBTTSnsrFlt, system-signal=CAN4_FrntPTCLeIGBTTSnsrFlt}, {implementation-record-element=CAN4_FrntPTCLeIGBTT, system-signal=CAN4_FrntPTCLeIGBTT}, {implementation-record-element=CAN4_FrntPTCLeIGBTShoCircFlt, system-signal=CAN4_FrntPTCLeIGBTShoCircFlt}, {implementation-record-element=CAN4_FrntPTCLeIGBTOverTFlt, system-signal=CAN4_FrntPTCLeIGBTOverTFlt}, {implementation-record-element=CAN4_FrntPTCLeCoreTSnsrFlt, system-signal=CAN4_FrntPTCLeCoreTSnsrFlt}, {implementation-record-element=CAN4_FrntPTCLeCoreT, system-signal=CAN4_FrntPTCLeCoreT}, {implementation-record-element=CAN4_FrntPTCLeCoreOverTFlt, system-signal=CAN4_FrntPTCLeCoreOverTFlt}, {implementation-record-element=CAN4_FrntPTCLeBusLineC, system-signal=CAN4_FrntPTCLeBusLineC}, {implementation-record-element=CAN4_FrntPTCLeActHeatPwr, system-signal=CAN4_FrntPTCLeActHeatPwr}, {implementation-record-element=CAN4_FrntPTCLVUnderUFlt, system-signal=CAN4_FrntPTCLVUnderUFlt}, {implementation-record-element=CAN4_FrntPTCLVOverUFlt, system-signal=CAN4_FrntPTCLVOverUFlt}, {implementation-record-element=CAN4_FrntPTCHWVers, system-signal=CAN4_FrntPTCHWVers}, {implementation-record-element=CAN4_FrntPTCHVUnderUFlt, system-signal=CAN4_FrntPTCHVUnderUFlt}, {implementation-record-element=CAN4_FrntPTCHVOverUFlt, system-signal=CAN4_FrntPTCHVOverUFlt}, {implementation-record-element=CAN4_FrntPTCFltSt, system-signal=CAN4_FrntPTCFltSt}, {implementation-record-element=CAN4_FrntPTCComFlt, system-signal=CAN4_FrntPTCComFlt}]}
      MAP_R_CAN4_zGW_CANFr1: sender-receiver-to-signal-group-mapping{communication-direction=IN, data-element=SWC_FDC.root_FDC.R_CAN4_zGW_CANFr1.CAN4_SG_zGW_CANFr1, signal-group=CAN4_SG_zGW_CANFr1, type-mapping=sender-rec-record-type-mapping=record-element-mappings=[{implementation-record-element=CAN4_COMP_ActualPwr, system-signal=CAN4_COMP_ActualPwr}, {implementation-record-element=CAN4_PTCUnderVolHSC6, system-signal=CAN4_PTCUnderVolHSC6}, {implementation-record-element=CAN4_PTCStsHSC6, system-signal=CAN4_PTCStsHSC6}, {implementation-record-element=CAN4_PTCSecRlngCtrHSC6, system-signal=CAN4_PTCSecRlngCtrHSC6}, {implementation-record-element=CAN4_PTCSecChksmHSC6, system-signal=CAN4_PTCSecChksmHSC6}, {implementation-record-element=CAN4_PTCRlngCtrHSC6, system-signal=CAN4_PTCRlngCtrHSC6}, {implementation-record-element=CAN4_PTCPCBTemHSC6, system-signal=CAN4_PTCPCBTemHSC6}, {implementation-record-element=CAN4_PTCOverVolHSC6, system-signal=CAN4_PTCOverVolHSC6}, {implementation-record-element=CAN4_PTCOverHeatHSC6, system-signal=CAN4_PTCOverHeatHSC6}, {implementation-record-element=CAN4_PTCOverCrntHSC6, system-signal=CAN4_PTCOverCrntHSC6}, {implementation-record-element=CAN4_PTCOtptTemHSC6, system-signal=CAN4_PTCOtptTemHSC6}, {implementation-record-element=CAN4_PTCNTCStsHSC6, system-signal=CAN4_PTCNTCStsHSC6}, {implementation-record-element=CAN4_PTCIGBTTemHSC6, system-signal=CAN4_PTCIGBTTemHSC6}, {implementation-record-element=CAN4_PTCIGBTStsHSC6, system-signal=CAN4_PTCIGBTStsHSC6}, {implementation-record-element=CAN4_PTCIGBTOverHeatHSC6, system-signal=CAN4_PTCIGBTOverHeatHSC6}, {implementation-record-element=CAN4_PTCHVLckStsHSC6, system-signal=CAN4_PTCHVLckStsHSC6}, {implementation-record-element=CAN4_PTCFltLvlHSC6, system-signal=CAN4_PTCFltLvlHSC6}, {implementation-record-element=CAN4_PTCChksmHSC6, system-signal=CAN4_PTCChksmHSC6}, {implementation-record-element=CAN4_PTCActuVolHSC6, system-signal=CAN4_PTCActuVolHSC6}, {implementation-record-element=CAN4_PTCActuPwrHSC6, system-signal=CAN4_PTCActuPwrHSC6}, {implementation-record-element=CAN4_PTCActuPWMDutyHSC6, system-signal=CAN4_PTCActuPWMDutyHSC6}, {implementation-record-element=CAN4_PTCActuCrntHSC6, system-signal=CAN4_PTCActuCrntHSC6}, {implementation-record-element=CAN4_PTC1_PowerConsumption, system-signal=CAN4_PTC1_PowerConsumption}, {implementation-record-element=CAN4_EAC_TempSnsrFalt, system-signal=CAN4_EAC_TempSnsrFalt}, {implementation-record-element=CAN4_EAC_Temp, system-signal=CAN4_EAC_Temp}, {implementation-record-element=CAN4_EAC_OvLoadFalt, system-signal=CAN4_EAC_OvLoadFalt}, {implementation-record-element=CAN4_EAC_MotorLackFalt, system-signal=CAN4_EAC_MotorLackFalt}, {implementation-record-element=CAN4_EAC_MotCrt, system-signal=CAN4_EAC_MotCrt}, {implementation-record-element=CAN4_EAC_DrvVoltFalt, system-signal=CAN4_EAC_DrvVoltFalt}, {implementation-record-element=CAN4_COMP_VoltVaild, system-signal=CAN4_COMP_VoltVaild}, {implementation-record-element=CAN4_COMP_VoltOverErr, system-signal=CAN4_COMP_VoltOverErr}, {implementation-record-element=CAN4_COMP_VoltLessErr, system-signal=CAN4_COMP_VoltLessErr}, {implementation-record-element=CAN4_COMP_StatorSpd, system-signal=CAN4_COMP_StatorSpd}, {implementation-record-element=CAN4_COMP_Sta, system-signal=CAN4_COMP_Sta}, {implementation-record-element=CAN4_COMP_SpdVaild, system-signal=CAN4_COMP_SpdVaild}, {implementation-record-element=CAN4_COMP_Init, system-signal=CAN4_COMP_Init}, {implementation-record-element=CAN4_COMP_IPM_TempOverFlt, system-signal=CAN4_COMP_IPM_TempOverFlt}, {implementation-record-element=CAN4_COMP_IPM_HWFLt, system-signal=CAN4_COMP_IPM_HWFLt}, {implementation-record-element=CAN4_COMP_CurVaild, system-signal=CAN4_COMP_CurVaild}, {implementation-record-element=CAN4_COMP_CurOverProtect, system-signal=CAN4_COMP_CurOverProtect}, {implementation-record-element=CAN4_COMP_CtrlCircFlt, system-signal=CAN4_COMP_CtrlCircFlt}, {implementation-record-element=CAN4_COMP_ConVolt, system-signal=CAN4_COMP_ConVolt}, {implementation-record-element=CAN4_COMP_ConCur, system-signal=CAN4_COMP_ConCur}, {implementation-record-element=CAN4_COMP_ComLost, system-signal=CAN4_COMP_ComLost}]}
      MAP_R_CAN4_zGW_LINDr1: sender-receiver-to-signal-group-mapping{communication-direction=IN, data-element=SWC_FDC.root_FDC.R_CAN4_zGW_LINDr1.CAN4_SG_zGW_LINDr1, signal-group=CAN4_SG_zGW_LINDr1, type-mapping=sender-rec-record-type-mapping=record-element-mappings=[{implementation-record-element=CAN4_CSW_DimSw, system-signal=CAN4_CSW_DimSw}, {implementation-record-element=CAN4_SWC_resp_error, system-signal=CAN4_SWC_resp_error}, {implementation-record-element=CAN4_SWC_mode_Sta, system-signal=CAN4_SWC_mode_Sta}, {implementation-record-element=CAN4_SWC_VR_Sta, system-signal=CAN4_SWC_VR_Sta}, {implementation-record-element=CAN4_SWC_Up_Sta, system-signal=CAN4_SWC_Up_Sta}, {implementation-record-element=CAN4_SWC_Undefined_Sta, system-signal=CAN4_SWC_Undefined_Sta}, {implementation-record-element=CAN4_SWC_Trip_Sta, system-signal=CAN4_SWC_Trip_Sta}, {implementation-record-element=CAN4_SWC_Set_down_Sta, system-signal=CAN4_SWC_Set_down_Sta}, {implementation-record-element=CAN4_SWC_Right_Sta, system-signal=CAN4_SWC_Right_Sta}, {implementation-record-element=CAN4_SWC_Res_Up_Sta, system-signal=CAN4_SWC_Res_Up_Sta}, {implementation-record-element=CAN4_SWC_RegenUp, system-signal=CAN4_SWC_RegenUp}, {implementation-record-element=CAN4_SWC_RegenDown, system-signal=CAN4_SWC_RegenDown}, {implementation-record-element=CAN4_SWC_Left_Sta, system-signal=CAN4_SWC_Left_Sta}, {implementation-record-element=CAN4_SWC_LKA_Sta, system-signal=CAN4_SWC_LKA_Sta}, {implementation-record-element=CAN4_SWC_Drivemode_Sta, system-signal=CAN4_SWC_Drivemode_Sta}, {implementation-record-element=CAN4_SWC_Down_Sta, system-signal=CAN4_SWC_Down_Sta}, {implementation-record-element=CAN4_SWC_Distance_Sta, system-signal=CAN4_SWC_Distance_Sta}, {implementation-record-element=CAN4_SWC_CANCEL_Sta, system-signal=CAN4_SWC_CANCEL_Sta}, {implementation-record-element=CAN4_SWC_A_SW_version, system-signal=CAN4_SWC_A_SW_version}, {implementation-record-element=CAN4_SWC_A_Resp_Err, system-signal=CAN4_SWC_A_Resp_Err}, {implementation-record-element=CAN4_SWC_A_HW_version, system-signal=CAN4_SWC_A_HW_version}, {implementation-record-element=CAN4_SWC_ACC_Sta, system-signal=CAN4_SWC_ACC_Sta}, {implementation-record-element=CAN4_SWC2_SW_Version, system-signal=CAN4_SWC2_SW_Version}, {implementation-record-element=CAN4_SWC2_ResponseError, system-signal=CAN4_SWC2_ResponseError}, {implementation-record-element=CAN4_SWC2_R_VR_Sta, system-signal=CAN4_SWC2_R_VR_Sta}, {implementation-record-element=CAN4_SWC2_R_ScrollUp_Sta, system-signal=CAN4_SWC2_R_ScrollUp_Sta}, {implementation-record-element=CAN4_SWC2_R_ScrollPress_Sta, system-signal=CAN4_SWC2_R_ScrollPress_Sta}, {implementation-record-element=CAN4_SWC2_R_ScrollDown_Sta, system-signal=CAN4_SWC2_R_ScrollDown_Sta}, {implementation-record-element=CAN4_SWC2_R_Right_Sta, system-signal=CAN4_SWC2_R_Right_Sta}, {implementation-record-element=CAN4_SWC2_R_RegenDown_Sta, system-signal=CAN4_SWC2_R_RegenDown_Sta}, {implementation-record-element=CAN4_SWC2_R_PageSwitch_Sta, system-signal=CAN4_SWC2_R_PageSwitch_Sta}, {implementation-record-element=CAN4_SWC2_R_Left_Sta, system-signal=CAN4_SWC2_R_Left_Sta}, {implementation-record-element=CAN4_SWC2_R_Customize_Sta, system-signal=CAN4_SWC2_R_Customize_Sta}, {implementation-record-element=CAN4_SWC2_L_ScrollUp_Sta, system-signal=CAN4_SWC2_L_ScrollUp_Sta}, {implementation-record-element=CAN4_SWC2_L_ScrollPress_Sta, system-signal=CAN4_SWC2_L_ScrollPress_Sta}, {implementation-record-element=CAN4_SWC2_L_ScrollDown_Sta, system-signal=CAN4_SWC2_L_ScrollDown_Sta}, {implementation-record-element=CAN4_SWC2_L_Right_Sta, system-signal=CAN4_SWC2_L_Right_Sta}, {implementation-record-element=CAN4_SWC2_L_RegenUp_Sta, system-signal=CAN4_SWC2_L_RegenUp_Sta}, {implementation-record-element=CAN4_SWC2_L_Left_Sta, system-signal=CAN4_SWC2_L_Left_Sta}, {implementation-record-element=CAN4_SWC2_L_Home_Sta, system-signal=CAN4_SWC2_L_Home_Sta}, {implementation-record-element=CAN4_SWC2_L_DriveMode_Sta, system-signal=CAN4_SWC2_L_DriveMode_Sta}, {implementation-record-element=CAN4_SWC2_L_ADAS_Sta, system-signal=CAN4_SWC2_L_ADAS_Sta}, {implementation-record-element=CAN4_SWC2_HW_Version, system-signal=CAN4_SWC2_HW_Version}, {implementation-record-element=CAN4_RLS_RainSnrWiperCmd, system-signal=CAN4_RLS_RainSnrWiperCmd}, {implementation-record-element=CAN4_RLS_RainSnrErr, system-signal=CAN4_RLS_RainSnrErr}, {implementation-record-element=CAN4_RLS_LightSnrErr, system-signal=CAN4_RLS_LightSnrErr}, {implementation-record-element=CAN4_RLS_Lamp_Sta, system-signal=CAN4_RLS_Lamp_Sta}, {implementation-record-element=CAN4_RLS_LIN_Resp_Err, system-signal=CAN4_RLS_LIN_Resp_Err}, {implementation-record-element=CAN4_RAPWL_01_LIN_Response_Error, system-signal=CAN4_RAPWL_01_LIN_Response_Error}, {implementation-record-element=CAN4_L_RRD_Wdw_Running_Sts, system-signal=CAN4_L_RRD_Wdw_Running_Sts}, {implementation-record-element=CAN4_L_RRD_Wdw_PositionSts, system-signal=CAN4_L_RRD_Wdw_PositionSts}, {implementation-record-element=CAN4_L_RRD_Wdw_Obs_InhibitSts, system-signal=CAN4_L_RRD_Wdw_Obs_InhibitSts}, {implementation-record-element=CAN4_L_RRD_Wdw_OD_Sts, system-signal=CAN4_L_RRD_Wdw_OD_Sts}, {implementation-record-element=CAN4_L_RRD_Wdw_LocalSwitch, system-signal=CAN4_L_RRD_Wdw_LocalSwitch}, {implementation-record-element=CAN4_L_RRD_Wdw_Init, system-signal=CAN4_L_RRD_Wdw_Init}, {implementation-record-element=CAN4_L_RRD_Val_Wdw_Opened, system-signal=CAN4_L_RRD_Val_Wdw_Opened}, {implementation-record-element=CAN4_L_RRD_OverHeat_Protect, system-signal=CAN4_L_RRD_OverHeat_Protect}, {implementation-record-element=CAN4_L_RRD_Motor_Ripple_Error, system-signal=CAN4_L_RRD_Motor_Ripple_Error}, {implementation-record-element=CAN4_L_RRD_Motor_Relay_Error, system-signal=CAN4_L_RRD_Motor_Relay_Error}, {implementation-record-element=CAN4_L_RLD_Wdw_Running_Sts, system-signal=CAN4_L_RLD_Wdw_Running_Sts}, {implementation-record-element=CAN4_L_RLD_Wdw_PositionSts, system-signal=CAN4_L_RLD_Wdw_PositionSts}, {implementation-record-element=CAN4_L_RLD_Wdw_Obs_InhibitSts, system-signal=CAN4_L_RLD_Wdw_Obs_InhibitSts}, {implementation-record-element=CAN4_L_RLD_Wdw_OD_Sts, system-signal=CAN4_L_RLD_Wdw_OD_Sts}, {implementation-record-element=CAN4_L_RLD_Wdw_LocalSwitch, system-signal=CAN4_L_RLD_Wdw_LocalSwitch}, {implementation-record-element=CAN4_L_RLD_Wdw_Init, system-signal=CAN4_L_RLD_Wdw_Init}, {implementation-record-element=CAN4_L_RLD_Val_Wdw_Opened, system-signal=CAN4_L_RLD_Val_Wdw_Opened}, {implementation-record-element=CAN4_L_RLD_OverHeat_Protect, system-signal=CAN4_L_RLD_OverHeat_Protect}, {implementation-record-element=CAN4_L_RLD_Motor_Ripple_Error, system-signal=CAN4_L_RLD_Motor_Ripple_Error}, {implementation-record-element=CAN4_L_RLD_Motor_Relay_Error, system-signal=CAN4_L_RLD_Motor_Relay_Error}, {implementation-record-element=CAN4_L_Power_Status, system-signal=CAN4_L_Power_Status}, {implementation-record-element=CAN4_L_Pas_Wdw_Running_Sts, system-signal=CAN4_L_Pas_Wdw_Running_Sts}, {implementation-record-element=CAN4_L_Pas_Wdw_PositionSts, system-signal=CAN4_L_Pas_Wdw_PositionSts}, {implementation-record-element=CAN4_L_Pas_Wdw_Obs_InhibitSts, system-signal=CAN4_L_Pas_Wdw_Obs_InhibitSts}, {implementation-record-element=CAN4_L_Pas_Wdw_OD_Sts, system-signal=CAN4_L_Pas_Wdw_OD_Sts}, {implementation-record-element=CAN4_L_Pas_Wdw_LocalSwitch, system-signal=CAN4_L_Pas_Wdw_LocalSwitch}, {implementation-record-element=CAN4_L_Pas_Wdw_Init, system-signal=CAN4_L_Pas_Wdw_Init}, {implementation-record-element=CAN4_L_Pas_Val_Wdw_Opened, system-signal=CAN4_L_Pas_Val_Wdw_Opened}, {implementation-record-element=CAN4_L_Pas_OverHeat_Protect, system-signal=CAN4_L_Pas_OverHeat_Protect}, {implementation-record-element=CAN4_L_Pas_Motor_Ripple_Error, system-signal=CAN4_L_Pas_Motor_Ripple_Error}, {implementation-record-element=CAN4_L_Pas_Motor_Relay_Error, system-signal=CAN4_L_Pas_Motor_Relay_Error}, {implementation-record-element=CAN4_L_Drv_Wdw_Running_Sts, system-signal=CAN4_L_Drv_Wdw_Running_Sts}, {implementation-record-element=CAN4_L_Drv_Wdw_RRD_Switch, system-signal=CAN4_L_Drv_Wdw_RRD_Switch}, {implementation-record-element=CAN4_L_Drv_Wdw_RLD_Switch, system-signal=CAN4_L_Drv_Wdw_RLD_Switch}, {implementation-record-element=CAN4_L_Drv_Wdw_PositionSts, system-signal=CAN4_L_Drv_Wdw_PositionSts}, {implementation-record-element=CAN4_L_Drv_Wdw_Pas_Switch, system-signal=CAN4_L_Drv_Wdw_Pas_Switch}, {implementation-record-element=CAN4_L_Drv_Wdw_Obs_InhibitSts, system-signal=CAN4_L_Drv_Wdw_Obs_InhibitSts}, {implementation-record-element=CAN4_L_Drv_Wdw_OD_Sts, system-signal=CAN4_L_Drv_Wdw_OD_Sts}, {implementation-record-element=CAN4_L_Drv_Wdw_LocalSwitch, system-signal=CAN4_L_Drv_Wdw_LocalSwitch}, {implementation-record-element=CAN4_L_Drv_Wdw_Init, system-signal=CAN4_L_Drv_Wdw_Init}, {implementation-record-element=CAN4_L_Drv_Val_Wdw_Opened, system-signal=CAN4_L_Drv_Val_Wdw_Opened}, {implementation-record-element=CAN4_L_Drv_OverHeat_Protect, system-signal=CAN4_L_Drv_OverHeat_Protect}, {implementation-record-element=CAN4_L_Drv_Motor_Ripple_Error, system-signal=CAN4_L_Drv_Motor_Ripple_Error}, {implementation-record-element=CAN4_L_Drv_Motor_Relay_Error, system-signal=CAN4_L_Drv_Motor_Relay_Error}, {implementation-record-element=CAN4_FAPWL_01_LIN_Response_Error, system-signal=CAN4_FAPWL_01_LIN_Response_Error}, {implementation-record-element=CAN4_CSW_resp_error, system-signal=CAN4_CSW_resp_error}, {implementation-record-element=CAN4_CSW_TurnSw_Sta, system-signal=CAN4_CSW_TurnSw_Sta}, {implementation-record-element=CAN4_CSW_SW_version, system-signal=CAN4_CSW_SW_version}, {implementation-record-element=CAN4_CSW_RWipIntSw_Sta, system-signal=CAN4_CSW_RWipIntSw_Sta}, {implementation-record-element=CAN4_CSW_RWasSW_Sta, system-signal=CAN4_CSW_RWasSW_Sta}, {implementation-record-element=CAN4_CSW_PassSW_Sta, system-signal=CAN4_CSW_PassSW_Sta}, {implementation-record-element=CAN4_CSW_HW_version, system-signal=CAN4_CSW_HW_version}, {implementation-record-element=CAN4_CSW_FWipSw_Sta, system-signal=CAN4_CSW_FWipSw_Sta}, {implementation-record-element=CAN4_CSW_FWasSw_Sta, system-signal=CAN4_CSW_FWasSw_Sta}]}
      MAP_R_CAN5_TBOX1: sender-receiver-to-signal-group-mapping{communication-direction=IN, data-element=SWC_FDC.root_FDC.R_CAN5_TBOX1.CAN5_SG_TBOX1, signal-group=CAN5_SG_TBOX1, type-mapping=sender-rec-record-type-mapping=record-element-mappings=[{implementation-record-element=CAN5_Antitheft_Zero, system-signal=CAN5_Antitheft_Zero}, {implementation-record-element=CAN5_Uncounting_Req, system-signal=CAN5_Uncounting_Req}, {implementation-record-element=CAN5_TBOX_TEST_STATUS, system-signal=CAN5_TBOX_TEST_STATUS}, {implementation-record-element=CAN5_TBOX_Remote_PW, system-signal=CAN5_TBOX_Remote_PW}, {implementation-record-element=CAN5_TBOX_RemoteOn, system-signal=CAN5_TBOX_RemoteOn}, {implementation-record-element=CAN5_TBOX_Re_VehData, system-signal=CAN5_TBOX_Re_VehData}, {implementation-record-element=CAN5_TBOX_Re_DTCData, system-signal=CAN5_TBOX_Re_DTCData}, {implementation-record-element=CAN5_TBOX_NET_SIG_STR, system-signal=CAN5_TBOX_NET_SIG_STR}, {implementation-record-element=CAN5_Remote_MidAutoReq, system-signal=CAN5_Remote_MidAutoReq}, {implementation-record-element=CAN5_Remote_AutoReq, system-signal=CAN5_Remote_AutoReq}, {implementation-record-element=CAN5_Remote_ACTemp, system-signal=CAN5_Remote_ACTemp}, {implementation-record-element=CAN5_Re_Radio, system-signal=CAN5_Re_Radio}, {implementation-record-element=CAN5_Re_PwrReqTbox, system-signal=CAN5_Re_PwrReqTbox}, {implementation-record-element=CAN5_Re_DoorLock, system-signal=CAN5_Re_DoorLock}, {implementation-record-element=CAN5_ReOutsideMirror, system-signal=CAN5_ReOutsideMirror}, {implementation-record-element=CAN5_PowerOff_T_Set, system-signal=CAN5_PowerOff_T_Set}, {implementation-record-element=CAN5_CbnPreTarT, system-signal=CAN5_CbnPreTarT}, {implementation-record-element=CAN5_CbnPreReq, system-signal=CAN5_CbnPreReq}, {implementation-record-element=CAN5_CbnPreACEnaReq, system-signal=CAN5_CbnPreACEnaReq}]}
      MAP_R_CAN5_TBOX2: sender-receiver-to-signal-group-mapping{communication-direction=IN, data-element=SWC_FDC.root_FDC.R_CAN5_TBOX2.CAN5_SG_TBOX2, signal-group=CAN5_SG_TBOX2, type-mapping=sender-rec-record-type-mapping=record-element-mappings=[{implementation-record-element=CAN5_TimeSyncFromBS_Day, system-signal=CAN5_TimeSyncFromBS_Day}, {implementation-record-element=CAN5_TimeSyncFromBS_Year, system-signal=CAN5_TimeSyncFromBS_Year}, {implementation-record-element=CAN5_TimeSyncFromBS_Second, system-signal=CAN5_TimeSyncFromBS_Second}, {implementation-record-element=CAN5_TimeSyncFromBS_Month, system-signal=CAN5_TimeSyncFromBS_Month}, {implementation-record-element=CAN5_TimeSyncFromBS_Minute, system-signal=CAN5_TimeSyncFromBS_Minute}, {implementation-record-element=CAN5_TimeSyncFromBS_Hour, system-signal=CAN5_TimeSyncFromBS_Hour}]}
      MAP_R_CAN5_TBOX3: sender-receiver-to-signal-group-mapping{communication-direction=IN, data-element=SWC_FDC.root_FDC.R_CAN5_TBOX3.CAN5_SG_TBOX3, signal-group=CAN5_SG_TBOX3, type-mapping=sender-rec-record-type-mapping=record-element-mappings=[{implementation-record-element=CAN5_Charge_Percent_Set, system-signal=CAN5_Charge_Percent_Set}, {implementation-record-element=CAN5_TBOX_SW_VER, system-signal=CAN5_TBOX_SW_VER}, {implementation-record-element=CAN5_TBOX_HW_VER, system-signal=CAN5_TBOX_HW_VER}, {implementation-record-element=CAN5_ReserveChargeOn_Year, system-signal=CAN5_ReserveChargeOn_Year}, {implementation-record-element=CAN5_ReserveChargeOn_Month, system-signal=CAN5_ReserveChargeOn_Month}, {implementation-record-element=CAN5_ReserveChargeOn_Minute, system-signal=CAN5_ReserveChargeOn_Minute}, {implementation-record-element=CAN5_ReserveChargeOn_Hour, system-signal=CAN5_ReserveChargeOn_Hour}, {implementation-record-element=CAN5_ReserveChargeOn_Day, system-signal=CAN5_ReserveChargeOn_Day}, {implementation-record-element=CAN5_ReserveChargeOFF_Year, system-signal=CAN5_ReserveChargeOFF_Year}, {implementation-record-element=CAN5_ReserveChargeOFF_Month, system-signal=CAN5_ReserveChargeOFF_Month}, {implementation-record-element=CAN5_ReserveChargeOFF_Minute, system-signal=CAN5_ReserveChargeOFF_Minute}, {implementation-record-element=CAN5_ReserveChargeOFF_Hour, system-signal=CAN5_ReserveChargeOFF_Hour}, {implementation-record-element=CAN5_ReserveChargeOFF_Day, system-signal=CAN5_ReserveChargeOFF_Day}]}
      MAP_R_CAN7_Door_Fr1: sender-receiver-to-signal-group-mapping{communication-direction=IN, data-element=SWC_FDC.root_FDC.R_CAN7_Door_Fr1.CAN7_SG_Door_Fr1, signal-group=CAN7_SG_Door_Fr1, type-mapping=sender-rec-record-type-mapping=record-element-mappings=[{implementation-record-element=CAN7_Door_Fr_DoorEmergency_sta, system-signal=CAN7_Door_Fr_DoorEmergency_sta}, {implementation-record-element=CAN7_Door_Fr_Doorposition_sta, system-signal=CAN7_Door_Fr_Doorposition_sta}, {implementation-record-element=CAN7_Door_Fr_Dooroperation_sta, system-signal=CAN7_Door_Fr_Dooroperation_sta}]}
      MAP_CGW_P_CAN2_CGW_GW2_C10_0: sender-receiver-to-signal-group-mapping{communication-direction=OUT, data-element=SWC_CGW.root_FDC.P_CAN2_CGW_GW2_C10_0.CAN2_SG_CGW_GW2_C10_0, signal-group=CAN2_SG_CGW_GW2_C10_0, type-mapping=sender-rec-record-type-mapping=record-element-mappings=[{implementation-record-element=CAN2_DCDCAuxCur, system-signal=CAN2_DCDCAuxCur}, {implementation-record-element=CAN2_Rposition_Lamp_Warning, system-signal=CAN2_Rposition_Lamp_Warning}, {implementation-record-element=CAN2_RLB_Warning, system-signal=CAN2_RLB_Warning}, {implementation-record-element=CAN2_RDRL_Warning, system-signal=CAN2_RDRL_Warning}, {implementation-record-element=CAN2_RAHB_Warning, system-signal=CAN2_RAHB_Warning}, {implementation-record-element=CAN2_RADB_Warning, system-signal=CAN2_RADB_Warning}, {implementation-record-element=CAN2_RADB_Operation_Status, system-signal=CAN2_RADB_Operation_Status}, {implementation-record-element=CAN2_RADB_Hibeam_Indication, system-signal=CAN2_RADB_Hibeam_Indication}, {implementation-record-element=CAN2_Lposition_Lamp_Warning, system-signal=CAN2_Lposition_Lamp_Warning}, {implementation-record-element=CAN2_LLB_Warning, system-signal=CAN2_LLB_Warning}, {implementation-record-element=CAN2_LDRL_Warning, system-signal=CAN2_LDRL_Warning}, {implementation-record-element=CAN2_LAHB_Warning, system-signal=CAN2_LAHB_Warning}, {implementation-record-element=CAN2_LADB_Warning, system-signal=CAN2_LADB_Warning}, {implementation-record-element=CAN2_LADB_Operation_Status, system-signal=CAN2_LADB_Operation_Status}, {implementation-record-element=CAN2_LADB_Hibeam_Indication, system-signal=CAN2_LADB_Hibeam_Indication}, {implementation-record-element=CAN2_HVBattVolt, system-signal=CAN2_HVBattVolt}, {implementation-record-element=CAN2_HVBattErr, system-signal=CAN2_HVBattErr}, {implementation-record-element=CAN2_HVBattCurr, system-signal=CAN2_HVBattCurr}, {implementation-record-element=CAN2_FrPMMLimpHomeActReq, system-signal=CAN2_FrPMMLimpHomeActReq}, {implementation-record-element=CAN2_FireDetErr, system-signal=CAN2_FireDetErr}, {implementation-record-element=CAN2_FRTurn_Light_Warning, system-signal=CAN2_FRTurn_Light_Warning}, {implementation-record-element=CAN2_FLTurn_Light_Warning, system-signal=CAN2_FLTurn_Light_Warning}, {implementation-record-element=CAN2_DrSCPSysErrLmp, system-signal=CAN2_DrSCPSysErrLmp}, {implementation-record-element=CAN2_DrPMMSysErrLmp, system-signal=CAN2_DrPMMSysErrLmp}, {implementation-record-element=CAN2_DrPMMLVOutPErrLmp, system-signal=CAN2_DrPMMLVOutPErrLmp}, {implementation-record-element=CAN2_DCDCAuxVolt, system-signal=CAN2_DCDCAuxVolt}]}
      MAP_CGW_P_CAN2_GW2_CE1000_0: sender-receiver-to-signal-group-mapping{communication-direction=OUT, data-element=SWC_CGW.root_FDC.P_CAN2_GW2_CE1000_0.CAN2_SG_GW2_CE1000_0, signal-group=CAN2_SG_GW2_CE1000_0, type-mapping=sender-rec-record-type-mapping=record-element-mappings=[{implementation-record-element=CAN2_ACChrgCurrDis, system-signal=CAN2_ACChrgCurrDis}, {implementation-record-element=CAN2_TimeSyncFromBS_Year, system-signal=CAN2_TimeSyncFromBS_Year}, {implementation-record-element=CAN2_TimeSyncFromBS_Second, system-signal=CAN2_TimeSyncFromBS_Second}, {implementation-record-element=CAN2_TimeSyncFromBS_Month, system-signal=CAN2_TimeSyncFromBS_Month}, {implementation-record-element=CAN2_TimeSyncFromBS_Minute, system-signal=CAN2_TimeSyncFromBS_Minute}, {implementation-record-element=CAN2_TimeSyncFromBS_Hour, system-signal=CAN2_TimeSyncFromBS_Hour}, {implementation-record-element=CAN2_TimeSyncFromBS_Day, system-signal=CAN2_TimeSyncFromBS_Day}, {implementation-record-element=CAN2_TBOX_SW_VER, system-signal=CAN2_TBOX_SW_VER}, {implementation-record-element=CAN2_TBOX_HW_VER, system-signal=CAN2_TBOX_HW_VER}, {implementation-record-element=CAN2_Rr_MCU3_SW_Ver_Nidec, system-signal=CAN2_Rr_MCU3_SW_Ver_Nidec}, {implementation-record-element=CAN2_Rr_MCU3_SW_Ver, system-signal=CAN2_Rr_MCU3_SW_Ver}, {implementation-record-element=CAN2_Rr_MCU3_HW_Ver_Nidec, system-signal=CAN2_Rr_MCU3_HW_Ver_Nidec}, {implementation-record-element=CAN2_Rr_MCU3_HW_Ver, system-signal=CAN2_Rr_MCU3_HW_Ver}, {implementation-record-element=CAN2_RemainChrgTime, system-signal=CAN2_RemainChrgTime}, {implementation-record-element=CAN2_HVBattSOCDis, system-signal=CAN2_HVBattSOCDis}, {implementation-record-element=CAN2_HVBattSOC, system-signal=CAN2_HVBattSOC}, {implementation-record-element=CAN2_HVBChrgPwr, system-signal=CAN2_HVBChrgPwr}, {implementation-record-element=CAN2_Charge_Percent_Set, system-signal=CAN2_Charge_Percent_Set}]}
      MAP_CGW_P_CAN2_GW2_CE100_0: sender-receiver-to-signal-group-mapping{communication-direction=OUT, data-element=SWC_CGW.root_FDC.P_CAN2_GW2_CE100_0.CAN2_SG_GW2_CE100_0, signal-group=CAN2_SG_GW2_CE100_0, type-mapping=sender-rec-record-type-mapping=record-element-mappings=[{implementation-record-element=CAN2_COMP_ActualPwr, system-signal=CAN2_COMP_ActualPwr}, {implementation-record-element=CAN2_ZFR_EChrg_Sys_Sta, system-signal=CAN2_ZFR_EChrg_Sys_Sta}, {implementation-record-element=CAN2_ZFR_EChrg_Active_Sta, system-signal=CAN2_ZFR_EChrg_Active_Sta}, {implementation-record-element=CAN2_ZFR_BCM_ChargerDoorSW_Sta, system-signal=CAN2_ZFR_BCM_ChargerDoorSW_Sta}, {implementation-record-element=CAN2_V2LSta, system-signal=CAN2_V2LSta}, {implementation-record-element=CAN2_TrailerModeSta, system-signal=CAN2_TrailerModeSta}, {implementation-record-element=CAN2_TrailerCheck, system-signal=CAN2_TrailerCheck}, {implementation-record-element=CAN2_TBOX_TEST_STATUS, system-signal=CAN2_TBOX_TEST_STATUS}, {implementation-record-element=CAN2_TBOX_NET_SIG_STR, system-signal=CAN2_TBOX_NET_SIG_STR}, {implementation-record-element=CAN2_Shifter_Handle_Cmd, system-signal=CAN2_Shifter_Handle_Cmd}, {implementation-record-element=CAN2_Shifter_Fail_sta, system-signal=CAN2_Shifter_Fail_sta}, {implementation-record-element=CAN2_SWC_mode_Sta, system-signal=CAN2_SWC_mode_Sta}, {implementation-record-element=CAN2_SWC_VR_Sta, system-signal=CAN2_SWC_VR_Sta}, {implementation-record-element=CAN2_SWC_Up_Sta, system-signal=CAN2_SWC_Up_Sta}, {implementation-record-element=CAN2_SWC_Undefined_Sta, system-signal=CAN2_SWC_Undefined_Sta}, {implementation-record-element=CAN2_SWC_Trip_Sta, system-signal=CAN2_SWC_Trip_Sta}, {implementation-record-element=CAN2_SWC_Right_Sta, system-signal=CAN2_SWC_Right_Sta}, {implementation-record-element=CAN2_SWC_RegenUp, system-signal=CAN2_SWC_RegenUp}, {implementation-record-element=CAN2_SWC_RegenDown, system-signal=CAN2_SWC_RegenDown}, {implementation-record-element=CAN2_SWC_Left_Sta, system-signal=CAN2_SWC_Left_Sta}, {implementation-record-element=CAN2_SWC_LKA_Sta, system-signal=CAN2_SWC_LKA_Sta}, {implementation-record-element=CAN2_SWC_Down_Sta, system-signal=CAN2_SWC_Down_Sta}, {implementation-record-element=CAN2_SWC_ACC_Sta, system-signal=CAN2_SWC_ACC_Sta}, {implementation-record-element=CAN2_Re_Radio, system-signal=CAN2_Re_Radio}, {implementation-record-element=CAN2_RLS_Lamp_Sta, system-signal=CAN2_RLS_Lamp_Sta}, {implementation-record-element=CAN2_P_UID_LowPower, system-signal=CAN2_P_UID_LowPower}, {implementation-record-element=CAN2_P_KeyMiss, system-signal=CAN2_P_KeyMiss}, {implementation-record-element=CAN2_P_Dkey_Show_IVI, system-signal=CAN2_P_Dkey_Show_IVI}, {implementation-record-element=CAN2_PTCActuPwrHSC6, system-signal=CAN2_PTCActuPwrHSC6}, {implementation-record-element=CAN2_OBC_AC_Cur_Lim, system-signal=CAN2_OBC_AC_Cur_Lim}, {implementation-record-element=CAN2_OBCFaultSta, system-signal=CAN2_OBCFaultSta}, {implementation-record-element=CAN2_OBCACVoltInf, system-signal=CAN2_OBCACVoltInf}, {implementation-record-element=CAN2_OBCACCurrInf, system-signal=CAN2_OBCACCurrInf}, {implementation-record-element=CAN2_OBCACCSLimit, system-signal=CAN2_OBCACCSLimit}, {implementation-record-element=CAN2_MainRlyPosSta, system-signal=CAN2_MainRlyPosSta}, {implementation-record-element=CAN2_MainRlyNegSta, system-signal=CAN2_MainRlyNegSta}, {implementation-record-element=CAN2_HVBOvrTempWarn, system-signal=CAN2_HVBOvrTempWarn}, {implementation-record-element=CAN2_HVBOvrTempErr, system-signal=CAN2_HVBOvrTempErr}, {implementation-record-element=CAN2_HVBMTempMax, system-signal=CAN2_HVBMTempMax}, {implementation-record-element=CAN2_HVBContactorSta, system-signal=CAN2_HVBContactorSta}, {implementation-record-element=CAN2_HVBChrgErr, system-signal=CAN2_HVBChrgErr}, {implementation-record-element=CAN2_FrntPTCRiActHeatPwr, system-signal=CAN2_FrntPTCRiActHeatPwr}, {implementation-record-element=CAN2_FrntPTCRearRiActHeatPwr, system-signal=CAN2_FrntPTCRearRiActHeatPwr}, {implementation-record-element=CAN2_FrntPTCRearLeActHeatPwr, system-signal=CAN2_FrntPTCRearLeActHeatPwr}, {implementation-record-element=CAN2_FrntPTCLeActHeatPwr, system-signal=CAN2_FrntPTCLeActHeatPwr}, {implementation-record-element=CAN2_FDC_BCM_TurnSw_Sta, system-signal=CAN2_FDC_BCM_TurnSw_Sta}, {implementation-record-element=CAN2_FDC_BCM_FWipSw_Sta, system-signal=CAN2_FDC_BCM_FWipSw_Sta}, {implementation-record-element=CAN2_FDC_BCM_DimSw, system-signal=CAN2_FDC_BCM_DimSw}, {implementation-record-element=CAN2_ExtChrgSta, system-signal=CAN2_ExtChrgSta}, {implementation-record-element=CAN2_DisChrgPlugErr, system-signal=CAN2_DisChrgPlugErr}, {implementation-record-element=CAN2_DKC_KeyType_Sta, system-signal=CAN2_DKC_KeyType_Sta}, {implementation-record-element=CAN2_DKC_KeyNum_Sta, system-signal=CAN2_DKC_KeyNum_Sta}, {implementation-record-element=CAN2_ChrgPlugSta, system-signal=CAN2_ChrgPlugSta}, {implementation-record-element=CAN2_ChargeInletLockSta, system-signal=CAN2_ChargeInletLockSta}, {implementation-record-element=CAN2_CbnPreACEnaReq, system-signal=CAN2_CbnPreACEnaReq}]}
      MAP_CGW_P_CAN2_GW2_CE100_1: sender-receiver-to-signal-group-mapping{communication-direction=OUT, data-element=SWC_CGW.root_FDC.P_CAN2_GW2_CE100_1.CAN2_SG_GW2_CE100_1, signal-group=CAN2_SG_GW2_CE100_1, type-mapping=sender-rec-record-type-mapping=record-element-mappings=[{implementation-record-element=CAN2_Fr_EDUDrtSta, system-signal=CAN2_Fr_EDUDrtSta}, {implementation-record-element=CAN2_SWC2_R_VR_Sta, system-signal=CAN2_SWC2_R_VR_Sta}, {implementation-record-element=CAN2_SWC2_R_ScrollUp_Sta, system-signal=CAN2_SWC2_R_ScrollUp_Sta}, {implementation-record-element=CAN2_SWC2_R_ScrollPress_Sta, system-signal=CAN2_SWC2_R_ScrollPress_Sta}, {implementation-record-element=CAN2_SWC2_R_ScrollDown_Sta, system-signal=CAN2_SWC2_R_ScrollDown_Sta}, {implementation-record-element=CAN2_SWC2_R_Right_Sta, system-signal=CAN2_SWC2_R_Right_Sta}, {implementation-record-element=CAN2_SWC2_R_PageSwitch_Sta, system-signal=CAN2_SWC2_R_PageSwitch_Sta}, {implementation-record-element=CAN2_SWC2_R_Left_Sta, system-signal=CAN2_SWC2_R_Left_Sta}, {implementation-record-element=CAN2_SWC2_R_Customize_Sta, system-signal=CAN2_SWC2_R_Customize_Sta}, {implementation-record-element=CAN2_SWC2_L_Home_Sta, system-signal=CAN2_SWC2_L_Home_Sta}, {implementation-record-element=CAN2_SWC2_L_DriveMode_Sta, system-signal=CAN2_SWC2_L_DriveMode_Sta}, {implementation-record-element=CAN2_Rr_TMTempWarn, system-signal=CAN2_Rr_TMTempWarn}, {implementation-record-element=CAN2_Rr_TMTemp, system-signal=CAN2_Rr_TMTemp}, {implementation-record-element=CAN2_Rr_TMSpd, system-signal=CAN2_Rr_TMSpd}, {implementation-record-element=CAN2_Rr_MotorAvailTq, system-signal=CAN2_Rr_MotorAvailTq}, {implementation-record-element=CAN2_Rr_MCUTempWarn, system-signal=CAN2_Rr_MCUTempWarn}, {implementation-record-element=CAN2_Rr_MCUTemp, system-signal=CAN2_Rr_MCUTemp}, {implementation-record-element=CAN2_Rr_EDURealTMTq, system-signal=CAN2_Rr_EDURealTMTq}, {implementation-record-element=CAN2_Rr_EDUDrtSta, system-signal=CAN2_Rr_EDUDrtSta}, {implementation-record-element=CAN2_MCU_B_R_LLCTempWarn_Sta, system-signal=CAN2_MCU_B_R_LLCTempWarn_Sta}, {implementation-record-element=CAN2_Fr_TMTempWarn, system-signal=CAN2_Fr_TMTempWarn}, {implementation-record-element=CAN2_Fr_TMTemp, system-signal=CAN2_Fr_TMTemp}, {implementation-record-element=CAN2_Fr_TMSpd, system-signal=CAN2_Fr_TMSpd}, {implementation-record-element=CAN2_Fr_MotorAvailTq, system-signal=CAN2_Fr_MotorAvailTq}, {implementation-record-element=CAN2_Fr_MCUTempWarn, system-signal=CAN2_Fr_MCUTempWarn}, {implementation-record-element=CAN2_Fr_MCUTemp, system-signal=CAN2_Fr_MCUTemp}, {implementation-record-element=CAN2_Fr_EDURealTMTq, system-signal=CAN2_Fr_EDURealTMTq}]}
      MAP_CGW_P_CAN2_GW2_CE100_2: sender-receiver-to-signal-group-mapping{communication-direction=OUT, data-element=SWC_CGW.root_FDC.P_CAN2_GW2_CE100_2.CAN2_SG_GW2_CE100_2, signal-group=CAN2_SG_GW2_CE100_2, type-mapping=sender-rec-record-type-mapping=record-element-mappings=[{implementation-record-element=CAN2_FAPWL_01_LIN_Response_Error, system-signal=CAN2_FAPWL_01_LIN_Response_Error}, {implementation-record-element=CAN2_Rr_TMTemp_Nidec, system-signal=CAN2_Rr_TMTemp_Nidec}, {implementation-record-element=CAN2_Rr_TMTempWarn_Nidec, system-signal=CAN2_Rr_TMTempWarn_Nidec}, {implementation-record-element=CAN2_Rr_TMSpd_Nidec, system-signal=CAN2_Rr_TMSpd_Nidec}, {implementation-record-element=CAN2_Rr_MotorAvailTq_Nidec, system-signal=CAN2_Rr_MotorAvailTq_Nidec}, {implementation-record-element=CAN2_Rr_MCUTemp_Nidec, system-signal=CAN2_Rr_MCUTemp_Nidec}, {implementation-record-element=CAN2_Rr_MCUTempWarn_Nidec, system-signal=CAN2_Rr_MCUTempWarn_Nidec}, {implementation-record-element=CAN2_Rr_EDURealTMTq_Nidec, system-signal=CAN2_Rr_EDURealTMTq_Nidec}, {implementation-record-element=CAN2_Rr_EDUDrtSta_Nidec, system-signal=CAN2_Rr_EDUDrtSta_Nidec}, {implementation-record-element=CAN2_RAPWL_01_LIN_Response_Error, system-signal=CAN2_RAPWL_01_LIN_Response_Error}, {implementation-record-element=CAN2_L_RRD_Val_Wdw_Opened, system-signal=CAN2_L_RRD_Val_Wdw_Opened}, {implementation-record-element=CAN2_L_RRD_Motor_Ripple_Error, system-signal=CAN2_L_RRD_Motor_Ripple_Error}, {implementation-record-element=CAN2_L_RRD_Motor_Relay_Error, system-signal=CAN2_L_RRD_Motor_Relay_Error}, {implementation-record-element=CAN2_L_RLD_Val_Wdw_Opened, system-signal=CAN2_L_RLD_Val_Wdw_Opened}, {implementation-record-element=CAN2_L_RLD_Motor_Ripple_Error, system-signal=CAN2_L_RLD_Motor_Ripple_Error}, {implementation-record-element=CAN2_L_RLD_Motor_Relay_Error, system-signal=CAN2_L_RLD_Motor_Relay_Error}, {implementation-record-element=CAN2_L_Pas_Val_Wdw_Opened, system-signal=CAN2_L_Pas_Val_Wdw_Opened}, {implementation-record-element=CAN2_L_Pas_Motor_Ripple_Error, system-signal=CAN2_L_Pas_Motor_Ripple_Error}, {implementation-record-element=CAN2_L_Pas_Motor_Relay_Error, system-signal=CAN2_L_Pas_Motor_Relay_Error}, {implementation-record-element=CAN2_L_Drv_Val_Wdw_Opened, system-signal=CAN2_L_Drv_Val_Wdw_Opened}, {implementation-record-element=CAN2_L_Drv_Motor_Ripple_Error, system-signal=CAN2_L_Drv_Motor_Ripple_Error}, {implementation-record-element=CAN2_L_Drv_Motor_Relay_Error, system-signal=CAN2_L_Drv_Motor_Relay_Error}]}
      MAP_CGW_P_CAN3_CGW_GW3_CE100_0: sender-receiver-to-signal-group-mapping{communication-direction=OUT, data-element=SWC_CGW.root_FDC.P_CAN3_CGW_GW3_CE100_0.CAN3_SG_CGW_GW3_CE100_0, signal-group=CAN3_SG_CGW_GW3_CE100_0, type-mapping=sender-rec-record-type-mapping=record-element-mappings=[{implementation-record-element=CAN3_AC_Chg_Cur_Set, system-signal=CAN3_AC_Chg_Cur_Set}, {implementation-record-element=CAN3_Sched_Chg_limit, system-signal=CAN3_Sched_Chg_limit}, {implementation-record-element=CAN3_Sched_Chg_butt, system-signal=CAN3_Sched_Chg_butt}, {implementation-record-element=CAN3_Sched_Chg_Stop, system-signal=CAN3_Sched_Chg_Stop}, {implementation-record-element=CAN3_Sched_Chg_Start, system-signal=CAN3_Sched_Chg_Start}, {implementation-record-element=CAN3_SOC_V2LLimit, system-signal=CAN3_SOC_V2LLimit}, {implementation-record-element=CAN3_SOC_Limit_Set, system-signal=CAN3_SOC_Limit_Set}, {implementation-record-element=CAN3_SOC_ADJ_BUTT, system-signal=CAN3_SOC_ADJ_BUTT}, {implementation-record-element=CAN3_ReserveChargeOn_Year, system-signal=CAN3_ReserveChargeOn_Year}, {implementation-record-element=CAN3_ReserveChargeOn_Month, system-signal=CAN3_ReserveChargeOn_Month}, {implementation-record-element=CAN3_ReserveChargeOn_Minute, system-signal=CAN3_ReserveChargeOn_Minute}, {implementation-record-element=CAN3_ReserveChargeOn_Hour, system-signal=CAN3_ReserveChargeOn_Hour}, {implementation-record-element=CAN3_ReserveChargeOn_Day, system-signal=CAN3_ReserveChargeOn_Day}, {implementation-record-element=CAN3_ReserveChargeOFF_Year, system-signal=CAN3_ReserveChargeOFF_Year}, {implementation-record-element=CAN3_ReserveChargeOFF_Month, system-signal=CAN3_ReserveChargeOFF_Month}, {implementation-record-element=CAN3_ReserveChargeOFF_Minute, system-signal=CAN3_ReserveChargeOFF_Minute}, {implementation-record-element=CAN3_ReserveChargeOFF_Hour, system-signal=CAN3_ReserveChargeOFF_Hour}, {implementation-record-element=CAN3_ReserveChargeOFF_Day, system-signal=CAN3_ReserveChargeOFF_Day}, {implementation-record-element=CAN3_Perd_V2L, system-signal=CAN3_Perd_V2L}, {implementation-record-element=CAN3_PTC1_PowerConsumption, system-signal=CAN3_PTC1_PowerConsumption}, {implementation-record-element=CAN3_IVI_Unlock_Chg_req, system-signal=CAN3_IVI_Unlock_Chg_req}, {implementation-record-element=CAN3_IVI_Time_Second, system-signal=CAN3_IVI_Time_Second}, {implementation-record-element=CAN3_IVI_Time_Month, system-signal=CAN3_IVI_Time_Month}, {implementation-record-element=CAN3_IVI_Time_Minute, system-signal=CAN3_IVI_Time_Minute}, {implementation-record-element=CAN3_IVI_Time_Hour, system-signal=CAN3_IVI_Time_Hour}, {implementation-record-element=CAN3_IVI_Time_Day, system-signal=CAN3_IVI_Time_Day}, {implementation-record-element=CAN3_IVI_Stop_Chg_req, system-signal=CAN3_IVI_Stop_Chg_req}, {implementation-record-element=CAN3_IVI_Start_Chg_req, system-signal=CAN3_IVI_Start_Chg_req}, {implementation-record-element=CAN3_IVI_Req_V2L, system-signal=CAN3_IVI_Req_V2L}, {implementation-record-element=CAN3_Charge_Percent_Set, system-signal=CAN3_Charge_Percent_Set}, {implementation-record-element=CAN3_ChargeInletLockSta, system-signal=CAN3_ChargeInletLockSta}, {implementation-record-element=CAN3_COMP_ConVolt, system-signal=CAN3_COMP_ConVolt}, {implementation-record-element=CAN3_COMP_ConCur, system-signal=CAN3_COMP_ConCur}, {implementation-record-element=CAN3_COMP_ActualPwr, system-signal=CAN3_COMP_ActualPwr}]}
      MAP_CGW_P_CAN4_CGW_GW4_CE100_0: sender-receiver-to-signal-group-mapping{communication-direction=OUT, data-element=SWC_CGW.root_FDC.P_CAN4_CGW_GW4_CE100_0.CAN4_SG_CGW_GW4_CE100_0, signal-group=CAN4_SG_CGW_GW4_CE100_0, type-mapping=sender-rec-record-type-mapping=record-element-mappings=[{implementation-record-element=CAN4_AVM_parking_excute, system-signal=CAN4_AVM_parking_excute}, {implementation-record-element=CAN4_WlcmLight_Mode, system-signal=CAN4_WlcmLight_Mode}, {implementation-record-element=CAN4_Walkaway_Lock_SW, system-signal=CAN4_Walkaway_Lock_SW}, {implementation-record-element=CAN4_V2LSta, system-signal=CAN4_V2LSta}, {implementation-record-element=CAN4_TBOX_Remote_PW, system-signal=CAN4_TBOX_Remote_PW}, {implementation-record-element=CAN4_SenstivityPosition, system-signal=CAN4_SenstivityPosition}, {implementation-record-element=CAN4_PSEAT_vent_req, system-signal=CAN4_PSEAT_vent_req}, {implementation-record-element=CAN4_OFF_AC_MODE, system-signal=CAN4_OFF_AC_MODE}, {implementation-record-element=CAN4_OBCV2LSta, system-signal=CAN4_OBCV2LSta}, {implementation-record-element=CAN4_METER_KPH_Calcu, system-signal=CAN4_METER_KPH_Calcu}, {implementation-record-element=CAN4_Light_ShowStop_Req, system-signal=CAN4_Light_ShowStop_Req}, {implementation-record-element=CAN4_Light_ShowStart_Req, system-signal=CAN4_Light_ShowStart_Req}, {implementation-record-element=CAN4_IVI_TrailerModeSW_Sta, system-signal=CAN4_IVI_TrailerModeSW_Sta}, {implementation-record-element=CAN4_IVI_TrailerCheckReq_Sta, system-signal=CAN4_IVI_TrailerCheckReq_Sta}, {implementation-record-element=CAN4_IVI_Time_Year, system-signal=CAN4_IVI_Time_Year}, {implementation-record-element=CAN4_IVI_Time_Second, system-signal=CAN4_IVI_Time_Second}, {implementation-record-element=CAN4_IVI_Time_Month, system-signal=CAN4_IVI_Time_Month}, {implementation-record-element=CAN4_IVI_Time_Minute, system-signal=CAN4_IVI_Time_Minute}, {implementation-record-element=CAN4_IVI_Time_Hour, system-signal=CAN4_IVI_Time_Hour}, {implementation-record-element=CAN4_IVI_Time_Day, system-signal=CAN4_IVI_Time_Day}, {implementation-record-element=CAN4_IVI_Time_Check, system-signal=CAN4_IVI_Time_Check}, {implementation-record-element=CAN4_IVI_PTG_Sta_SW, system-signal=CAN4_IVI_PTG_Sta_SW}, {implementation-record-element=CAN4_IVI_PTG_Open_Height, system-signal=CAN4_IVI_PTG_Open_Height}, {implementation-record-element=CAN4_IVI_PTG_Mode_SW, system-signal=CAN4_IVI_PTG_Mode_SW}, {implementation-record-element=CAN4_IVI_PSEATHeater_Cmd, system-signal=CAN4_IVI_PSEATHeater_Cmd}, {implementation-record-element=CAN4_IVI_Located_STA, system-signal=CAN4_IVI_Located_STA}, {implementation-record-element=CAN4_IVI_ISA_OffsetSpd, system-signal=CAN4_IVI_ISA_OffsetSpd}, {implementation-record-element=CAN4_IVI_DSEATHeater_Cmd, system-signal=CAN4_IVI_DSEATHeater_Cmd}, {implementation-record-element=CAN4_IVI_ChargePortSW_Sta, system-signal=CAN4_IVI_ChargePortSW_Sta}, {implementation-record-element=CAN4_Hood_Latch_SW, system-signal=CAN4_Hood_Latch_SW}, {implementation-record-element=CAN4_HeadLampSW, system-signal=CAN4_HeadLampSW}, {implementation-record-element=CAN4_ExtChrgSta, system-signal=CAN4_ExtChrgSta}, {implementation-record-element=CAN4_Distance_unit, system-signal=CAN4_Distance_unit}, {implementation-record-element=CAN4_DSEAT_vent_req, system-signal=CAN4_DSEAT_vent_req}, {implementation-record-element=CAN4_DSEAT_entryfun_set, system-signal=CAN4_DSEAT_entryfun_set}, {implementation-record-element=CAN4_DSEAT_anti_set, system-signal=CAN4_DSEAT_anti_set}, {implementation-record-element=CAN4_ChrgPlugSta, system-signal=CAN4_ChrgPlugSta}, {implementation-record-element=CAN4_ChrgInLockReq, system-signal=CAN4_ChrgInLockReq}, {implementation-record-element=CAN4_Approach_Unlock_SW, system-signal=CAN4_Approach_Unlock_SW}]}
      MAP_CGW_P_CAN4_GW4_CE200_0: sender-receiver-to-signal-group-mapping{communication-direction=OUT, data-element=SWC_CGW.root_FDC.P_CAN4_GW4_CE200_0.CAN4_SG_GW4_CE200_0, signal-group=CAN4_SG_GW4_CE200_0, type-mapping=sender-rec-record-type-mapping=record-element-mappings=[{implementation-record-element=CAN4_IVI_LSEATvent_Cmd, system-signal=CAN4_IVI_LSEATvent_Cmd}, {implementation-record-element=CAN4_IVI_RSEATvent_Cmd, system-signal=CAN4_IVI_RSEATvent_Cmd}, {implementation-record-element=CAN4_IVI_MRZeroGravity_Cmd, system-signal=CAN4_IVI_MRZeroGravity_Cmd}, {implementation-record-element=CAN4_IVI_MRSlider_Cmd, system-signal=CAN4_IVI_MRSlider_Cmd}, {implementation-record-element=CAN4_IVI_MRSldRestore_Cmd, system-signal=CAN4_IVI_MRSldRestore_Cmd}, {implementation-record-element=CAN4_IVI_MRSeatLift_Cmd, system-signal=CAN4_IVI_MRSeatLift_Cmd}, {implementation-record-element=CAN4_IVI_MRSEATvent_Cmd, system-signal=CAN4_IVI_MRSEATvent_Cmd}, {implementation-record-element=CAN4_IVI_MRRestore_Cmd, system-signal=CAN4_IVI_MRRestore_Cmd}, {implementation-record-element=CAN4_IVI_MRRecliner_Cmd, system-signal=CAN4_IVI_MRRecliner_Cmd}, {implementation-record-element=CAN4_IVI_MRNapMode_Cmd, system-signal=CAN4_IVI_MRNapMode_Cmd}, {implementation-record-element=CAN4_IVI_MRFootLift_Cmd, system-signal=CAN4_IVI_MRFootLift_Cmd}, {implementation-record-element=CAN4_IVI_MRFMost_Cmd, system-signal=CAN4_IVI_MRFMost_Cmd}, {implementation-record-element=CAN4_IVI_MLZeroGravity_Cmd, system-signal=CAN4_IVI_MLZeroGravity_Cmd}, {implementation-record-element=CAN4_IVI_MLSlider_Cmd, system-signal=CAN4_IVI_MLSlider_Cmd}, {implementation-record-element=CAN4_IVI_MLSldRestore_Cmd, system-signal=CAN4_IVI_MLSldRestore_Cmd}, {implementation-record-element=CAN4_IVI_MLSeatLift_Cmd, system-signal=CAN4_IVI_MLSeatLift_Cmd}, {implementation-record-element=CAN4_IVI_MLSEATvent_Cmd, system-signal=CAN4_IVI_MLSEATvent_Cmd}, {implementation-record-element=CAN4_IVI_MLRestore_Cmd, system-signal=CAN4_IVI_MLRestore_Cmd}, {implementation-record-element=CAN4_IVI_MLRecliner_Cmd, system-signal=CAN4_IVI_MLRecliner_Cmd}, {implementation-record-element=CAN4_IVI_MLNapMode_Cmd, system-signal=CAN4_IVI_MLNapMode_Cmd}, {implementation-record-element=CAN4_IVI_MLFootLift_Cmd, system-signal=CAN4_IVI_MLFootLift_Cmd}, {implementation-record-element=CAN4_IVI_MLFMost_Cmd, system-signal=CAN4_IVI_MLFMost_Cmd}]}
      MAP_CGW_P_CAN5_CGW_GW5_CE100_0: sender-receiver-to-signal-group-mapping{communication-direction=OUT, data-element=SWC_CGW.root_FDC.P_CAN5_CGW_GW5_CE100_0.CAN5_SG_CGW_GW5_CE100_0, signal-group=CAN5_SG_CGW_GW5_CE100_0, type-mapping=sender-rec-record-type-mapping=record-element-mappings=[{implementation-record-element=CAN5_L_Drv_Val_Wdw_Opened, system-signal=CAN5_L_Drv_Val_Wdw_Opened}, {implementation-record-element=CAN5_L_RRD_Wdw_PositionSts, system-signal=CAN5_L_RRD_Wdw_PositionSts}, {implementation-record-element=CAN5_L_RRD_Val_Wdw_Opened, system-signal=CAN5_L_RRD_Val_Wdw_Opened}, {implementation-record-element=CAN5_L_RLD_Wdw_PositionSts, system-signal=CAN5_L_RLD_Wdw_PositionSts}, {implementation-record-element=CAN5_L_RLD_Val_Wdw_Opened, system-signal=CAN5_L_RLD_Val_Wdw_Opened}, {implementation-record-element=CAN5_L_Pas_Wdw_PositionSts, system-signal=CAN5_L_Pas_Wdw_PositionSts}, {implementation-record-element=CAN5_L_Pas_Val_Wdw_Opened, system-signal=CAN5_L_Pas_Val_Wdw_Opened}, {implementation-record-element=CAN5_L_Drv_Wdw_PositionSts, system-signal=CAN5_L_Drv_Wdw_PositionSts}]}
      MAP_CGW_R_CAN2_IVI1: sender-receiver-to-signal-group-mapping{communication-direction=IN, data-element=SWC_CGW.root_FDC.R_CAN2_IVI1.CAN2_SG_IVI1, signal-group=CAN2_SG_IVI1, type-mapping=sender-rec-record-type-mapping=record-element-mappings=[{implementation-record-element=CAN2_A2B_Node_sta, system-signal=CAN2_A2B_Node_sta}, {implementation-record-element=CAN2_mFRD_link_Sta, system-signal=CAN2_mFRD_link_Sta}, {implementation-record-element=CAN2_VehACModReq, system-signal=CAN2_VehACModReq}, {implementation-record-element=CAN2_UserSet, system-signal=CAN2_UserSet}, {implementation-record-element=CAN2_Upd_Countdown_Skip, system-signal=CAN2_Upd_Countdown_Skip}, {implementation-record-element=CAN2_Upd_Countdown_Cancel, system-signal=CAN2_Upd_Countdown_Cancel}, {implementation-record-element=CAN2_SmartEco_Mode_SW, system-signal=CAN2_SmartEco_Mode_SW}, {implementation-record-element=CAN2_Sched_OTA_wake, system-signal=CAN2_Sched_OTA_wake}, {implementation-record-element=CAN2_Sched_Chg_St_Time_Min, system-signal=CAN2_Sched_Chg_St_Time_Min}, {implementation-record-element=CAN2_Sched_Chg_St_Time_HR, system-signal=CAN2_Sched_Chg_St_Time_HR}, {implementation-record-element=CAN2_Sched_Chg_End_Time_Min, system-signal=CAN2_Sched_Chg_End_Time_Min}, {implementation-record-element=CAN2_Sched_Chg_End_Time_HR, system-signal=CAN2_Sched_Chg_End_Time_HR}, {implementation-record-element=CAN2_Sched_Chg_Day_Set, system-signal=CAN2_Sched_Chg_Day_Set}, {implementation-record-element=CAN2_Re_Radio_Sta, system-signal=CAN2_Re_Radio_Sta}, {implementation-record-element=CAN2_PW_CONTINUE_USE, system-signal=CAN2_PW_CONTINUE_USE}, {implementation-record-element=CAN2_PW_CLOSE_IMD, system-signal=CAN2_PW_CLOSE_IMD}, {implementation-record-element=CAN2_OpenDrOpenWdo_SW, system-signal=CAN2_OpenDrOpenWdo_SW}, {implementation-record-element=CAN2_OTA_UpdStart_Req, system-signal=CAN2_OTA_UpdStart_Req}, {implementation-record-element=CAN2_OTA_SuspendDL_Req, system-signal=CAN2_OTA_SuspendDL_Req}, {implementation-record-element=CAN2_OTA_DL_Req, system-signal=CAN2_OTA_DL_Req}, {implementation-record-element=CAN2_OTA_CompNTFY_Pres, system-signal=CAN2_OTA_CompNTFY_Pres}, {implementation-record-element=CAN2_OTA_CancelDL_Req, system-signal=CAN2_OTA_CancelDL_Req}, {implementation-record-element=CAN2_LINKtoDrive, system-signal=CAN2_LINKtoDrive}, {implementation-record-element=CAN2_IVI_sigScreenReq_Sta, system-signal=CAN2_IVI_sigScreenReq_Sta}, {implementation-record-element=CAN2_IVI_Time_Year, system-signal=CAN2_IVI_Time_Year}, {implementation-record-element=CAN2_IVI_Time_Second, system-signal=CAN2_IVI_Time_Second}, {implementation-record-element=CAN2_IVI_Time_Month, system-signal=CAN2_IVI_Time_Month}, {implementation-record-element=CAN2_IVI_Time_Minute, system-signal=CAN2_IVI_Time_Minute}, {implementation-record-element=CAN2_IVI_Time_Hour, system-signal=CAN2_IVI_Time_Hour}, {implementation-record-element=CAN2_IVI_Time_Day, system-signal=CAN2_IVI_Time_Day}, {implementation-record-element=CAN2_IVI_Time_Check, system-signal=CAN2_IVI_Time_Check}, {implementation-record-element=CAN2_IVI_SWC_VibMode_Sta, system-signal=CAN2_IVI_SWC_VibMode_Sta}, {implementation-record-element=CAN2_IVI_QuickRefresh_Sta, system-signal=CAN2_IVI_QuickRefresh_Sta}, {implementation-record-element=CAN2_IVI_OTA_Upd_Sta, system-signal=CAN2_IVI_OTA_Upd_Sta}, {implementation-record-element=CAN2_IVI_NAVI_Foreground_Sta, system-signal=CAN2_IVI_NAVI_Foreground_Sta}, {implementation-record-element=CAN2_IVI_Lock_SoundSW_Sta, system-signal=CAN2_IVI_Lock_SoundSW_Sta}, {implementation-record-element=CAN2_IVI_Located_STA, system-signal=CAN2_IVI_Located_STA}, {implementation-record-element=CAN2_IVI_LinkKey_Sta, system-signal=CAN2_IVI_LinkKey_Sta}, {implementation-record-element=CAN2_IVI_LinkAcc_Sta, system-signal=CAN2_IVI_LinkAcc_Sta}, {implementation-record-element=CAN2_IVI_LinkAccReq_Sta, system-signal=CAN2_IVI_LinkAccReq_Sta}, {implementation-record-element=CAN2_IVI_HMI_Undefined_Sta, system-signal=CAN2_IVI_HMI_Undefined_Sta}, {implementation-record-element=CAN2_IVI_FrTrunk_UnlockReq_Sta, system-signal=CAN2_IVI_FrTrunk_UnlockReq_Sta}, {implementation-record-element=CAN2_IVI_DelAccReq_Sta, system-signal=CAN2_IVI_DelAccReq_Sta}, {implementation-record-element=CAN2_IVI_DSEAT_anti_set_Sta, system-signal=CAN2_IVI_DSEAT_anti_set_Sta}, {implementation-record-element=CAN2_IVI_DMS_SW_Sta, system-signal=CAN2_IVI_DMS_SW_Sta}, {implementation-record-element=CAN2_IVI_CreateAccReq_Sta, system-signal=CAN2_IVI_CreateAccReq_Sta}, {implementation-record-element=CAN2_IVI_CLWin_LockDoorSW_Sta, system-signal=CAN2_IVI_CLWin_LockDoorSW_Sta}, {implementation-record-element=CAN2_IVI_AutoTheme_But_Sta, system-signal=CAN2_IVI_AutoTheme_But_Sta}, {implementation-record-element=CAN2_IVI_AirRefresh_ByDMS_Sta, system-signal=CAN2_IVI_AirRefresh_ByDMS_Sta}, {implementation-record-element=CAN2_FCP_MidEvt_BtnAutoReq, system-signal=CAN2_FCP_MidEvt_BtnAutoReq}, {implementation-record-element=CAN2_FCP_FrEvt_BtnSyncReq, system-signal=CAN2_FCP_FrEvt_BtnSyncReq}, {implementation-record-element=CAN2_FCP_FrEvt_BtnAutoReq, system-signal=CAN2_FCP_FrEvt_BtnAutoReq}, {implementation-record-element=CAN2_FCP_FrEvt_BtnACReq, system-signal=CAN2_FCP_FrEvt_BtnACReq}, {implementation-record-element=CAN2_FCP_FrEvt_BtnACMaxReq, system-signal=CAN2_FCP_FrEvt_BtnACMaxReq}, {implementation-record-element=CAN2_BrkAbn_GoReady_SW, system-signal=CAN2_BrkAbn_GoReady_SW}, {implementation-record-element=CAN2_AmbLight_WlcmLight_SW, system-signal=CAN2_AmbLight_WlcmLight_SW}, {implementation-record-element=CAN2_AmbLight_SW, system-signal=CAN2_AmbLight_SW}, {implementation-record-element=CAN2_AmbLight_DimInDark_SW, system-signal=CAN2_AmbLight_DimInDark_SW}, {implementation-record-element=CAN2_AmbLightColorSet, system-signal=CAN2_AmbLightColorSet}, {implementation-record-element=CAN2_AmbLightBrightnessSet, system-signal=CAN2_AmbLightBrightnessSet}, {implementation-record-element=CAN2_AmbLigh_SafetyAlert_SW, system-signal=CAN2_AmbLigh_SafetyAlert_SW}, {implementation-record-element=CAN2_AmbLigh_LowBatAlert_SW, system-signal=CAN2_AmbLigh_LowBatAlert_SW}]}
      MAP_CGW_R_CAN2_IVI2: sender-receiver-to-signal-group-mapping{communication-direction=IN, data-element=SWC_CGW.root_FDC.R_CAN2_IVI2.CAN2_SG_IVI2, signal-group=CAN2_SG_IVI2, type-mapping=sender-rec-record-type-mapping=record-element-mappings=[{implementation-record-element=CAN2_AC_Chg_Cur_Set, system-signal=CAN2_AC_Chg_Cur_Set}, {implementation-record-element=CAN2_sigWindDirZon3Req, system-signal=CAN2_sigWindDirZon3Req}, {implementation-record-element=CAN2_sigSetTempZon3Req, system-signal=CAN2_sigSetTempZon3Req}, {implementation-record-element=CAN2_sigSetTempZon2Req, system-signal=CAN2_sigSetTempZon2Req}, {implementation-record-element=CAN2_sigSetTempZon1Req, system-signal=CAN2_sigSetTempZon1Req}, {implementation-record-element=CAN2_sigRecircReq, system-signal=CAN2_sigRecircReq}, {implementation-record-element=CAN2_sigHvacReq, system-signal=CAN2_sigHvacReq}, {implementation-record-element=CAN2_sigHvacRearReq, system-signal=CAN2_sigHvacRearReq}, {implementation-record-element=CAN2_sigHvacFrontReq, system-signal=CAN2_sigHvacFrontReq}, {implementation-record-element=CAN2_sigFootReq, system-signal=CAN2_sigFootReq}, {implementation-record-element=CAN2_sigFaceReq, system-signal=CAN2_sigFaceReq}, {implementation-record-element=CAN2_sigDfrstReq, system-signal=CAN2_sigDfrstReq}, {implementation-record-element=CAN2_sigAirIntenZon3Req, system-signal=CAN2_sigAirIntenZon3Req}, {implementation-record-element=CAN2_sigAirIntenZon1Req, system-signal=CAN2_sigAirIntenZon1Req}, {implementation-record-element=CAN2_WlcmLight_Mode, system-signal=CAN2_WlcmLight_Mode}, {implementation-record-element=CAN2_Wifi_Sta_IVI_TBOX, system-signal=CAN2_Wifi_Sta_IVI_TBOX}, {implementation-record-element=CAN2_Wifi_Reset, system-signal=CAN2_Wifi_Reset}, {implementation-record-element=CAN2_Walkaway_Lock_SW, system-signal=CAN2_Walkaway_Lock_SW}, {implementation-record-element=CAN2_User_p_upload, system-signal=CAN2_User_p_upload}, {implementation-record-element=CAN2_User_p_download, system-signal=CAN2_User_p_download}, {implementation-record-element=CAN2_TurnSwTimeSet, system-signal=CAN2_TurnSwTimeSet}, {implementation-record-element=CAN2_Time_system, system-signal=CAN2_Time_system}, {implementation-record-element=CAN2_Temperature_unit, system-signal=CAN2_Temperature_unit}, {implementation-record-element=CAN2_TPMS_Res_Butt, system-signal=CAN2_TPMS_Res_Butt}, {implementation-record-element=CAN2_TPMS_Cali_Butt, system-signal=CAN2_TPMS_Cali_Butt}, {implementation-record-element=CAN2_TCS_SW_Cmd, system-signal=CAN2_TCS_SW_Cmd}, {implementation-record-element=CAN2_SetUnlockSingle, system-signal=CAN2_SetUnlockSingle}, {implementation-record-element=CAN2_SenstivityPosition, system-signal=CAN2_SenstivityPosition}, {implementation-record-element=CAN2_Sched_Chg_wake, system-signal=CAN2_Sched_Chg_wake}, {implementation-record-element=CAN2_Sched_Chg_limit, system-signal=CAN2_Sched_Chg_limit}, {implementation-record-element=CAN2_Sched_Chg_butt, system-signal=CAN2_Sched_Chg_butt}, {implementation-record-element=CAN2_Sched_Chg_Stop, system-signal=CAN2_Sched_Chg_Stop}, {implementation-record-element=CAN2_Sched_Chg_Start, system-signal=CAN2_Sched_Chg_Start}, {implementation-record-element=CAN2_SOC_V2LLimit, system-signal=CAN2_SOC_V2LLimit}, {implementation-record-element=CAN2_SOC_Limit_Set, system-signal=CAN2_SOC_Limit_Set}, {implementation-record-element=CAN2_SOC_ADJ_BUTT, system-signal=CAN2_SOC_ADJ_BUTT}, {implementation-record-element=CAN2_SLIF_BUTT, system-signal=CAN2_SLIF_BUTT}, {implementation-record-element=CAN2_SLG_Sw, system-signal=CAN2_SLG_Sw}, {implementation-record-element=CAN2_RoomLampMode, system-signal=CAN2_RoomLampMode}, {implementation-record-element=CAN2_Roll_Mode_SW_Cmd, system-signal=CAN2_Roll_Mode_SW_Cmd}, {implementation-record-element=CAN2_Roll_Eng_Mode, system-signal=CAN2_Roll_Eng_Mode}, {implementation-record-element=CAN2_RFogLampSW, system-signal=CAN2_RFogLampSW}, {implementation-record-element=CAN2_RCTA_BUTT, system-signal=CAN2_RCTA_BUTT}, {implementation-record-element=CAN2_Pressure_unit, system-signal=CAN2_Pressure_unit}, {implementation-record-element=CAN2_Perd_V2L, system-signal=CAN2_Perd_V2L}, {implementation-record-element=CAN2_PSEAT_vent_req, system-signal=CAN2_PSEAT_vent_req}, {implementation-record-element=CAN2_OFF_AC_MODE, system-signal=CAN2_OFF_AC_MODE}, {implementation-record-element=CAN2_ODAMute_BUTT, system-signal=CAN2_ODAMute_BUTT}, {implementation-record-element=CAN2_NAVI_Tunnel, system-signal=CAN2_NAVI_Tunnel}, {implementation-record-element=CAN2_NAVI_Tollgate, system-signal=CAN2_NAVI_Tollgate}, {implementation-record-element=CAN2_NAVI_State, system-signal=CAN2_NAVI_State}, {implementation-record-element=CAN2_NAVI_Speed_Limit_A, system-signal=CAN2_NAVI_Speed_Limit_A}, {implementation-record-element=CAN2_NAVI_SpeedLimit, system-signal=CAN2_NAVI_SpeedLimit}, {implementation-record-element=CAN2_NAVI_RoadClass, system-signal=CAN2_NAVI_RoadClass}, {implementation-record-element=CAN2_NAVI_LinkClass, system-signal=CAN2_NAVI_LinkClass}, {implementation-record-element=CAN2_NAVI_ForwardLinkLevel, system-signal=CAN2_NAVI_ForwardLinkLevel}, {implementation-record-element=CAN2_NAVI_Distance_info, system-signal=CAN2_NAVI_Distance_info}, {implementation-record-element=CAN2_NAVI_Direction_STA, system-signal=CAN2_NAVI_Direction_STA}, {implementation-record-element=CAN2_NAVI_Cam_Dist_info, system-signal=CAN2_NAVI_Cam_Dist_info}, {implementation-record-element=CAN2_MFRD_N_Bright_Req, system-signal=CAN2_MFRD_N_Bright_Req}, {implementation-record-element=CAN2_METER_Malfunc_Sta, system-signal=CAN2_METER_Malfunc_Sta}, {implementation-record-element=CAN2_Light_ShowStop_Req, system-signal=CAN2_Light_ShowStop_Req}, {implementation-record-element=CAN2_Light_ShowStart_Req, system-signal=CAN2_Light_ShowStart_Req}, {implementation-record-element=CAN2_L_RRD_ControlCommand, system-signal=CAN2_L_RRD_ControlCommand}, {implementation-record-element=CAN2_L_RLD_ControlCommand, system-signal=CAN2_L_RLD_ControlCommand}, {implementation-record-element=CAN2_L_Pas_ControlCommand, system-signal=CAN2_L_Pas_ControlCommand}, {implementation-record-element=CAN2_L_Drv_ControlCommand, system-signal=CAN2_L_Drv_ControlCommand}, {implementation-record-element=CAN2_LVDAMute_BUTT, system-signal=CAN2_LVDAMute_BUTT}, {implementation-record-element=CAN2_LKA_BUTT, system-signal=CAN2_LKA_BUTT}, {implementation-record-element=CAN2_LDWMute_BUTT, system-signal=CAN2_LDWMute_BUTT}, {implementation-record-element=CAN2_IVI_WI_MAIN_SW, system-signal=CAN2_IVI_WI_MAIN_SW}, {implementation-record-element=CAN2_IVI_Unlock_Chg_req, system-signal=CAN2_IVI_Unlock_Chg_req}, {implementation-record-element=CAN2_IVI_Trigger_req, system-signal=CAN2_IVI_Trigger_req}, {implementation-record-element=CAN2_IVI_TrailerModeSW_Sta, system-signal=CAN2_IVI_TrailerModeSW_Sta}, {implementation-record-element=CAN2_IVI_TrailerCheckReq_Sta, system-signal=CAN2_IVI_TrailerCheckReq_Sta}, {implementation-record-element=CAN2_IVI_Stop_Chg_req, system-signal=CAN2_IVI_Stop_Chg_req}, {implementation-record-element=CAN2_IVI_Status, system-signal=CAN2_IVI_Status}, {implementation-record-element=CAN2_IVI_Start_Chg_req, system-signal=CAN2_IVI_Start_Chg_req}, {implementation-record-element=CAN2_IVI_SetTempZon2_Sta, system-signal=CAN2_IVI_SetTempZon2_Sta}, {implementation-record-element=CAN2_IVI_SetTempZon1_Sta, system-signal=CAN2_IVI_SetTempZon1_Sta}, {implementation-record-element=CAN2_IVI_Screen, system-signal=CAN2_IVI_Screen}, {implementation-record-element=CAN2_IVI_SWC_RUndefined_Sta, system-signal=CAN2_IVI_SWC_RUndefined_Sta}, {implementation-record-element=CAN2_IVI_SWC_LUndefined_Sta, system-signal=CAN2_IVI_SWC_LUndefined_Sta}, {implementation-record-element=CAN2_IVI_SWC_ACCMode_Sta, system-signal=CAN2_IVI_SWC_ACCMode_Sta}, {implementation-record-element=CAN2_IVI_SLIF_Warning_Sta, system-signal=CAN2_IVI_SLIF_Warning_Sta}, {implementation-record-element=CAN2_IVI_Req_V2L, system-signal=CAN2_IVI_Req_V2L}, {implementation-record-element=CAN2_IVI_RR_Def_Req, system-signal=CAN2_IVI_RR_Def_Req}, {implementation-record-element=CAN2_IVI_Pwroff_req, system-signal=CAN2_IVI_Pwroff_req}, {implementation-record-element=CAN2_IVI_PwrLockSW, system-signal=CAN2_IVI_PwrLockSW}, {implementation-record-element=CAN2_IVI_Panel_Y_Coor, system-signal=CAN2_IVI_Panel_Y_Coor}, {implementation-record-element=CAN2_IVI_Panel_X_Coor, system-signal=CAN2_IVI_Panel_X_Coor}, {implementation-record-element=CAN2_IVI_Panel_Act, system-signal=CAN2_IVI_Panel_Act}, {implementation-record-element=CAN2_IVI_PW_Mode_Req, system-signal=CAN2_IVI_PW_Mode_Req}, {implementation-record-element=CAN2_IVI_PTG_USSta_SW, system-signal=CAN2_IVI_PTG_USSta_SW}, {implementation-record-element=CAN2_IVI_PTG_Sta_SW, system-signal=CAN2_IVI_PTG_Sta_SW}, {implementation-record-element=CAN2_IVI_PTG_Open_Height, system-signal=CAN2_IVI_PTG_Open_Height}, {implementation-record-element=CAN2_IVI_PTG_Mode_SW, system-signal=CAN2_IVI_PTG_Mode_SW}, {implementation-record-element=CAN2_IVI_PSEAT_Slide_Cmd, system-signal=CAN2_IVI_PSEAT_Slide_Cmd}, {implementation-record-element=CAN2_IVI_PSEAT_Recline_Cmd, system-signal=CAN2_IVI_PSEAT_Recline_Cmd}, {implementation-record-element=CAN2_IVI_PSEATHeater_Cmd, system-signal=CAN2_IVI_PSEATHeater_Cmd}, {implementation-record-element=CAN2_IVI_Night_Mode_Sta, system-signal=CAN2_IVI_Night_Mode_Sta}, {implementation-record-element=CAN2_IVI_Mute_Sta, system-signal=CAN2_IVI_Mute_Sta}, {implementation-record-element=CAN2_IVI_LVChrgFuncSW, system-signal=CAN2_IVI_LVChrgFuncSW}, {implementation-record-element=CAN2_IVI_ISA_OffsetSpd, system-signal=CAN2_IVI_ISA_OffsetSpd}, {implementation-record-element=CAN2_IVI_DSEAT_Slide_Cmd, system-signal=CAN2_IVI_DSEAT_Slide_Cmd}, {implementation-record-element=CAN2_IVI_DSEAT_Recline_Cmd, system-signal=CAN2_IVI_DSEAT_Recline_Cmd}, {implementation-record-element=CAN2_IVI_DSEAT_Memory_OPTCLS_Sta, system-signal=CAN2_IVI_DSEAT_Memory_OPTCLS_Sta}, {implementation-record-element=CAN2_IVI_DSEAT_Memory2_Sta, system-signal=CAN2_IVI_DSEAT_Memory2_Sta}, {implementation-record-element=CAN2_IVI_DSEAT_Memory1_Sta, system-signal=CAN2_IVI_DSEAT_Memory1_Sta}, {implementation-record-element=CAN2_IVI_DSEAT_Height_Cmd, system-signal=CAN2_IVI_DSEAT_Height_Cmd}, {implementation-record-element=CAN2_IVI_DSEAT_FroEdge_Height_Cmd, system-signal=CAN2_IVI_DSEAT_FroEdge_Height_Cmd}, {implementation-record-element=CAN2_IVI_DSEATHeater_Cmd, system-signal=CAN2_IVI_DSEATHeater_Cmd}, {implementation-record-element=CAN2_IVI_CreepSW_Req, system-signal=CAN2_IVI_CreepSW_Req}, {implementation-record-element=CAN2_IVI_CoastDwSW, system-signal=CAN2_IVI_CoastDwSW}, {implementation-record-element=CAN2_IVI_ChargePortSW_Sta, system-signal=CAN2_IVI_ChargePortSW_Sta}, {implementation-record-element=CAN2_IVI_CfmTo_Rdy, system-signal=CAN2_IVI_CfmTo_Rdy}, {implementation-record-element=CAN2_IVI_AirIntZ3_Cmd, system-signal=CAN2_IVI_AirIntZ3_Cmd}, {implementation-record-element=CAN2_IVI_ActvDmpDisabSW, system-signal=CAN2_IVI_ActvDmpDisabSW}, {implementation-record-element=CAN2_IVI_ACC_Adaptive_Sta, system-signal=CAN2_IVI_ACC_Adaptive_Sta}, {implementation-record-element=CAN2_Hood_Latch_SW, system-signal=CAN2_Hood_Latch_SW}, {implementation-record-element=CAN2_HeadLampSW, system-signal=CAN2_HeadLampSW}, {implementation-record-element=CAN2_GPS_LONG, system-signal=CAN2_GPS_LONG}, {implementation-record-element=CAN2_GPS_LAT, system-signal=CAN2_GPS_LAT}, {implementation-record-element=CAN2_FollowMeSW, system-signal=CAN2_FollowMeSW}, {implementation-record-element=CAN2_FalseNPrevent_SW, system-signal=CAN2_FalseNPrevent_SW}, {implementation-record-element=CAN2_FS_Off_Sw, system-signal=CAN2_FS_Off_Sw}, {implementation-record-element=CAN2_FFogLampSW, system-signal=CAN2_FFogLampSW}, {implementation-record-element=CAN2_FCWMute_BUTT, system-signal=CAN2_FCWMute_BUTT}, {implementation-record-element=CAN2_ESC_SW_Cmd, system-signal=CAN2_ESC_SW_Cmd}, {implementation-record-element=CAN2_Distance_unit, system-signal=CAN2_Distance_unit}, {implementation-record-element=CAN2_DSEAT_vent_req, system-signal=CAN2_DSEAT_vent_req}, {implementation-record-element=CAN2_DSEAT_entryfun_set, system-signal=CAN2_DSEAT_entryfun_set}, {implementation-record-element=CAN2_DSEAT_anti_set, system-signal=CAN2_DSEAT_anti_set}, {implementation-record-element=CAN2_DMS_Warning_Unresponsive, system-signal=CAN2_DMS_Warning_Unresponsive}, {implementation-record-element=CAN2_DMS_Warning_Fatigue, system-signal=CAN2_DMS_Warning_Fatigue}, {implementation-record-element=CAN2_DMS_Warning_Distraction, system-signal=CAN2_DMS_Warning_Distraction}, {implementation-record-element=CAN2_DMS_Status, system-signal=CAN2_DMS_Status}, {implementation-record-element=CAN2_CameraWrn, system-signal=CAN2_CameraWrn}, {implementation-record-element=CAN2_CDL_Unlock_Butt, system-signal=CAN2_CDL_Unlock_Butt}, {implementation-record-element=CAN2_CDL_Lock_Butt, system-signal=CAN2_CDL_Lock_Butt}, {implementation-record-element=CAN2_CAAS_Sw, system-signal=CAN2_CAAS_Sw}, {implementation-record-element=CAN2_BSDMute_BUTT, system-signal=CAN2_BSDMute_BUTT}, {implementation-record-element=CAN2_Approach_Unlock_SW, system-signal=CAN2_Approach_Unlock_SW}, {implementation-record-element=CAN2_AVM_parking_excute, system-signal=CAN2_AVM_parking_excute}, {implementation-record-element=CAN2_AVM_parking_cancel, system-signal=CAN2_AVM_parking_cancel}, {implementation-record-element=CAN2_AVM_Parking_mode, system-signal=CAN2_AVM_Parking_mode}, {implementation-record-element=CAN2_AVM_OFF_Rec_Butt, system-signal=CAN2_AVM_OFF_Rec_Butt}, {implementation-record-element=CAN2_AVM_Err_STA, system-signal=CAN2_AVM_Err_STA}, {implementation-record-element=CAN2_AEB_BUTT, system-signal=CAN2_AEB_BUTT}]}
      MAP_CGW_R_CAN2_IVI3: sender-receiver-to-signal-group-mapping{communication-direction=IN, data-element=SWC_CGW.root_FDC.R_CAN2_IVI3.CAN2_SG_IVI3, signal-group=CAN2_SG_IVI3, type-mapping=sender-rec-record-type-mapping=record-element-mappings=[{implementation-record-element=CAN2_IVI_CLBlower_Y_Sta, system-signal=CAN2_IVI_CLBlower_Y_Sta}, {implementation-record-element=CAN2_IVI_RSEATvent_Cmd, system-signal=CAN2_IVI_RSEATvent_Cmd}, {implementation-record-element=CAN2_IVI_PsBlower_Z_Sta, system-signal=CAN2_IVI_PsBlower_Z_Sta}, {implementation-record-element=CAN2_IVI_PsBlower_Y_Sta, system-signal=CAN2_IVI_PsBlower_Y_Sta}, {implementation-record-element=CAN2_IVI_PsBlower_Mode_Sta, system-signal=CAN2_IVI_PsBlower_Mode_Sta}, {implementation-record-element=CAN2_IVI_MRZeroGravity_Cmd, system-signal=CAN2_IVI_MRZeroGravity_Cmd}, {implementation-record-element=CAN2_IVI_MRSlider_Cmd, system-signal=CAN2_IVI_MRSlider_Cmd}, {implementation-record-element=CAN2_IVI_MRSldRestore_Cmd, system-signal=CAN2_IVI_MRSldRestore_Cmd}, {implementation-record-element=CAN2_IVI_MRSeatLift_Cmd, system-signal=CAN2_IVI_MRSeatLift_Cmd}, {implementation-record-element=CAN2_IVI_MRSEATvent_Cmd, system-signal=CAN2_IVI_MRSEATvent_Cmd}, {implementation-record-element=CAN2_IVI_MRRestore_Cmd, system-signal=CAN2_IVI_MRRestore_Cmd}, {implementation-record-element=CAN2_IVI_MRRecliner_Cmd, system-signal=CAN2_IVI_MRRecliner_Cmd}, {implementation-record-element=CAN2_IVI_MRNapMode_Cmd, system-signal=CAN2_IVI_MRNapMode_Cmd}, {implementation-record-element=CAN2_IVI_MRFootLift_Cmd, system-signal=CAN2_IVI_MRFootLift_Cmd}, {implementation-record-element=CAN2_IVI_MRFMost_Cmd, system-signal=CAN2_IVI_MRFMost_Cmd}, {implementation-record-element=CAN2_IVI_MLZeroGravity_Cmd, system-signal=CAN2_IVI_MLZeroGravity_Cmd}, {implementation-record-element=CAN2_IVI_MLSlider_Cmd, system-signal=CAN2_IVI_MLSlider_Cmd}, {implementation-record-element=CAN2_IVI_MLSldRestore_Cmd, system-signal=CAN2_IVI_MLSldRestore_Cmd}, {implementation-record-element=CAN2_IVI_MLSeatLift_Cmd, system-signal=CAN2_IVI_MLSeatLift_Cmd}, {implementation-record-element=CAN2_IVI_MLSEATvent_Cmd, system-signal=CAN2_IVI_MLSEATvent_Cmd}, {implementation-record-element=CAN2_IVI_MLRestore_Cmd, system-signal=CAN2_IVI_MLRestore_Cmd}, {implementation-record-element=CAN2_IVI_MLRecliner_Cmd, system-signal=CAN2_IVI_MLRecliner_Cmd}, {implementation-record-element=CAN2_IVI_MLNapMode_Cmd, system-signal=CAN2_IVI_MLNapMode_Cmd}, {implementation-record-element=CAN2_IVI_MLFootLift_Cmd, system-signal=CAN2_IVI_MLFootLift_Cmd}, {implementation-record-element=CAN2_IVI_MLFMost_Cmd, system-signal=CAN2_IVI_MLFMost_Cmd}, {implementation-record-element=CAN2_IVI_LSEATvent_Cmd, system-signal=CAN2_IVI_LSEATvent_Cmd}, {implementation-record-element=CAN2_IVI_DrBlower_Z_Sta, system-signal=CAN2_IVI_DrBlower_Z_Sta}, {implementation-record-element=CAN2_IVI_DrBlower_Y_Sta, system-signal=CAN2_IVI_DrBlower_Y_Sta}, {implementation-record-element=CAN2_IVI_DrBlower_Mode_Sta, system-signal=CAN2_IVI_DrBlower_Mode_Sta}, {implementation-record-element=CAN2_IVI_CRBlower_Z_Sta, system-signal=CAN2_IVI_CRBlower_Z_Sta}, {implementation-record-element=CAN2_IVI_CRBlower_Y_Sta, system-signal=CAN2_IVI_CRBlower_Y_Sta}, {implementation-record-element=CAN2_IVI_CLBlower_Z_Sta, system-signal=CAN2_IVI_CLBlower_Z_Sta}]}
      MAP_CGW_R_CAN2_METER1: sender-receiver-to-signal-group-mapping{communication-direction=IN, data-element=SWC_CGW.root_FDC.R_CAN2_METER1.CAN2_SG_METER1, signal-group=CAN2_SG_METER1, type-mapping=sender-rec-record-type-mapping=record-element-mappings=[{implementation-record-element=CAN2_APCforDTE, system-signal=CAN2_APCforDTE}, {implementation-record-element=CAN2_Trip_B, system-signal=CAN2_Trip_B}, {implementation-record-element=CAN2_Trip_A, system-signal=CAN2_Trip_A}, {implementation-record-element=CAN2_Spd_Crl_Sta, system-signal=CAN2_Spd_Crl_Sta}, {implementation-record-element=CAN2_Spd_Crl_Mode, system-signal=CAN2_Spd_Crl_Mode}, {implementation-record-element=CAN2_ParkBrake, system-signal=CAN2_ParkBrake}, {implementation-record-element=CAN2_ODOMETER, system-signal=CAN2_ODOMETER}, {implementation-record-element=CAN2_METER_MPH_Real, system-signal=CAN2_METER_MPH_Real}, {implementation-record-element=CAN2_METER_MPH_Calcu, system-signal=CAN2_METER_MPH_Calcu}, {implementation-record-element=CAN2_METER_KPH_Real, system-signal=CAN2_METER_KPH_Real}, {implementation-record-element=CAN2_METER_KPH_Calcu, system-signal=CAN2_METER_KPH_Calcu}, {implementation-record-element=CAN2_LEDlitWarnReq, system-signal=CAN2_LEDlitWarnReq}, {implementation-record-element=CAN2_Charge, system-signal=CAN2_Charge}, {implementation-record-element=CAN2_Averaged_vehspeed, system-signal=CAN2_Averaged_vehspeed}, {implementation-record-element=CAN2_AvailableTrip, system-signal=CAN2_AvailableTrip}, {implementation-record-element=CAN2_AVGPwrConsumption, system-signal=CAN2_AVGPwrConsumption}]}
      MAP_CGW_R_CAN3_BMS1: sender-receiver-to-signal-group-mapping{communication-direction=IN, data-element=SWC_CGW.root_FDC.R_CAN3_BMS1.CAN3_SG_BMS1, signal-group=CAN3_SG_BMS1, type-mapping=sender-rec-record-type-mapping=record-element-mappings=[{implementation-record-element=CAN3_BMSChckSum_1, system-signal=CAN3_BMSChckSum_1}, {implementation-record-element=CAN3_HVBattVolt, system-signal=CAN3_HVBattVolt}, {implementation-record-element=CAN3_HVBattCurr, system-signal=CAN3_HVBattCurr}, {implementation-record-element=CAN3_HVBPwrAvailDchrg60, system-signal=CAN3_HVBPwrAvailDchrg60}, {implementation-record-element=CAN3_HVBPwrAvailDchrg30, system-signal=CAN3_HVBPwrAvailDchrg30}, {implementation-record-element=CAN3_HVBPwrAvailDchrg, system-signal=CAN3_HVBPwrAvailDchrg}, {implementation-record-element=CAN3_HVBPwrAvailChrg60, system-signal=CAN3_HVBPwrAvailChrg60}, {implementation-record-element=CAN3_HVBPwrAvailChrg30, system-signal=CAN3_HVBPwrAvailChrg30}, {implementation-record-element=CAN3_HVBPwrAvailChrg, system-signal=CAN3_HVBPwrAvailChrg}, {implementation-record-element=CAN3_BMSRolCnct_1, system-signal=CAN3_BMSRolCnct_1}]}
      MAP_CGW_R_CAN3_BMS3: sender-receiver-to-signal-group-mapping{communication-direction=IN, data-element=SWC_CGW.root_FDC.R_CAN3_BMS3.CAN3_SG_BMS3, signal-group=CAN3_SG_BMS3, type-mapping=sender-rec-record-type-mapping=record-element-mappings=[{implementation-record-element=CAN3_ACChrgCurrDis, system-signal=CAN3_ACChrgCurrDis}, {implementation-record-element=CAN3_RemainChrgTime, system-signal=CAN3_RemainChrgTime}, {implementation-record-element=CAN3_RechrgCyc, system-signal=CAN3_RechrgCyc}, {implementation-record-element=CAN3_HVBattSOCDis, system-signal=CAN3_HVBattSOCDis}, {implementation-record-element=CAN3_HVBattSOC, system-signal=CAN3_HVBattSOC}, {implementation-record-element=CAN3_HVBattPackVolt, system-signal=CAN3_HVBattPackVolt}, {implementation-record-element=CAN3_HVBattErr, system-signal=CAN3_HVBattErr}, {implementation-record-element=CAN3_HVBSOH, system-signal=CAN3_HVBSOH}, {implementation-record-element=CAN3_HVBIsoImpedenceP, system-signal=CAN3_HVBIsoImpedenceP}, {implementation-record-element=CAN3_HVBIsoImpedenceN, system-signal=CAN3_HVBIsoImpedenceN}, {implementation-record-element=CAN3_HVBFullChrgPwr, system-signal=CAN3_HVBFullChrgPwr}, {implementation-record-element=CAN3_HVBDrvPwrTotal, system-signal=CAN3_HVBDrvPwrTotal}, {implementation-record-element=CAN3_HVBDrvPwr, system-signal=CAN3_HVBDrvPwr}, {implementation-record-element=CAN3_HVBChrgPwrTotal, system-signal=CAN3_HVBChrgPwrTotal}, {implementation-record-element=CAN3_HVBChrgPwr, system-signal=CAN3_HVBChrgPwr}, {implementation-record-element=CAN3_FireDetErr, system-signal=CAN3_FireDetErr}, {implementation-record-element=CAN3_ChrgLampSta, system-signal=CAN3_ChrgLampSta}, {implementation-record-element=CAN3_ChrgCurType, system-signal=CAN3_ChrgCurType}, {implementation-record-element=CAN3_CellType, system-signal=CAN3_CellType}, {implementation-record-element=CAN3_Battsystfail_Num, system-signal=CAN3_Battsystfail_Num}]}
      MAP_CGW_R_CAN3_BMS4: sender-receiver-to-signal-group-mapping{communication-direction=IN, data-element=SWC_CGW.root_FDC.R_CAN3_BMS4.CAN3_SG_BMS4, signal-group=CAN3_SG_BMS4, type-mapping=sender-rec-record-type-mapping=record-element-mappings=[{implementation-record-element=CAN3_CellTempAvg, system-signal=CAN3_CellTempAvg}, {implementation-record-element=CAN3_Mtemp20, system-signal=CAN3_Mtemp20}, {implementation-record-element=CAN3_Mtemp19, system-signal=CAN3_Mtemp19}, {implementation-record-element=CAN3_Mtemp18, system-signal=CAN3_Mtemp18}, {implementation-record-element=CAN3_Mtemp17, system-signal=CAN3_Mtemp17}, {implementation-record-element=CAN3_Mtemp16, system-signal=CAN3_Mtemp16}, {implementation-record-element=CAN3_Mtemp15, system-signal=CAN3_Mtemp15}, {implementation-record-element=CAN3_Mtemp14, system-signal=CAN3_Mtemp14}, {implementation-record-element=CAN3_Mtemp13, system-signal=CAN3_Mtemp13}, {implementation-record-element=CAN3_Mtemp12, system-signal=CAN3_Mtemp12}, {implementation-record-element=CAN3_Mtemp11, system-signal=CAN3_Mtemp11}, {implementation-record-element=CAN3_Mtemp10, system-signal=CAN3_Mtemp10}, {implementation-record-element=CAN3_Mtemp09, system-signal=CAN3_Mtemp09}, {implementation-record-element=CAN3_Mtemp08, system-signal=CAN3_Mtemp08}, {implementation-record-element=CAN3_Mtemp07, system-signal=CAN3_Mtemp07}, {implementation-record-element=CAN3_Mtemp06, system-signal=CAN3_Mtemp06}, {implementation-record-element=CAN3_Mtemp05, system-signal=CAN3_Mtemp05}, {implementation-record-element=CAN3_Mtemp04, system-signal=CAN3_Mtemp04}, {implementation-record-element=CAN3_Mtemp03, system-signal=CAN3_Mtemp03}, {implementation-record-element=CAN3_Mtemp02, system-signal=CAN3_Mtemp02}, {implementation-record-element=CAN3_Mtemp01, system-signal=CAN3_Mtemp01}, {implementation-record-element=CAN3_MinCellVolt_Num, system-signal=CAN3_MinCellVolt_Num}, {implementation-record-element=CAN3_MinCellTemp_Num, system-signal=CAN3_MinCellTemp_Num}, {implementation-record-element=CAN3_MaxCellVolt_Num, system-signal=CAN3_MaxCellVolt_Num}, {implementation-record-element=CAN3_MaxCellTemp_Num, system-signal=CAN3_MaxCellTemp_Num}, {implementation-record-element=CAN3_HVBMTempMin, system-signal=CAN3_HVBMTempMin}, {implementation-record-element=CAN3_HVBMTempMax, system-signal=CAN3_HVBMTempMax}, {implementation-record-element=CAN3_HVBCellVoltMin, system-signal=CAN3_HVBCellVoltMin}, {implementation-record-element=CAN3_HVBCellVoltMax, system-signal=CAN3_HVBCellVoltMax}]}
      MAP_CGW_R_CAN3_BMS5: sender-receiver-to-signal-group-mapping{communication-direction=IN, data-element=SWC_CGW.root_FDC.R_CAN3_BMS5.CAN3_SG_BMS5, signal-group=CAN3_SG_BMS5, type-mapping=sender-rec-record-type-mapping=record-element-mappings=[{implementation-record-element=CAN3_DCPortNeg_Temp, system-signal=CAN3_DCPortNeg_Temp}, {implementation-record-element=CAN3_ReChargerStaFromEvcc, system-signal=CAN3_ReChargerStaFromEvcc}, {implementation-record-element=CAN3_OBCEna, system-signal=CAN3_OBCEna}, {implementation-record-element=CAN3_OBCDCVoltLm, system-signal=CAN3_OBCDCVoltLm}, {implementation-record-element=CAN3_OBCDCCurLm, system-signal=CAN3_OBCDCCurLm}, {implementation-record-element=CAN3_OBCACCSLimit, system-signal=CAN3_OBCACCSLimit}, {implementation-record-element=CAN3_LVBattDet12V, system-signal=CAN3_LVBattDet12V}, {implementation-record-element=CAN3_HVInVolt, system-signal=CAN3_HVInVolt}, {implementation-record-element=CAN3_DCPortPos_Temp, system-signal=CAN3_DCPortPos_Temp}]}
      MAP_CGW_R_CAN3_BMS6: sender-receiver-to-signal-group-mapping{communication-direction=IN, data-element=SWC_CGW.root_FDC.R_CAN3_BMS6.CAN3_SG_BMS6, signal-group=CAN3_SG_BMS6, type-mapping=sender-rec-record-type-mapping=record-element-mappings=[{implementation-record-element=CAN3_BMSChckSum, system-signal=CAN3_BMSChckSum}, {implementation-record-element=CAN3_V2LSta, system-signal=CAN3_V2LSta}, {implementation-record-element=CAN3_SystemUncomErr, system-signal=CAN3_SystemUncomErr}, {implementation-record-element=CAN3_IsoDetSta, system-signal=CAN3_IsoDetSta}, {implementation-record-element=CAN3_HVILSta, system-signal=CAN3_HVILSta}, {implementation-record-element=CAN3_HVBattReady4Pre, system-signal=CAN3_HVBattReady4Pre}, {implementation-record-element=CAN3_HVBUndrVoltErr, system-signal=CAN3_HVBUndrVoltErr}, {implementation-record-element=CAN3_HVBUndrTempWarn, system-signal=CAN3_HVBUndrTempWarn}, {implementation-record-element=CAN3_HVBUndrTempErr, system-signal=CAN3_HVBUndrTempErr}, {implementation-record-element=CAN3_HVBUndrSOCErr, system-signal=CAN3_HVBUndrSOCErr}, {implementation-record-element=CAN3_HVBTempDiffErr, system-signal=CAN3_HVBTempDiffErr}, {implementation-record-element=CAN3_HVBShrtDischrgCurrErr, system-signal=CAN3_HVBShrtDischrgCurrErr}, {implementation-record-element=CAN3_HVBShrtChrgCurrErr, system-signal=CAN3_HVBShrtChrgCurrErr}, {implementation-record-element=CAN3_HVBSOCJumpError, system-signal=CAN3_HVBSOCJumpError}, {implementation-record-element=CAN3_HVBPreheatPrecoolSta, system-signal=CAN3_HVBPreheatPrecoolSta}, {implementation-record-element=CAN3_HVBPrechrgSta, system-signal=CAN3_HVBPrechrgSta}, {implementation-record-element=CAN3_HVBOvrVoltErr, system-signal=CAN3_HVBOvrVoltErr}, {implementation-record-element=CAN3_HVBOvrTempWarn, system-signal=CAN3_HVBOvrTempWarn}, {implementation-record-element=CAN3_HVBOvrTempErr, system-signal=CAN3_HVBOvrTempErr}, {implementation-record-element=CAN3_HVBOvrSOCErr, system-signal=CAN3_HVBOvrSOCErr}, {implementation-record-element=CAN3_HVBOvrDchrgCurErr, system-signal=CAN3_HVBOvrDchrgCurErr}, {implementation-record-element=CAN3_HVBOvrChrgCurrErr, system-signal=CAN3_HVBOvrChrgCurrErr}, {implementation-record-element=CAN3_HVBHVILErr, system-signal=CAN3_HVBHVILErr}, {implementation-record-element=CAN3_HVBContactorSta, system-signal=CAN3_HVBContactorSta}, {implementation-record-element=CAN3_HVBChrgErr, system-signal=CAN3_HVBChrgErr}, {implementation-record-element=CAN3_HVBCellUndrVoltErr, system-signal=CAN3_HVBCellUndrVoltErr}, {implementation-record-element=CAN3_HVBCellUnbalanErr, system-signal=CAN3_HVBCellUnbalanErr}, {implementation-record-element=CAN3_HVBCellUdrVoltWarn, system-signal=CAN3_HVBCellUdrVoltWarn}, {implementation-record-element=CAN3_HVBCellOvrVoltWarn, system-signal=CAN3_HVBCellOvrVoltWarn}, {implementation-record-element=CAN3_HVBCellOvrVoltErr, system-signal=CAN3_HVBCellOvrVoltErr}, {implementation-record-element=CAN3_ExtChrgSta, system-signal=CAN3_ExtChrgSta}, {implementation-record-element=CAN3_DisChrgPlugErr, system-signal=CAN3_DisChrgPlugErr}, {implementation-record-element=CAN3_DCChrgSysShockErr, system-signal=CAN3_DCChrgSysShockErr}, {implementation-record-element=CAN3_ChrgPlugSta, system-signal=CAN3_ChrgPlugSta}, {implementation-record-element=CAN3_ChrgInLockReq, system-signal=CAN3_ChrgInLockReq}, {implementation-record-element=CAN3_CellUnconsistErr, system-signal=CAN3_CellUnconsistErr}, {implementation-record-element=CAN3_BMS_Warn_8, system-signal=CAN3_BMS_Warn_8}, {implementation-record-element=CAN3_BMS_Warn_7, system-signal=CAN3_BMS_Warn_7}, {implementation-record-element=CAN3_BMS_Warn_6, system-signal=CAN3_BMS_Warn_6}, {implementation-record-element=CAN3_BMS_Warn_5, system-signal=CAN3_BMS_Warn_5}, {implementation-record-element=CAN3_BMS_Warn_4, system-signal=CAN3_BMS_Warn_4}, {implementation-record-element=CAN3_BMS_Warn_3, system-signal=CAN3_BMS_Warn_3}, {implementation-record-element=CAN3_BMS_Warn_2, system-signal=CAN3_BMS_Warn_2}, {implementation-record-element=CAN3_BMS_Warn_1, system-signal=CAN3_BMS_Warn_1}, {implementation-record-element=CAN3_BMS_READY, system-signal=CAN3_BMS_READY}, {implementation-record-element=CAN3_BMSRolCnct, system-signal=CAN3_BMSRolCnct}]}
      MAP_CGW_R_CAN3_BMS8: sender-receiver-to-signal-group-mapping{communication-direction=IN, data-element=SWC_CGW.root_FDC.R_CAN3_BMS8.CAN3_SG_BMS8, signal-group=CAN3_SG_BMS8, type-mapping=sender-rec-record-type-mapping=record-element-mappings=[{implementation-record-element=CAN3_ACChrgStop, system-signal=CAN3_ACChrgStop}, {implementation-record-element=CAN3_TherRunawayErrMask, system-signal=CAN3_TherRunawayErrMask}, {implementation-record-element=CAN3_MainRlyPosSta, system-signal=CAN3_MainRlyPosSta}, {implementation-record-element=CAN3_MainRlyPosOutterVoltage, system-signal=CAN3_MainRlyPosOutterVoltage}, {implementation-record-element=CAN3_MainRlyPosInnerVoltage, system-signal=CAN3_MainRlyPosInnerVoltage}, {implementation-record-element=CAN3_MainRlyPosDriReq, system-signal=CAN3_MainRlyPosDriReq}, {implementation-record-element=CAN3_MainRlyNegSta, system-signal=CAN3_MainRlyNegSta}, {implementation-record-element=CAN3_MainRlyNegOutterVoltage, system-signal=CAN3_MainRlyNegOutterVoltage}, {implementation-record-element=CAN3_MainRlyNegDriReq, system-signal=CAN3_MainRlyNegDriReq}, {implementation-record-element=CAN3_MainPosstandard, system-signal=CAN3_MainPosstandard}, {implementation-record-element=CAN3_MainChrgRlyPosSta, system-signal=CAN3_MainChrgRlyPosSta}, {implementation-record-element=CAN3_MainChrgRlyPosOutterVoltage, system-signal=CAN3_MainChrgRlyPosOutterVoltage}, {implementation-record-element=CAN3_MainChrgRlyPosDriReq, system-signal=CAN3_MainChrgRlyPosDriReq}, {implementation-record-element=CAN3_MainChrgRlyNegSta, system-signal=CAN3_MainChrgRlyNegSta}, {implementation-record-element=CAN3_MainChrgRlyNegOutterVoltage, system-signal=CAN3_MainChrgRlyNegOutterVoltage}, {implementation-record-element=CAN3_MainChrgRlyNegDriReq, system-signal=CAN3_MainChrgRlyNegDriReq}, {implementation-record-element=CAN3_G0standard, system-signal=CAN3_G0standard}, {implementation-record-element=CAN3_DCChrgVoltage, system-signal=CAN3_DCChrgVoltage}, {implementation-record-element=CAN3_DCChrgStop, system-signal=CAN3_DCChrgStop}, {implementation-record-element=CAN3_DCChrgCurrent, system-signal=CAN3_DCChrgCurrent}, {implementation-record-element=CAN3_CurrentErrorID, system-signal=CAN3_CurrentErrorID}]}
      MAP_CGW_R_CAN3_CCU1: sender-receiver-to-signal-group-mapping{communication-direction=IN, data-element=SWC_CGW.root_FDC.R_CAN3_CCU1.CAN3_SG_CCU1, signal-group=CAN3_SG_CCU1, type-mapping=sender-rec-record-type-mapping=record-element-mappings=[{implementation-record-element=CAN3_CS_CCU1, system-signal=CAN3_CS_CCU1}, {implementation-record-element=CAN3_RC_CCU1, system-signal=CAN3_RC_CCU1}, {implementation-record-element=CAN3_OBCWakeup4Plugin, system-signal=CAN3_OBCWakeup4Plugin}, {implementation-record-element=CAN3_OBCV2LVoutUVP, system-signal=CAN3_OBCV2LVoutUVP}, {implementation-record-element=CAN3_OBCV2LVoutOVP, system-signal=CAN3_OBCV2LVoutOVP}, {implementation-record-element=CAN3_OBCV2LVoutOCP, system-signal=CAN3_OBCV2LVoutOCP}, {implementation-record-element=CAN3_OBCV2LVinUVP, system-signal=CAN3_OBCV2LVinUVP}, {implementation-record-element=CAN3_OBCV2LVinOVP, system-signal=CAN3_OBCV2LVinOVP}, {implementation-record-element=CAN3_OBCV2LInsuFault, system-signal=CAN3_OBCV2LInsuFault}, {implementation-record-element=CAN3_OBCV2LINVOTP, system-signal=CAN3_OBCV2LINVOTP}, {implementation-record-element=CAN3_OBCPreCompleted, system-signal=CAN3_OBCPreCompleted}, {implementation-record-element=CAN3_OBCDCVoltInf, system-signal=CAN3_OBCDCVoltInf}, {implementation-record-element=CAN3_OBCDCCurrInf, system-signal=CAN3_OBCDCCurrInf}, {implementation-record-element=CAN3_DCDCPreCompleted, system-signal=CAN3_DCDCPreCompleted}, {implementation-record-element=CAN3_DCDCInVoltInf, system-signal=CAN3_DCDCInVoltInf}, {implementation-record-element=CAN3_DCDCHVCur, system-signal=CAN3_DCDCHVCur}, {implementation-record-element=CAN3_DCDCAuxVolt, system-signal=CAN3_DCDCAuxVolt}, {implementation-record-element=CAN3_DCDCAuxCur, system-signal=CAN3_DCDCAuxCur}]}
      MAP_CGW_R_CAN3_CCU2: sender-receiver-to-signal-group-mapping{communication-direction=IN, data-element=SWC_CGW.root_FDC.R_CAN3_CCU2.CAN3_SG_CCU2, signal-group=CAN3_SG_CCU2, type-mapping=sender-rec-record-type-mapping=record-element-mappings=[{implementation-record-element=CAN3_CS_CCU2, system-signal=CAN3_CS_CCU2}, {implementation-record-element=CAN3_RC_CCU2, system-signal=CAN3_RC_CCU2}, {implementation-record-element=CAN3_OBC_AC_Cur_Lim, system-signal=CAN3_OBC_AC_Cur_Lim}, {implementation-record-element=CAN3_OBCV2LSta, system-signal=CAN3_OBCV2LSta}, {implementation-record-element=CAN3_OBCTemp, system-signal=CAN3_OBCTemp}, {implementation-record-element=CAN3_OBCRlySta, system-signal=CAN3_OBCRlySta}, {implementation-record-element=CAN3_OBCReady4Pre, system-signal=CAN3_OBCReady4Pre}, {implementation-record-element=CAN3_OBCPluginSta, system-signal=CAN3_OBCPluginSta}, {implementation-record-element=CAN3_OBCFaultSta, system-signal=CAN3_OBCFaultSta}, {implementation-record-element=CAN3_OBCEnaSta, system-signal=CAN3_OBCEnaSta}, {implementation-record-element=CAN3_OBCDCP, system-signal=CAN3_OBCDCP}, {implementation-record-element=CAN3_OBCACVoltInf, system-signal=CAN3_OBCACVoltInf}, {implementation-record-element=CAN3_OBCACCurrInf, system-signal=CAN3_OBCACCurrInf}, {implementation-record-element=CAN3_DCDCTemp, system-signal=CAN3_DCDCTemp}, {implementation-record-element=CAN3_DCDCReady4Pre, system-signal=CAN3_DCDCReady4Pre}, {implementation-record-element=CAN3_DCDCFaultSta, system-signal=CAN3_DCDCFaultSta}, {implementation-record-element=CAN3_DCDCEnaSta, system-signal=CAN3_DCDCEnaSta}]}
      MAP_CGW_R_CAN3_MCU_B_R1: sender-receiver-to-signal-group-mapping{communication-direction=IN, data-element=SWC_CGW.root_FDC.R_CAN3_MCU_B_R1.CAN3_SG_MCU_B_R1, signal-group=CAN3_SG_MCU_B_R1, type-mapping=sender-rec-record-type-mapping=record-element-mappings=[{implementation-record-element=CAN3_MCUWarn_R, system-signal=CAN3_MCUWarn_R}, {implementation-record-element=CAN3_Rr_TMiq, system-signal=CAN3_Rr_TMiq}, {implementation-record-element=CAN3_Rr_TMid, system-signal=CAN3_Rr_TMid}, {implementation-record-element=CAN3_Rr_TMTemp, system-signal=CAN3_Rr_TMTemp}, {implementation-record-element=CAN3_Rr_TMSpd, system-signal=CAN3_Rr_TMSpd}, {implementation-record-element=CAN3_Rr_Reserved_bits, system-signal=CAN3_Rr_Reserved_bits}, {implementation-record-element=CAN3_Rr_RegenAvailTq, system-signal=CAN3_Rr_RegenAvailTq}, {implementation-record-element=CAN3_Rr_MotorAvailTq, system-signal=CAN3_Rr_MotorAvailTq}, {implementation-record-element=CAN3_Rr_MCUTemp, system-signal=CAN3_Rr_MCUTemp}, {implementation-record-element=CAN3_Rr_MCUSysSta, system-signal=CAN3_Rr_MCUSysSta}, {implementation-record-element=CAN3_Rr_MCUReady4Pre, system-signal=CAN3_Rr_MCUReady4Pre}, {implementation-record-element=CAN3_Rr_MCUReady, system-signal=CAN3_Rr_MCUReady}, {implementation-record-element=CAN3_Rr_MCUIGN_sta, system-signal=CAN3_Rr_MCUIGN_sta}, {implementation-record-element=CAN3_Rr_MCUErr, system-signal=CAN3_Rr_MCUErr}, {implementation-record-element=CAN3_Rr_MCUEnaSta, system-signal=CAN3_Rr_MCUEnaSta}, {implementation-record-element=CAN3_Rr_MCUDischrgSta, system-signal=CAN3_Rr_MCUDischrgSta}, {implementation-record-element=CAN3_Rr_MCUDCBusVolt, system-signal=CAN3_Rr_MCUDCBusVolt}, {implementation-record-element=CAN3_Rr_MCUDCBusCurr, system-signal=CAN3_Rr_MCUDCBusCurr}, {implementation-record-element=CAN3_Rr_MCUBAT, system-signal=CAN3_Rr_MCUBAT}, {implementation-record-element=CAN3_Rr_MCU1RolCnt, system-signal=CAN3_Rr_MCU1RolCnt}, {implementation-record-element=CAN3_Rr_MCU1Chksum, system-signal=CAN3_Rr_MCU1Chksum}, {implementation-record-element=CAN3_Rr_EDUTqReqFbk, system-signal=CAN3_Rr_EDUTqReqFbk}, {implementation-record-element=CAN3_Rr_EDURotateDirction, system-signal=CAN3_Rr_EDURotateDirction}, {implementation-record-element=CAN3_Rr_EDURealTMTq, system-signal=CAN3_Rr_EDURealTMTq}, {implementation-record-element=CAN3_Rr_EDUOpratingSta, system-signal=CAN3_Rr_EDUOpratingSta}, {implementation-record-element=CAN3_Rr_EDUDrtSta, system-signal=CAN3_Rr_EDUDrtSta}, {implementation-record-element=CAN3_Rr_ActvDmpDisabSta, system-signal=CAN3_Rr_ActvDmpDisabSta}]}
      MAP_CGW_R_CAN3_MCU_B_R2: sender-receiver-to-signal-group-mapping{communication-direction=IN, data-element=SWC_CGW.root_FDC.R_CAN3_MCU_B_R2.CAN3_SG_MCU_B_R2, signal-group=CAN3_SG_MCU_B_R2, type-mapping=sender-rec-record-type-mapping=record-element-mappings=[{implementation-record-element=CAN3_MCU_B_R_FailLv_Sta, system-signal=CAN3_MCU_B_R_FailLv_Sta}, {implementation-record-element=CAN3_Rr_TMTempWarn, system-signal=CAN3_Rr_TMTempWarn}, {implementation-record-element=CAN3_Rr_MCUTempWarn, system-signal=CAN3_Rr_MCUTempWarn}, {implementation-record-element=CAN3_Rr_MCU3_SW_Ver, system-signal=CAN3_Rr_MCU3_SW_Ver}, {implementation-record-element=CAN3_Rr_MCU3_HW_Ver, system-signal=CAN3_Rr_MCU3_HW_Ver}, {implementation-record-element=CAN3_Rr_MCU2RolCnt, system-signal=CAN3_Rr_MCU2RolCnt}, {implementation-record-element=CAN3_Rr_MCU2Chksum, system-signal=CAN3_Rr_MCU2Chksum}, {implementation-record-element=CAN3_Rr_LLCflowReq, system-signal=CAN3_Rr_LLCflowReq}, {implementation-record-element=CAN3_Rr_LLCTemp, system-signal=CAN3_Rr_LLCTemp}, {implementation-record-element=CAN3_Rr_Failcodehistory2, system-signal=CAN3_Rr_Failcodehistory2}, {implementation-record-element=CAN3_Rr_Failcodehistory1, system-signal=CAN3_Rr_Failcodehistory1}, {implementation-record-element=CAN3_Rr_Failcode2, system-signal=CAN3_Rr_Failcode2}, {implementation-record-element=CAN3_Rr_Failcode1, system-signal=CAN3_Rr_Failcode1}, {implementation-record-element=CAN3_Rr_CoolanttempReq, system-signal=CAN3_Rr_CoolanttempReq}, {implementation-record-element=CAN3_MCU_B_R_LLCTempWarn_Sta, system-signal=CAN3_MCU_B_R_LLCTempWarn_Sta}]}
      MAP_CGW_R_CAN3_Shifter1: sender-receiver-to-signal-group-mapping{communication-direction=IN, data-element=SWC_CGW.root_FDC.R_CAN3_Shifter1.CAN3_SG_Shifter1, signal-group=CAN3_SG_Shifter1, type-mapping=sender-rec-record-type-mapping=record-element-mappings=[{implementation-record-element=CAN3_Shifter_CRC8, system-signal=CAN3_Shifter_CRC8}, {implementation-record-element=CAN3_Shifter_RC, system-signal=CAN3_Shifter_RC}, {implementation-record-element=CAN3_Shifter_Handle_Cmd, system-signal=CAN3_Shifter_Handle_Cmd}, {implementation-record-element=CAN3_Shifter_Fail_sta, system-signal=CAN3_Shifter_Fail_sta}]}
      MAP_CGW_R_CAN4_DKC1: sender-receiver-to-signal-group-mapping{communication-direction=IN, data-element=SWC_CGW.root_FDC.R_CAN4_DKC1.CAN4_SG_DKC1, signal-group=CAN4_SG_DKC1, type-mapping=sender-rec-record-type-mapping=record-element-mappings=[{implementation-record-element=CAN4_DKC_KeyNum_Sta, system-signal=CAN4_DKC_KeyNum_Sta}, {implementation-record-element=CAN4_P_UID_LowPower, system-signal=CAN4_P_UID_LowPower}, {implementation-record-element=CAN4_P_KeyMode, system-signal=CAN4_P_KeyMode}, {implementation-record-element=CAN4_P_KeyMiss, system-signal=CAN4_P_KeyMiss}, {implementation-record-element=CAN4_P_Dkey_Show_IVI, system-signal=CAN4_P_Dkey_Show_IVI}, {implementation-record-element=CAN4_P_DKey_Welcome, system-signal=CAN4_P_DKey_Welcome}, {implementation-record-element=CAN4_P_DKey_Area_PTG, system-signal=CAN4_P_DKey_Area_PTG}, {implementation-record-element=CAN4_P_DKey_Area_PS, system-signal=CAN4_P_DKey_Area_PS}, {implementation-record-element=CAN4_P_DKey_Area_LockUnlock, system-signal=CAN4_P_DKey_Area_LockUnlock}, {implementation-record-element=CAN4_P_CommandToPTG, system-signal=CAN4_P_CommandToPTG}, {implementation-record-element=CAN4_P_CommandToBCM, system-signal=CAN4_P_CommandToBCM}, {implementation-record-element=CAN4_DKC_Re_VehData, system-signal=CAN4_DKC_Re_VehData}, {implementation-record-element=CAN4_DKC_ParkingMode_Cmd, system-signal=CAN4_DKC_ParkingMode_Cmd}, {implementation-record-element=CAN4_DKC_PDkeyAreaRAPS_Sta, system-signal=CAN4_DKC_PDkeyAreaRAPS_Sta}, {implementation-record-element=CAN4_DKC_KeyType_Sta, system-signal=CAN4_DKC_KeyType_Sta}]}
      MAP_CGW_R_CAN4_ZONE_DR_VCU: sender-receiver-to-signal-group-mapping{communication-direction=IN, data-element=SWC_CGW.root_FDC.R_CAN4_ZONE_DR_VCU.CAN4_SG_ZONE_DR_VCU, signal-group=CAN4_SG_ZONE_DR_VCU, type-mapping=sender-rec-record-type-mapping=record-element-mappings=[{implementation-record-element=CAN4_APTC_Err, system-signal=CAN4_APTC_Err}, {implementation-record-element=CAN4_ZoneDrMalfunLevel, system-signal=CAN4_ZoneDrMalfunLevel}, {implementation-record-element=CAN4_ZDR_VCU_PwrSupply_Sta, system-signal=CAN4_ZDR_VCU_PwrSupply_Sta}, {implementation-record-element=CAN4_ZDR_VCU_HWReset_Sta, system-signal=CAN4_ZDR_VCU_HWReset_Sta}, {implementation-record-element=CAN4_ZDR_SYS_CSWRetryCnt_Sta, system-signal=CAN4_ZDR_SYS_CSWRetryCnt_Sta}, {implementation-record-element=CAN4_ZDR_SYS_BSWSleepReq_Sta, system-signal=CAN4_ZDR_SYS_BSWSleepReq_Sta}, {implementation-record-element=CAN4_ZDR_SYS_APMRetryCnt_Sta, system-signal=CAN4_ZDR_SYS_APMRetryCnt_Sta}, {implementation-record-element=CAN4_Tincar_Err, system-signal=CAN4_Tincar_Err}, {implementation-record-element=CAN4_Tincar, system-signal=CAN4_Tincar}, {implementation-record-element=CAN4_Tevap_Err, system-signal=CAN4_Tevap_Err}, {implementation-record-element=CAN4_Tevap, system-signal=CAN4_Tevap}, {implementation-record-element=CAN4_T_Foot_Rr_Err, system-signal=CAN4_T_Foot_Rr_Err}, {implementation-record-element=CAN4_T_Foot_Rr, system-signal=CAN4_T_Foot_Rr}, {implementation-record-element=CAN4_T_Foot_R_Err, system-signal=CAN4_T_Foot_R_Err}, {implementation-record-element=CAN4_T_Foot_R, system-signal=CAN4_T_Foot_R}, {implementation-record-element=CAN4_T_Foot_L_Err, system-signal=CAN4_T_Foot_L_Err}, {implementation-record-element=CAN4_T_Foot_L, system-signal=CAN4_T_Foot_L}, {implementation-record-element=CAN4_T_Face_Rr_Err, system-signal=CAN4_T_Face_Rr_Err}, {implementation-record-element=CAN4_T_Face_Rr, system-signal=CAN4_T_Face_Rr}, {implementation-record-element=CAN4_T_Face_R_Err, system-signal=CAN4_T_Face_R_Err}, {implementation-record-element=CAN4_T_Face_R, system-signal=CAN4_T_Face_R}, {implementation-record-element=CAN4_T_Face_L_Err, system-signal=CAN4_T_Face_L_Err}, {implementation-record-element=CAN4_T_Face_L, system-signal=CAN4_T_Face_L}, {implementation-record-element=CAN4_SolarR_Err, system-signal=CAN4_SolarR_Err}, {implementation-record-element=CAN4_SolarR, system-signal=CAN4_SolarR}, {implementation-record-element=CAN4_SolarL_Err, system-signal=CAN4_SolarL_Err}, {implementation-record-element=CAN4_SolarL, system-signal=CAN4_SolarL}, {implementation-record-element=CAN4_RegenSW_Err, system-signal=CAN4_RegenSW_Err}, {implementation-record-element=CAN4_DrTHCMFault, system-signal=CAN4_DrTHCMFault}, {implementation-record-element=CAN4_DrStdAErrSta, system-signal=CAN4_DrStdAErrSta}, {implementation-record-element=CAN4_DrSCPSysErrLmp, system-signal=CAN4_DrSCPSysErrLmp}, {implementation-record-element=CAN4_DrPwrWindowECUFault, system-signal=CAN4_DrPwrWindowECUFault}, {implementation-record-element=CAN4_DrPwrWinErrSta, system-signal=CAN4_DrPwrWinErrSta}, {implementation-record-element=CAN4_DrPwrStdbyACurr, system-signal=CAN4_DrPwrStdbyACurr}, {implementation-record-element=CAN4_DrPwrSta, system-signal=CAN4_DrPwrSta}, {implementation-record-element=CAN4_DrPwrONA2Curr, system-signal=CAN4_DrPwrONA2Curr}, {implementation-record-element=CAN4_DrPwrONA1Curr, system-signal=CAN4_DrPwrONA1Curr}, {implementation-record-element=CAN4_DrPwrInformationSta, system-signal=CAN4_DrPwrInformationSta}, {implementation-record-element=CAN4_DrPowerTemp2, system-signal=CAN4_DrPowerTemp2}, {implementation-record-element=CAN4_DrPowerTemp1, system-signal=CAN4_DrPowerTemp1}, {implementation-record-element=CAN4_DrPMMSysErrLmp, system-signal=CAN4_DrPMMSysErrLmp}, {implementation-record-element=CAN4_DrPMMLimpHomeActReq, system-signal=CAN4_DrPMMLimpHomeActReq}, {implementation-record-element=CAN4_DrPMMLVOutPErrLmp, system-signal=CAN4_DrPMMLVOutPErrLmp}, {implementation-record-element=CAN4_DrONA1ErrSta, system-signal=CAN4_DrONA1ErrSta}, {implementation-record-element=CAN4_DrInfoFault, system-signal=CAN4_DrInfoFault}, {implementation-record-element=CAN4_DrInfoErrSta, system-signal=CAN4_DrInfoErrSta}, {implementation-record-element=CAN4_DrIVIFault, system-signal=CAN4_DrIVIFault}, {implementation-record-element=CAN4_DrEOBDFault, system-signal=CAN4_DrEOBDFault}, {implementation-record-element=CAN4_DrCtrlTemp, system-signal=CAN4_DrCtrlTemp}, {implementation-record-element=CAN4_DrCtrlBDVolt, system-signal=CAN4_DrCtrlBDVolt}, {implementation-record-element=CAN4_DrColumnSWFault, system-signal=CAN4_DrColumnSWFault}, {implementation-record-element=CAN4_DrAuBoxPwrN2Curr, system-signal=CAN4_DrAuBoxPwrN2Curr}, {implementation-record-element=CAN4_DrAuBoxPwrN1Curr, system-signal=CAN4_DrAuBoxPwrN1Curr}, {implementation-record-element=CAN4_DrAPWStaErr, system-signal=CAN4_DrAPWStaErr}, {implementation-record-element=CAN4_DrAPWLINErr, system-signal=CAN4_DrAPWLINErr}, {implementation-record-element=CAN4_DrADASCurr, system-signal=CAN4_DrADASCurr}, {implementation-record-element=CAN4_Blower_FB, system-signal=CAN4_Blower_FB}, {implementation-record-element=CAN4_Blower_Err, system-signal=CAN4_Blower_Err}]}
      MAP_CGW_R_CAN4_ZONE_FR1: sender-receiver-to-signal-group-mapping{communication-direction=IN, data-element=SWC_CGW.root_FDC.R_CAN4_ZONE_FR1.CAN4_SG_ZONE_FR1, signal-group=CAN4_SG_ZONE_FR1, type-mapping=sender-rec-record-type-mapping=record-element-mappings=[{implementation-record-element=CAN4_BDC_1_MoveEnable, system-signal=CAN4_BDC_1_MoveEnable}, {implementation-record-element=CAN4_ZFR_THCM_PsEVentActZ_Sta, system-signal=CAN4_ZFR_THCM_PsEVentActZ_Sta}, {implementation-record-element=CAN4_ZFR_THCM_PsEVentActY_Sta, system-signal=CAN4_ZFR_THCM_PsEVentActY_Sta}, {implementation-record-element=CAN4_ZFR_THCM_DrEVentActZ_Sta, system-signal=CAN4_ZFR_THCM_DrEVentActZ_Sta}, {implementation-record-element=CAN4_ZFR_THCM_DrEVentActY_Sta, system-signal=CAN4_ZFR_THCM_DrEVentActY_Sta}, {implementation-record-element=CAN4_ZFR_THCM_CREVentActZ_Sta, system-signal=CAN4_ZFR_THCM_CREVentActZ_Sta}, {implementation-record-element=CAN4_ZFR_THCM_CREVentActY_Sta, system-signal=CAN4_ZFR_THCM_CREVentActY_Sta}, {implementation-record-element=CAN4_ZFR_THCM_CLEVentActZ_Sta, system-signal=CAN4_ZFR_THCM_CLEVentActZ_Sta}, {implementation-record-element=CAN4_ZFR_THCM_CLEVentActY_Sta, system-signal=CAN4_ZFR_THCM_CLEVentActY_Sta}, {implementation-record-element=CAN4_ZFR_EChrg_Sys_Sta, system-signal=CAN4_ZFR_EChrg_Sys_Sta}, {implementation-record-element=CAN4_ZFR_EChrg_Active_Sta, system-signal=CAN4_ZFR_EChrg_Active_Sta}, {implementation-record-element=CAN4_ZFR_BCM_ChargerDoorSW_Sta, system-signal=CAN4_ZFR_BCM_ChargerDoorSW_Sta}, {implementation-record-element=CAN4_TrailerModeSta, system-signal=CAN4_TrailerModeSta}, {implementation-record-element=CAN4_TrailerCheck, system-signal=CAN4_TrailerCheck}, {implementation-record-element=CAN4_Rposition_Lamp_Warning, system-signal=CAN4_Rposition_Lamp_Warning}, {implementation-record-element=CAN4_RL_BeamErr, system-signal=CAN4_RL_BeamErr}, {implementation-record-element=CAN4_RLB_Warning, system-signal=CAN4_RLB_Warning}, {implementation-record-element=CAN4_RH_BeamErr, system-signal=CAN4_RH_BeamErr}, {implementation-record-element=CAN4_RDRL_Warning, system-signal=CAN4_RDRL_Warning}, {implementation-record-element=CAN4_RDRLErr, system-signal=CAN4_RDRLErr}, {implementation-record-element=CAN4_RAHB_Warning, system-signal=CAN4_RAHB_Warning}, {implementation-record-element=CAN4_RADB_Warning, system-signal=CAN4_RADB_Warning}, {implementation-record-element=CAN4_RADB_Operation_Status, system-signal=CAN4_RADB_Operation_Status}, {implementation-record-element=CAN4_RADB_Hibeam_Indication, system-signal=CAN4_RADB_Hibeam_Indication}, {implementation-record-element=CAN4_RADBErr, system-signal=CAN4_RADBErr}, {implementation-record-element=CAN4_Lposition_Lamp_Warning, system-signal=CAN4_Lposition_Lamp_Warning}, {implementation-record-element=CAN4_LL_BeamErr, system-signal=CAN4_LL_BeamErr}, {implementation-record-element=CAN4_LLB_Warning, system-signal=CAN4_LLB_Warning}, {implementation-record-element=CAN4_LH_BeamErr, system-signal=CAN4_LH_BeamErr}, {implementation-record-element=CAN4_LDRL_Warning, system-signal=CAN4_LDRL_Warning}, {implementation-record-element=CAN4_LDRLErr, system-signal=CAN4_LDRLErr}, {implementation-record-element=CAN4_LAHB_Warning, system-signal=CAN4_LAHB_Warning}, {implementation-record-element=CAN4_LADB_Warning, system-signal=CAN4_LADB_Warning}, {implementation-record-element=CAN4_LADB_Operation_Status, system-signal=CAN4_LADB_Operation_Status}, {implementation-record-element=CAN4_LADB_Hibeam_Indication, system-signal=CAN4_LADB_Hibeam_Indication}, {implementation-record-element=CAN4_LADBErr, system-signal=CAN4_LADBErr}, {implementation-record-element=CAN4_FWiperProtection, system-signal=CAN4_FWiperProtection}, {implementation-record-element=CAN4_FWiperAS, system-signal=CAN4_FWiperAS}, {implementation-record-element=CAN4_FRTurn_Light_Warning, system-signal=CAN4_FRTurn_Light_Warning}, {implementation-record-element=CAN4_FRTurnLampC, system-signal=CAN4_FRTurnLampC}, {implementation-record-element=CAN4_FRTurnLPErr, system-signal=CAN4_FRTurnLPErr}, {implementation-record-element=CAN4_FRPosLPErr, system-signal=CAN4_FRPosLPErr}, {implementation-record-element=CAN4_FLTurn_Light_Warning, system-signal=CAN4_FLTurn_Light_Warning}, {implementation-record-element=CAN4_FLTurnLampC, system-signal=CAN4_FLTurnLampC}, {implementation-record-element=CAN4_FLTurnLPErr, system-signal=CAN4_FLTurnLPErr}, {implementation-record-element=CAN4_FLPosLPErr, system-signal=CAN4_FLPosLPErr}, {implementation-record-element=CAN4_EXV_Cmd_Set_Rq, system-signal=CAN4_EXV_Cmd_Set_Rq}, {implementation-record-element=CAN4_EXV_Cmd_Move_Enbl, system-signal=CAN4_EXV_Cmd_Move_Enbl}, {implementation-record-element=CAN4_EXV_Cmd_Init_Rq, system-signal=CAN4_EXV_Cmd_Init_Rq}, {implementation-record-element=CAN4_EXV2_Cmd_Set_Rq, system-signal=CAN4_EXV2_Cmd_Set_Rq}, {implementation-record-element=CAN4_EXV2_Cmd_Move_Enbl, system-signal=CAN4_EXV2_Cmd_Move_Enbl}, {implementation-record-element=CAN4_EXV2_Cmd_Init_Rq, system-signal=CAN4_EXV2_Cmd_Init_Rq}, {implementation-record-element=CAN4_EWP3_RPM_Target_EWP_Rq, system-signal=CAN4_EWP3_RPM_Target_EWP_Rq}, {implementation-record-element=CAN4_EWP3_Default_Operation_EWP_Rq, system-signal=CAN4_EWP3_Default_Operation_EWP_Rq}, {implementation-record-element=CAN4_EWP2_RPM_Target_EWP_Rq, system-signal=CAN4_EWP2_RPM_Target_EWP_Rq}, {implementation-record-element=CAN4_EWP2_Default_Operation_EWP_Rq, system-signal=CAN4_EWP2_Default_Operation_EWP_Rq}, {implementation-record-element=CAN4_EWP1_RPM_Target_EWP_Rq, system-signal=CAN4_EWP1_RPM_Target_EWP_Rq}, {implementation-record-element=CAN4_EWP1_Default_Operation_EWP_Rq, system-signal=CAN4_EWP1_Default_Operation_EWP_Rq}, {implementation-record-element=CAN4_CompProEN, system-signal=CAN4_CompProEN}, {implementation-record-element=CAN4_ChargeInletLockSta, system-signal=CAN4_ChargeInletLockSta}, {implementation-record-element=CAN4_CCV4_ReqMovePos, system-signal=CAN4_CCV4_ReqMovePos}, {implementation-record-element=CAN4_CCV4_MoveEnable, system-signal=CAN4_CCV4_MoveEnable}, {implementation-record-element=CAN4_CCM_SpdCmd, system-signal=CAN4_CCM_SpdCmd}, {implementation-record-element=CAN4_BMSReqTapPosHSC6, system-signal=CAN4_BMSReqTapPosHSC6}, {implementation-record-element=CAN4_BMSReqRlngCtrHSC6, system-signal=CAN4_BMSReqRlngCtrHSC6}, {implementation-record-element=CAN4_BMSReqPwrHSC6, system-signal=CAN4_BMSReqPwrHSC6}, {implementation-record-element=CAN4_BMSReqPWMHSC6, system-signal=CAN4_BMSReqPWMHSC6}, {implementation-record-element=CAN4_BMSReqMdHSC6, system-signal=CAN4_BMSReqMdHSC6}, {implementation-record-element=CAN4_BMSPackVol_h6HSC6, system-signal=CAN4_BMSPackVol_h6HSC6}, {implementation-record-element=CAN4_BMSInptClntTemHSC6, system-signal=CAN4_BMSInptClntTemHSC6}, {implementation-record-element=CAN4_BMSEnbPTCHSC6, system-signal=CAN4_BMSEnbPTCHSC6}, {implementation-record-element=CAN4_BMSChksmHSC6, system-signal=CAN4_BMSChksmHSC6}, {implementation-record-element=CAN4_BDC_1_ReqMovePos, system-signal=CAN4_BDC_1_ReqMovePos}]}
      MAP_CGW_R_CAN4_ZONE_FR_VCU: sender-receiver-to-signal-group-mapping{communication-direction=IN, data-element=SWC_CGW.root_FDC.R_CAN4_ZONE_FR_VCU.CAN4_SG_ZONE_FR_VCU, signal-group=CAN4_SG_ZONE_FR_VCU, type-mapping=sender-rec-record-type-mapping=record-element-mappings=[{implementation-record-element=CAN4_Bat_In_Temp, system-signal=CAN4_Bat_In_Temp}, {implementation-record-element=CAN4_ZoneFrMalfunLevel, system-signal=CAN4_ZoneFrMalfunLevel}, {implementation-record-element=CAN4_ZFR_VCU_PwrSupply_Sta, system-signal=CAN4_ZFR_VCU_PwrSupply_Sta}, {implementation-record-element=CAN4_ZFR_VCU_HWReset_Sta, system-signal=CAN4_ZFR_VCU_HWReset_Sta}, {implementation-record-element=CAN4_ZFR_SYS_MCURetryCnt_Sta, system-signal=CAN4_ZFR_SYS_MCURetryCnt_Sta}, {implementation-record-element=CAN4_ZFR_SYS_BSWSleepReq_Sta, system-signal=CAN4_ZFR_SYS_BSWSleepReq_Sta}, {implementation-record-element=CAN4_ZFR_SYS_BMSCCURetryCnt_Sta, system-signal=CAN4_ZFR_SYS_BMSCCURetryCnt_Sta}, {implementation-record-element=CAN4_WPTC_Err, system-signal=CAN4_WPTC_Err}, {implementation-record-element=CAN4_Tamb_Err, system-signal=CAN4_Tamb_Err}, {implementation-record-element=CAN4_Tamb, system-signal=CAN4_Tamb}, {implementation-record-element=CAN4_TWV_Err, system-signal=CAN4_TWV_Err}, {implementation-record-element=CAN4_SOV3_Err, system-signal=CAN4_SOV3_Err}, {implementation-record-element=CAN4_SOV2_Err, system-signal=CAN4_SOV2_Err}, {implementation-record-element=CAN4_SOV1_Err, system-signal=CAN4_SOV1_Err}, {implementation-record-element=CAN4_SOTXV_Err, system-signal=CAN4_SOTXV_Err}, {implementation-record-element=CAN4_PT_Low_T2_Err, system-signal=CAN4_PT_Low_T2_Err}, {implementation-record-element=CAN4_PT_Low_T2, system-signal=CAN4_PT_Low_T2}, {implementation-record-element=CAN4_PT_Low_T1_Err, system-signal=CAN4_PT_Low_T1_Err}, {implementation-record-element=CAN4_PT_Low_T1, system-signal=CAN4_PT_Low_T1}, {implementation-record-element=CAN4_PT_Low_P2_Err, system-signal=CAN4_PT_Low_P2_Err}, {implementation-record-element=CAN4_PT_Low_P2, system-signal=CAN4_PT_Low_P2}, {implementation-record-element=CAN4_PT_Low_P1_Err, system-signal=CAN4_PT_Low_P1_Err}, {implementation-record-element=CAN4_PT_Low_P1, system-signal=CAN4_PT_Low_P1}, {implementation-record-element=CAN4_PT_High_Tact_Err, system-signal=CAN4_PT_High_Tact_Err}, {implementation-record-element=CAN4_PT_High_Tact, system-signal=CAN4_PT_High_Tact}, {implementation-record-element=CAN4_PT_High_T, system-signal=CAN4_PT_High_T}, {implementation-record-element=CAN4_PT_High_P_Err, system-signal=CAN4_PT_High_P_Err}, {implementation-record-element=CAN4_PT_High_P, system-signal=CAN4_PT_High_P}, {implementation-record-element=CAN4_Motor_Out_Temp_Err, system-signal=CAN4_Motor_Out_Temp_Err}, {implementation-record-element=CAN4_Motor_Out_Temp, system-signal=CAN4_Motor_Out_Temp}, {implementation-record-element=CAN4_Motor_In_Temp_Err, system-signal=CAN4_Motor_In_Temp_Err}, {implementation-record-element=CAN4_Motor_In_Temp, system-signal=CAN4_Motor_In_Temp}, {implementation-record-element=CAN4_FrStdA2PErr, system-signal=CAN4_FrStdA2PErr}, {implementation-record-element=CAN4_FrStdA2PCErr, system-signal=CAN4_FrStdA2PCErr}, {implementation-record-element=CAN4_FrStdA1PCErr, system-signal=CAN4_FrStdA1PCErr}, {implementation-record-element=CAN4_FrPwrStdbyA2PlusFault, system-signal=CAN4_FrPwrStdbyA2PlusFault}, {implementation-record-element=CAN4_FrPwrStdbyA2PlusCurr, system-signal=CAN4_FrPwrStdbyA2PlusCurr}, {implementation-record-element=CAN4_FrPwrStdbyA2Curr, system-signal=CAN4_FrPwrStdbyA2Curr}, {implementation-record-element=CAN4_FrPwrStdbyA1PlusFault, system-signal=CAN4_FrPwrStdbyA1PlusFault}, {implementation-record-element=CAN4_FrPwrStdbyA1PlusCurr, system-signal=CAN4_FrPwrStdbyA1PlusCurr}, {implementation-record-element=CAN4_FrPwrStdbyA1Fault, system-signal=CAN4_FrPwrStdbyA1Fault}, {implementation-record-element=CAN4_FrPwrSta, system-signal=CAN4_FrPwrSta}, {implementation-record-element=CAN4_FrPwrONA3Curr, system-signal=CAN4_FrPwrONA3Curr}, {implementation-record-element=CAN4_FrPwrONA2Curr, system-signal=CAN4_FrPwrONA2Curr}, {implementation-record-element=CAN4_FrPwrONA1Fault, system-signal=CAN4_FrPwrONA1Fault}, {implementation-record-element=CAN4_FrPowerTemp2, system-signal=CAN4_FrPowerTemp2}, {implementation-record-element=CAN4_FrPowerTemp1, system-signal=CAN4_FrPowerTemp1}, {implementation-record-element=CAN4_FrPMMSysErrLmp, system-signal=CAN4_FrPMMSysErrLmp}, {implementation-record-element=CAN4_FrPMMLimpHomeActReq, system-signal=CAN4_FrPMMLimpHomeActReq}, {implementation-record-element=CAN4_FrPMMLVOutPErrLmp, system-signal=CAN4_FrPMMLVOutPErrLmp}, {implementation-record-element=CAN4_FrIRC_2Curr, system-signal=CAN4_FrIRC_2Curr}, {implementation-record-element=CAN4_FrIRC_1Curr, system-signal=CAN4_FrIRC_1Curr}, {implementation-record-element=CAN4_FrEDU_INVERTERFault, system-signal=CAN4_FrEDU_INVERTERFault}, {implementation-record-element=CAN4_FrEDU_INVERTERCurr, system-signal=CAN4_FrEDU_INVERTERCurr}, {implementation-record-element=CAN4_FrEDUErr, system-signal=CAN4_FrEDUErr}, {implementation-record-element=CAN4_FrCtrlTemp, system-signal=CAN4_FrCtrlTemp}, {implementation-record-element=CAN4_FrCtrlBDVolt, system-signal=CAN4_FrCtrlBDVolt}, {implementation-record-element=CAN4_FrBMS_CCU_CIRFault, system-signal=CAN4_FrBMS_CCU_CIRFault}, {implementation-record-element=CAN4_FrBMS_CCU_CIRCurr, system-signal=CAN4_FrBMS_CCU_CIRCurr}, {implementation-record-element=CAN4_FrBMSCCUCErr, system-signal=CAN4_FrBMSCCUCErr}, {implementation-record-element=CAN4_Fan_Err, system-signal=CAN4_Fan_Err}, {implementation-record-element=CAN4_FWV_Err, system-signal=CAN4_FWV_Err}, {implementation-record-element=CAN4_EXV2_Err, system-signal=CAN4_EXV2_Err}, {implementation-record-element=CAN4_EXV1_Err, system-signal=CAN4_EXV1_Err}, {implementation-record-element=CAN4_EWP3_Err, system-signal=CAN4_EWP3_Err}, {implementation-record-element=CAN4_EWP2_Err, system-signal=CAN4_EWP2_Err}, {implementation-record-element=CAN4_EWP1_Err, system-signal=CAN4_EWP1_Err}, {implementation-record-element=CAN4_EACProtectEnable, system-signal=CAN4_EACProtectEnable}, {implementation-record-element=CAN4_COMP_Err, system-signal=CAN4_COMP_Err}, {implementation-record-element=CAN4_Bat_Out_Temp_Err, system-signal=CAN4_Bat_Out_Temp_Err}, {implementation-record-element=CAN4_Bat_Out_Temp, system-signal=CAN4_Bat_Out_Temp}, {implementation-record-element=CAN4_Bat_In_Temp_Err, system-signal=CAN4_Bat_In_Temp_Err}]}
      MAP_CGW_R_CAN4_zGW_APTC1: sender-receiver-to-signal-group-mapping{communication-direction=IN, data-element=SWC_CGW.root_FDC.R_CAN4_zGW_APTC1.CAN4_SG_zGW_APTC1, signal-group=CAN4_SG_zGW_APTC1, type-mapping=sender-rec-record-type-mapping=record-element-mappings=[{implementation-record-element=CAN4_FrntPTCBusLineHiV, system-signal=CAN4_FrntPTCBusLineHiV}, {implementation-record-element=CAN4_FrntPTCSupplierCod, system-signal=CAN4_FrntPTCSupplierCod}, {implementation-record-element=CAN4_FrntPTCSts, system-signal=CAN4_FrntPTCSts}, {implementation-record-element=CAN4_FrntPTCSWVers, system-signal=CAN4_FrntPTCSWVers}, {implementation-record-element=CAN4_FrntPTCRiOverAFlt, system-signal=CAN4_FrntPTCRiOverAFlt}, {implementation-record-element=CAN4_FrntPTCRiOpentCircFlt, system-signal=CAN4_FrntPTCRiOpentCircFlt}, {implementation-record-element=CAN4_FrntPTCRiIGBTTSnsrFlt, system-signal=CAN4_FrntPTCRiIGBTTSnsrFlt}, {implementation-record-element=CAN4_FrntPTCRiIGBTT, system-signal=CAN4_FrntPTCRiIGBTT}, {implementation-record-element=CAN4_FrntPTCRiIGBTShoCircFlt, system-signal=CAN4_FrntPTCRiIGBTShoCircFlt}, {implementation-record-element=CAN4_FrntPTCRiIGBTOverTFlt, system-signal=CAN4_FrntPTCRiIGBTOverTFlt}, {implementation-record-element=CAN4_FrntPTCRiCoreTSnsrFlt, system-signal=CAN4_FrntPTCRiCoreTSnsrFlt}, {implementation-record-element=CAN4_FrntPTCRiCoreT, system-signal=CAN4_FrntPTCRiCoreT}, {implementation-record-element=CAN4_FrntPTCRiCoreOverTFlt, system-signal=CAN4_FrntPTCRiCoreOverTFlt}, {implementation-record-element=CAN4_FrntPTCRiBusLineC, system-signal=CAN4_FrntPTCRiBusLineC}, {implementation-record-element=CAN4_FrntPTCRiActHeatPwr, system-signal=CAN4_FrntPTCRiActHeatPwr}, {implementation-record-element=CAN4_FrntPTCRearRiOverAFlt, system-signal=CAN4_FrntPTCRearRiOverAFlt}, {implementation-record-element=CAN4_FrntPTCRearRiOpentCircFlt, system-signal=CAN4_FrntPTCRearRiOpentCircFlt}, {implementation-record-element=CAN4_FrntPTCRearRiIGBTShoCFlt, system-signal=CAN4_FrntPTCRearRiIGBTShoCFlt}, {implementation-record-element=CAN4_FrntPTCRearRiCoreTSnsrFlt, system-signal=CAN4_FrntPTCRearRiCoreTSnsrFlt}, {implementation-record-element=CAN4_FrntPTCRearRiCoreT, system-signal=CAN4_FrntPTCRearRiCoreT}, {implementation-record-element=CAN4_FrntPTCRearRiCoreOverTFlt, system-signal=CAN4_FrntPTCRearRiCoreOverTFlt}, {implementation-record-element=CAN4_FrntPTCRearRiBusLineC, system-signal=CAN4_FrntPTCRearRiBusLineC}, {implementation-record-element=CAN4_FrntPTCRearRiActHeatPwr, system-signal=CAN4_FrntPTCRearRiActHeatPwr}, {implementation-record-element=CAN4_FrntPTCRearLeOverAFlt, system-signal=CAN4_FrntPTCRearLeOverAFlt}, {implementation-record-element=CAN4_FrntPTCRearLeOpentCircFlt, system-signal=CAN4_FrntPTCRearLeOpentCircFlt}, {implementation-record-element=CAN4_FrntPTCRearLeIGBTShoCFlt, system-signal=CAN4_FrntPTCRearLeIGBTShoCFlt}, {implementation-record-element=CAN4_FrntPTCRearLeCoreTSnsrFlt, system-signal=CAN4_FrntPTCRearLeCoreTSnsrFlt}, {implementation-record-element=CAN4_FrntPTCRearLeCoreT, system-signal=CAN4_FrntPTCRearLeCoreT}, {implementation-record-element=CAN4_FrntPTCRearLeCoreOverTFlt, system-signal=CAN4_FrntPTCRearLeCoreOverTFlt}, {implementation-record-element=CAN4_FrntPTCRearLeBusLineC, system-signal=CAN4_FrntPTCRearLeBusLineC}, {implementation-record-element=CAN4_FrntPTCRearLeActHeatPwr, system-signal=CAN4_FrntPTCRearLeActHeatPwr}, {implementation-record-element=CAN4_FrntPTCPCBTSnsrFlt, system-signal=CAN4_FrntPTCPCBTSnsrFlt}, {implementation-record-element=CAN4_FrntPTCPCBT, system-signal=CAN4_FrntPTCPCBT}, {implementation-record-element=CAN4_FrntPTCPCBOverTFlt, system-signal=CAN4_FrntPTCPCBOverTFlt}, {implementation-record-element=CAN4_FrntPTCLeOverAFlt, system-signal=CAN4_FrntPTCLeOverAFlt}, {implementation-record-element=CAN4_FrntPTCLeOpentCircFlt, system-signal=CAN4_FrntPTCLeOpentCircFlt}, {implementation-record-element=CAN4_FrntPTCLeIGBTTSnsrFlt, system-signal=CAN4_FrntPTCLeIGBTTSnsrFlt}, {implementation-record-element=CAN4_FrntPTCLeIGBTT, system-signal=CAN4_FrntPTCLeIGBTT}, {implementation-record-element=CAN4_FrntPTCLeIGBTShoCircFlt, system-signal=CAN4_FrntPTCLeIGBTShoCircFlt}, {implementation-record-element=CAN4_FrntPTCLeIGBTOverTFlt, system-signal=CAN4_FrntPTCLeIGBTOverTFlt}, {implementation-record-element=CAN4_FrntPTCLeCoreTSnsrFlt, system-signal=CAN4_FrntPTCLeCoreTSnsrFlt}, {implementation-record-element=CAN4_FrntPTCLeCoreT, system-signal=CAN4_FrntPTCLeCoreT}, {implementation-record-element=CAN4_FrntPTCLeCoreOverTFlt, system-signal=CAN4_FrntPTCLeCoreOverTFlt}, {implementation-record-element=CAN4_FrntPTCLeBusLineC, system-signal=CAN4_FrntPTCLeBusLineC}, {implementation-record-element=CAN4_FrntPTCLeActHeatPwr, system-signal=CAN4_FrntPTCLeActHeatPwr}, {implementation-record-element=CAN4_FrntPTCLVUnderUFlt, system-signal=CAN4_FrntPTCLVUnderUFlt}, {implementation-record-element=CAN4_FrntPTCLVOverUFlt, system-signal=CAN4_FrntPTCLVOverUFlt}, {implementation-record-element=CAN4_FrntPTCHWVers, system-signal=CAN4_FrntPTCHWVers}, {implementation-record-element=CAN4_FrntPTCHVUnderUFlt, system-signal=CAN4_FrntPTCHVUnderUFlt}, {implementation-record-element=CAN4_FrntPTCHVOverUFlt, system-signal=CAN4_FrntPTCHVOverUFlt}, {implementation-record-element=CAN4_FrntPTCFltSt, system-signal=CAN4_FrntPTCFltSt}, {implementation-record-element=CAN4_FrntPTCComFlt, system-signal=CAN4_FrntPTCComFlt}]}
      MAP_CGW_R_CAN4_zGW_CANFr1: sender-receiver-to-signal-group-mapping{communication-direction=IN, data-element=SWC_CGW.root_FDC.R_CAN4_zGW_CANFr1.CAN4_SG_zGW_CANFr1, signal-group=CAN4_SG_zGW_CANFr1, type-mapping=sender-rec-record-type-mapping=record-element-mappings=[{implementation-record-element=CAN4_COMP_ActualPwr, system-signal=CAN4_COMP_ActualPwr}, {implementation-record-element=CAN4_PTCUnderVolHSC6, system-signal=CAN4_PTCUnderVolHSC6}, {implementation-record-element=CAN4_PTCStsHSC6, system-signal=CAN4_PTCStsHSC6}, {implementation-record-element=CAN4_PTCSecRlngCtrHSC6, system-signal=CAN4_PTCSecRlngCtrHSC6}, {implementation-record-element=CAN4_PTCSecChksmHSC6, system-signal=CAN4_PTCSecChksmHSC6}, {implementation-record-element=CAN4_PTCRlngCtrHSC6, system-signal=CAN4_PTCRlngCtrHSC6}, {implementation-record-element=CAN4_PTCPCBTemHSC6, system-signal=CAN4_PTCPCBTemHSC6}, {implementation-record-element=CAN4_PTCOverVolHSC6, system-signal=CAN4_PTCOverVolHSC6}, {implementation-record-element=CAN4_PTCOverHeatHSC6, system-signal=CAN4_PTCOverHeatHSC6}, {implementation-record-element=CAN4_PTCOverCrntHSC6, system-signal=CAN4_PTCOverCrntHSC6}, {implementation-record-element=CAN4_PTCOtptTemHSC6, system-signal=CAN4_PTCOtptTemHSC6}, {implementation-record-element=CAN4_PTCNTCStsHSC6, system-signal=CAN4_PTCNTCStsHSC6}, {implementation-record-element=CAN4_PTCIGBTTemHSC6, system-signal=CAN4_PTCIGBTTemHSC6}, {implementation-record-element=CAN4_PTCIGBTStsHSC6, system-signal=CAN4_PTCIGBTStsHSC6}, {implementation-record-element=CAN4_PTCIGBTOverHeatHSC6, system-signal=CAN4_PTCIGBTOverHeatHSC6}, {implementation-record-element=CAN4_PTCHVLckStsHSC6, system-signal=CAN4_PTCHVLckStsHSC6}, {implementation-record-element=CAN4_PTCFltLvlHSC6, system-signal=CAN4_PTCFltLvlHSC6}, {implementation-record-element=CAN4_PTCChksmHSC6, system-signal=CAN4_PTCChksmHSC6}, {implementation-record-element=CAN4_PTCActuVolHSC6, system-signal=CAN4_PTCActuVolHSC6}, {implementation-record-element=CAN4_PTCActuPwrHSC6, system-signal=CAN4_PTCActuPwrHSC6}, {implementation-record-element=CAN4_PTCActuPWMDutyHSC6, system-signal=CAN4_PTCActuPWMDutyHSC6}, {implementation-record-element=CAN4_PTCActuCrntHSC6, system-signal=CAN4_PTCActuCrntHSC6}, {implementation-record-element=CAN4_PTC1_PowerConsumption, system-signal=CAN4_PTC1_PowerConsumption}, {implementation-record-element=CAN4_EAC_TempSnsrFalt, system-signal=CAN4_EAC_TempSnsrFalt}, {implementation-record-element=CAN4_EAC_Temp, system-signal=CAN4_EAC_Temp}, {implementation-record-element=CAN4_EAC_OvLoadFalt, system-signal=CAN4_EAC_OvLoadFalt}, {implementation-record-element=CAN4_EAC_MotorLackFalt, system-signal=CAN4_EAC_MotorLackFalt}, {implementation-record-element=CAN4_EAC_MotCrt, system-signal=CAN4_EAC_MotCrt}, {implementation-record-element=CAN4_EAC_DrvVoltFalt, system-signal=CAN4_EAC_DrvVoltFalt}, {implementation-record-element=CAN4_COMP_VoltVaild, system-signal=CAN4_COMP_VoltVaild}, {implementation-record-element=CAN4_COMP_VoltOverErr, system-signal=CAN4_COMP_VoltOverErr}, {implementation-record-element=CAN4_COMP_VoltLessErr, system-signal=CAN4_COMP_VoltLessErr}, {implementation-record-element=CAN4_COMP_StatorSpd, system-signal=CAN4_COMP_StatorSpd}, {implementation-record-element=CAN4_COMP_Sta, system-signal=CAN4_COMP_Sta}, {implementation-record-element=CAN4_COMP_SpdVaild, system-signal=CAN4_COMP_SpdVaild}, {implementation-record-element=CAN4_COMP_Init, system-signal=CAN4_COMP_Init}, {implementation-record-element=CAN4_COMP_IPM_TempOverFlt, system-signal=CAN4_COMP_IPM_TempOverFlt}, {implementation-record-element=CAN4_COMP_IPM_HWFLt, system-signal=CAN4_COMP_IPM_HWFLt}, {implementation-record-element=CAN4_COMP_CurVaild, system-signal=CAN4_COMP_CurVaild}, {implementation-record-element=CAN4_COMP_CurOverProtect, system-signal=CAN4_COMP_CurOverProtect}, {implementation-record-element=CAN4_COMP_CtrlCircFlt, system-signal=CAN4_COMP_CtrlCircFlt}, {implementation-record-element=CAN4_COMP_ConVolt, system-signal=CAN4_COMP_ConVolt}, {implementation-record-element=CAN4_COMP_ConCur, system-signal=CAN4_COMP_ConCur}, {implementation-record-element=CAN4_COMP_ComLost, system-signal=CAN4_COMP_ComLost}]}
      MAP_CGW_R_CAN4_zGW_LINDr1: sender-receiver-to-signal-group-mapping{communication-direction=IN, data-element=SWC_CGW.root_FDC.R_CAN4_zGW_LINDr1.CAN4_SG_zGW_LINDr1, signal-group=CAN4_SG_zGW_LINDr1, type-mapping=sender-rec-record-type-mapping=record-element-mappings=[{implementation-record-element=CAN4_CSW_DimSw, system-signal=CAN4_CSW_DimSw}, {implementation-record-element=CAN4_SWC_resp_error, system-signal=CAN4_SWC_resp_error}, {implementation-record-element=CAN4_SWC_mode_Sta, system-signal=CAN4_SWC_mode_Sta}, {implementation-record-element=CAN4_SWC_VR_Sta, system-signal=CAN4_SWC_VR_Sta}, {implementation-record-element=CAN4_SWC_Up_Sta, system-signal=CAN4_SWC_Up_Sta}, {implementation-record-element=CAN4_SWC_Undefined_Sta, system-signal=CAN4_SWC_Undefined_Sta}, {implementation-record-element=CAN4_SWC_Trip_Sta, system-signal=CAN4_SWC_Trip_Sta}, {implementation-record-element=CAN4_SWC_Set_down_Sta, system-signal=CAN4_SWC_Set_down_Sta}, {implementation-record-element=CAN4_SWC_Right_Sta, system-signal=CAN4_SWC_Right_Sta}, {implementation-record-element=CAN4_SWC_Res_Up_Sta, system-signal=CAN4_SWC_Res_Up_Sta}, {implementation-record-element=CAN4_SWC_RegenUp, system-signal=CAN4_SWC_RegenUp}, {implementation-record-element=CAN4_SWC_RegenDown, system-signal=CAN4_SWC_RegenDown}, {implementation-record-element=CAN4_SWC_Left_Sta, system-signal=CAN4_SWC_Left_Sta}, {implementation-record-element=CAN4_SWC_LKA_Sta, system-signal=CAN4_SWC_LKA_Sta}, {implementation-record-element=CAN4_SWC_Drivemode_Sta, system-signal=CAN4_SWC_Drivemode_Sta}, {implementation-record-element=CAN4_SWC_Down_Sta, system-signal=CAN4_SWC_Down_Sta}, {implementation-record-element=CAN4_SWC_Distance_Sta, system-signal=CAN4_SWC_Distance_Sta}, {implementation-record-element=CAN4_SWC_CANCEL_Sta, system-signal=CAN4_SWC_CANCEL_Sta}, {implementation-record-element=CAN4_SWC_A_SW_version, system-signal=CAN4_SWC_A_SW_version}, {implementation-record-element=CAN4_SWC_A_Resp_Err, system-signal=CAN4_SWC_A_Resp_Err}, {implementation-record-element=CAN4_SWC_A_HW_version, system-signal=CAN4_SWC_A_HW_version}, {implementation-record-element=CAN4_SWC_ACC_Sta, system-signal=CAN4_SWC_ACC_Sta}, {implementation-record-element=CAN4_SWC2_SW_Version, system-signal=CAN4_SWC2_SW_Version}, {implementation-record-element=CAN4_SWC2_ResponseError, system-signal=CAN4_SWC2_ResponseError}, {implementation-record-element=CAN4_SWC2_R_VR_Sta, system-signal=CAN4_SWC2_R_VR_Sta}, {implementation-record-element=CAN4_SWC2_R_ScrollUp_Sta, system-signal=CAN4_SWC2_R_ScrollUp_Sta}, {implementation-record-element=CAN4_SWC2_R_ScrollPress_Sta, system-signal=CAN4_SWC2_R_ScrollPress_Sta}, {implementation-record-element=CAN4_SWC2_R_ScrollDown_Sta, system-signal=CAN4_SWC2_R_ScrollDown_Sta}, {implementation-record-element=CAN4_SWC2_R_Right_Sta, system-signal=CAN4_SWC2_R_Right_Sta}, {implementation-record-element=CAN4_SWC2_R_RegenDown_Sta, system-signal=CAN4_SWC2_R_RegenDown_Sta}, {implementation-record-element=CAN4_SWC2_R_PageSwitch_Sta, system-signal=CAN4_SWC2_R_PageSwitch_Sta}, {implementation-record-element=CAN4_SWC2_R_Left_Sta, system-signal=CAN4_SWC2_R_Left_Sta}, {implementation-record-element=CAN4_SWC2_R_Customize_Sta, system-signal=CAN4_SWC2_R_Customize_Sta}, {implementation-record-element=CAN4_SWC2_L_ScrollUp_Sta, system-signal=CAN4_SWC2_L_ScrollUp_Sta}, {implementation-record-element=CAN4_SWC2_L_ScrollPress_Sta, system-signal=CAN4_SWC2_L_ScrollPress_Sta}, {implementation-record-element=CAN4_SWC2_L_ScrollDown_Sta, system-signal=CAN4_SWC2_L_ScrollDown_Sta}, {implementation-record-element=CAN4_SWC2_L_Right_Sta, system-signal=CAN4_SWC2_L_Right_Sta}, {implementation-record-element=CAN4_SWC2_L_RegenUp_Sta, system-signal=CAN4_SWC2_L_RegenUp_Sta}, {implementation-record-element=CAN4_SWC2_L_Left_Sta, system-signal=CAN4_SWC2_L_Left_Sta}, {implementation-record-element=CAN4_SWC2_L_Home_Sta, system-signal=CAN4_SWC2_L_Home_Sta}, {implementation-record-element=CAN4_SWC2_L_DriveMode_Sta, system-signal=CAN4_SWC2_L_DriveMode_Sta}, {implementation-record-element=CAN4_SWC2_L_ADAS_Sta, system-signal=CAN4_SWC2_L_ADAS_Sta}, {implementation-record-element=CAN4_SWC2_HW_Version, system-signal=CAN4_SWC2_HW_Version}, {implementation-record-element=CAN4_RLS_RainSnrWiperCmd, system-signal=CAN4_RLS_RainSnrWiperCmd}, {implementation-record-element=CAN4_RLS_RainSnrErr, system-signal=CAN4_RLS_RainSnrErr}, {implementation-record-element=CAN4_RLS_LightSnrErr, system-signal=CAN4_RLS_LightSnrErr}, {implementation-record-element=CAN4_RLS_Lamp_Sta, system-signal=CAN4_RLS_Lamp_Sta}, {implementation-record-element=CAN4_RLS_LIN_Resp_Err, system-signal=CAN4_RLS_LIN_Resp_Err}, {implementation-record-element=CAN4_RAPWL_01_LIN_Response_Error, system-signal=CAN4_RAPWL_01_LIN_Response_Error}, {implementation-record-element=CAN4_L_RRD_Wdw_Running_Sts, system-signal=CAN4_L_RRD_Wdw_Running_Sts}, {implementation-record-element=CAN4_L_RRD_Wdw_PositionSts, system-signal=CAN4_L_RRD_Wdw_PositionSts}, {implementation-record-element=CAN4_L_RRD_Wdw_Obs_InhibitSts, system-signal=CAN4_L_RRD_Wdw_Obs_InhibitSts}, {implementation-record-element=CAN4_L_RRD_Wdw_OD_Sts, system-signal=CAN4_L_RRD_Wdw_OD_Sts}, {implementation-record-element=CAN4_L_RRD_Wdw_LocalSwitch, system-signal=CAN4_L_RRD_Wdw_LocalSwitch}, {implementation-record-element=CAN4_L_RRD_Wdw_Init, system-signal=CAN4_L_RRD_Wdw_Init}, {implementation-record-element=CAN4_L_RRD_Val_Wdw_Opened, system-signal=CAN4_L_RRD_Val_Wdw_Opened}, {implementation-record-element=CAN4_L_RRD_OverHeat_Protect, system-signal=CAN4_L_RRD_OverHeat_Protect}, {implementation-record-element=CAN4_L_RRD_Motor_Ripple_Error, system-signal=CAN4_L_RRD_Motor_Ripple_Error}, {implementation-record-element=CAN4_L_RRD_Motor_Relay_Error, system-signal=CAN4_L_RRD_Motor_Relay_Error}, {implementation-record-element=CAN4_L_RLD_Wdw_Running_Sts, system-signal=CAN4_L_RLD_Wdw_Running_Sts}, {implementation-record-element=CAN4_L_RLD_Wdw_PositionSts, system-signal=CAN4_L_RLD_Wdw_PositionSts}, {implementation-record-element=CAN4_L_RLD_Wdw_Obs_InhibitSts, system-signal=CAN4_L_RLD_Wdw_Obs_InhibitSts}, {implementation-record-element=CAN4_L_RLD_Wdw_OD_Sts, system-signal=CAN4_L_RLD_Wdw_OD_Sts}, {implementation-record-element=CAN4_L_RLD_Wdw_LocalSwitch, system-signal=CAN4_L_RLD_Wdw_LocalSwitch}, {implementation-record-element=CAN4_L_RLD_Wdw_Init, system-signal=CAN4_L_RLD_Wdw_Init}, {implementation-record-element=CAN4_L_RLD_Val_Wdw_Opened, system-signal=CAN4_L_RLD_Val_Wdw_Opened}, {implementation-record-element=CAN4_L_RLD_OverHeat_Protect, system-signal=CAN4_L_RLD_OverHeat_Protect}, {implementation-record-element=CAN4_L_RLD_Motor_Ripple_Error, system-signal=CAN4_L_RLD_Motor_Ripple_Error}, {implementation-record-element=CAN4_L_RLD_Motor_Relay_Error, system-signal=CAN4_L_RLD_Motor_Relay_Error}, {implementation-record-element=CAN4_L_Power_Status, system-signal=CAN4_L_Power_Status}, {implementation-record-element=CAN4_L_Pas_Wdw_Running_Sts, system-signal=CAN4_L_Pas_Wdw_Running_Sts}, {implementation-record-element=CAN4_L_Pas_Wdw_PositionSts, system-signal=CAN4_L_Pas_Wdw_PositionSts}, {implementation-record-element=CAN4_L_Pas_Wdw_Obs_InhibitSts, system-signal=CAN4_L_Pas_Wdw_Obs_InhibitSts}, {implementation-record-element=CAN4_L_Pas_Wdw_OD_Sts, system-signal=CAN4_L_Pas_Wdw_OD_Sts}, {implementation-record-element=CAN4_L_Pas_Wdw_LocalSwitch, system-signal=CAN4_L_Pas_Wdw_LocalSwitch}, {implementation-record-element=CAN4_L_Pas_Wdw_Init, system-signal=CAN4_L_Pas_Wdw_Init}, {implementation-record-element=CAN4_L_Pas_Val_Wdw_Opened, system-signal=CAN4_L_Pas_Val_Wdw_Opened}, {implementation-record-element=CAN4_L_Pas_OverHeat_Protect, system-signal=CAN4_L_Pas_OverHeat_Protect}, {implementation-record-element=CAN4_L_Pas_Motor_Ripple_Error, system-signal=CAN4_L_Pas_Motor_Ripple_Error}, {implementation-record-element=CAN4_L_Pas_Motor_Relay_Error, system-signal=CAN4_L_Pas_Motor_Relay_Error}, {implementation-record-element=CAN4_L_Drv_Wdw_Running_Sts, system-signal=CAN4_L_Drv_Wdw_Running_Sts}, {implementation-record-element=CAN4_L_Drv_Wdw_RRD_Switch, system-signal=CAN4_L_Drv_Wdw_RRD_Switch}, {implementation-record-element=CAN4_L_Drv_Wdw_RLD_Switch, system-signal=CAN4_L_Drv_Wdw_RLD_Switch}, {implementation-record-element=CAN4_L_Drv_Wdw_PositionSts, system-signal=CAN4_L_Drv_Wdw_PositionSts}, {implementation-record-element=CAN4_L_Drv_Wdw_Pas_Switch, system-signal=CAN4_L_Drv_Wdw_Pas_Switch}, {implementation-record-element=CAN4_L_Drv_Wdw_Obs_InhibitSts, system-signal=CAN4_L_Drv_Wdw_Obs_InhibitSts}, {implementation-record-element=CAN4_L_Drv_Wdw_OD_Sts, system-signal=CAN4_L_Drv_Wdw_OD_Sts}, {implementation-record-element=CAN4_L_Drv_Wdw_LocalSwitch, system-signal=CAN4_L_Drv_Wdw_LocalSwitch}, {implementation-record-element=CAN4_L_Drv_Wdw_Init, system-signal=CAN4_L_Drv_Wdw_Init}, {implementation-record-element=CAN4_L_Drv_Val_Wdw_Opened, system-signal=CAN4_L_Drv_Val_Wdw_Opened}, {implementation-record-element=CAN4_L_Drv_OverHeat_Protect, system-signal=CAN4_L_Drv_OverHeat_Protect}, {implementation-record-element=CAN4_L_Drv_Motor_Ripple_Error, system-signal=CAN4_L_Drv_Motor_Ripple_Error}, {implementation-record-element=CAN4_L_Drv_Motor_Relay_Error, system-signal=CAN4_L_Drv_Motor_Relay_Error}, {implementation-record-element=CAN4_FAPWL_01_LIN_Response_Error, system-signal=CAN4_FAPWL_01_LIN_Response_Error}, {implementation-record-element=CAN4_CSW_resp_error, system-signal=CAN4_CSW_resp_error}, {implementation-record-element=CAN4_CSW_TurnSw_Sta, system-signal=CAN4_CSW_TurnSw_Sta}, {implementation-record-element=CAN4_CSW_SW_version, system-signal=CAN4_CSW_SW_version}, {implementation-record-element=CAN4_CSW_RWipIntSw_Sta, system-signal=CAN4_CSW_RWipIntSw_Sta}, {implementation-record-element=CAN4_CSW_RWasSW_Sta, system-signal=CAN4_CSW_RWasSW_Sta}, {implementation-record-element=CAN4_CSW_PassSW_Sta, system-signal=CAN4_CSW_PassSW_Sta}, {implementation-record-element=CAN4_CSW_HW_version, system-signal=CAN4_CSW_HW_version}, {implementation-record-element=CAN4_CSW_FWipSw_Sta, system-signal=CAN4_CSW_FWipSw_Sta}, {implementation-record-element=CAN4_CSW_FWasSw_Sta, system-signal=CAN4_CSW_FWasSw_Sta}]}
      MAP_CGW_R_CAN5_TBOX1: sender-receiver-to-signal-group-mapping{communication-direction=IN, data-element=SWC_CGW.root_FDC.R_CAN5_TBOX1.CAN5_SG_TBOX1, signal-group=CAN5_SG_TBOX1, type-mapping=sender-rec-record-type-mapping=record-element-mappings=[{implementation-record-element=CAN5_Antitheft_Zero, system-signal=CAN5_Antitheft_Zero}, {implementation-record-element=CAN5_Uncounting_Req, system-signal=CAN5_Uncounting_Req}, {implementation-record-element=CAN5_TBOX_TEST_STATUS, system-signal=CAN5_TBOX_TEST_STATUS}, {implementation-record-element=CAN5_TBOX_Remote_PW, system-signal=CAN5_TBOX_Remote_PW}, {implementation-record-element=CAN5_TBOX_RemoteOn, system-signal=CAN5_TBOX_RemoteOn}, {implementation-record-element=CAN5_TBOX_Re_VehData, system-signal=CAN5_TBOX_Re_VehData}, {implementation-record-element=CAN5_TBOX_Re_DTCData, system-signal=CAN5_TBOX_Re_DTCData}, {implementation-record-element=CAN5_TBOX_NET_SIG_STR, system-signal=CAN5_TBOX_NET_SIG_STR}, {implementation-record-element=CAN5_Remote_MidAutoReq, system-signal=CAN5_Remote_MidAutoReq}, {implementation-record-element=CAN5_Remote_AutoReq, system-signal=CAN5_Remote_AutoReq}, {implementation-record-element=CAN5_Remote_ACTemp, system-signal=CAN5_Remote_ACTemp}, {implementation-record-element=CAN5_Re_Radio, system-signal=CAN5_Re_Radio}, {implementation-record-element=CAN5_Re_PwrReqTbox, system-signal=CAN5_Re_PwrReqTbox}, {implementation-record-element=CAN5_Re_DoorLock, system-signal=CAN5_Re_DoorLock}, {implementation-record-element=CAN5_ReOutsideMirror, system-signal=CAN5_ReOutsideMirror}, {implementation-record-element=CAN5_PowerOff_T_Set, system-signal=CAN5_PowerOff_T_Set}, {implementation-record-element=CAN5_CbnPreTarT, system-signal=CAN5_CbnPreTarT}, {implementation-record-element=CAN5_CbnPreReq, system-signal=CAN5_CbnPreReq}, {implementation-record-element=CAN5_CbnPreACEnaReq, system-signal=CAN5_CbnPreACEnaReq}]}
      MAP_CGW_R_CAN5_TBOX2: sender-receiver-to-signal-group-mapping{communication-direction=IN, data-element=SWC_CGW.root_FDC.R_CAN5_TBOX2.CAN5_SG_TBOX2, signal-group=CAN5_SG_TBOX2, type-mapping=sender-rec-record-type-mapping=record-element-mappings=[{implementation-record-element=CAN5_TimeSyncFromBS_Day, system-signal=CAN5_TimeSyncFromBS_Day}, {implementation-record-element=CAN5_TimeSyncFromBS_Year, system-signal=CAN5_TimeSyncFromBS_Year}, {implementation-record-element=CAN5_TimeSyncFromBS_Second, system-signal=CAN5_TimeSyncFromBS_Second}, {implementation-record-element=CAN5_TimeSyncFromBS_Month, system-signal=CAN5_TimeSyncFromBS_Month}, {implementation-record-element=CAN5_TimeSyncFromBS_Minute, system-signal=CAN5_TimeSyncFromBS_Minute}, {implementation-record-element=CAN5_TimeSyncFromBS_Hour, system-signal=CAN5_TimeSyncFromBS_Hour}]}
      MAP_CGW_R_CAN5_TBOX3: sender-receiver-to-signal-group-mapping{communication-direction=IN, data-element=SWC_CGW.root_FDC.R_CAN5_TBOX3.CAN5_SG_TBOX3, signal-group=CAN5_SG_TBOX3, type-mapping=sender-rec-record-type-mapping=record-element-mappings=[{implementation-record-element=CAN5_Charge_Percent_Set, system-signal=CAN5_Charge_Percent_Set}, {implementation-record-element=CAN5_TBOX_SW_VER, system-signal=CAN5_TBOX_SW_VER}, {implementation-record-element=CAN5_TBOX_HW_VER, system-signal=CAN5_TBOX_HW_VER}, {implementation-record-element=CAN5_ReserveChargeOn_Year, system-signal=CAN5_ReserveChargeOn_Year}, {implementation-record-element=CAN5_ReserveChargeOn_Month, system-signal=CAN5_ReserveChargeOn_Month}, {implementation-record-element=CAN5_ReserveChargeOn_Minute, system-signal=CAN5_ReserveChargeOn_Minute}, {implementation-record-element=CAN5_ReserveChargeOn_Hour, system-signal=CAN5_ReserveChargeOn_Hour}, {implementation-record-element=CAN5_ReserveChargeOn_Day, system-signal=CAN5_ReserveChargeOn_Day}, {implementation-record-element=CAN5_ReserveChargeOFF_Year, system-signal=CAN5_ReserveChargeOFF_Year}, {implementation-record-element=CAN5_ReserveChargeOFF_Month, system-signal=CAN5_ReserveChargeOFF_Month}, {implementation-record-element=CAN5_ReserveChargeOFF_Minute, system-signal=CAN5_ReserveChargeOFF_Minute}, {implementation-record-element=CAN5_ReserveChargeOFF_Hour, system-signal=CAN5_ReserveChargeOFF_Hour}, {implementation-record-element=CAN5_ReserveChargeOFF_Day, system-signal=CAN5_ReserveChargeOFF_Day}]}
    root-software-compositions:
      root sw composition prototype root_FDC: flat-map=root_FDC_FlatMap, software-composition=Comp_FDC_main
  flat map root_FDC_FlatMap
    flat instance descriptor FlatIns_FDC: upstream-reference=root_FDC.SWC_FDC, ecu-extract-reference=root_FDC.SWC_FDC
