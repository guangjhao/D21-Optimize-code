[part 2 of 2: packages /CAN2/ConstantSpecification to /CAN2/ImplementationDataTypes]
AUTOSAR XML (schema 4-3-0)
package /CAN2/ConstantSpecification
  600 x constant specification:
    Init_CAN2_APS_Angle_Target: value-spec=0
    Init_CAN2_APS_Rq_EPAS_Ctrl: value-spec=0
    Init_CAN2_APS_Sta_System: value-spec=0
    Init_CAN2_APS_V_Rq_EPAS_Ctrl: value-spec=0
    Init_CAN2_SG_FD_APS1: value-spec=fields=[Init_CAN2_APS_Angle_Target, Init_CAN2_APS_Rq_EPAS_Ctrl, Init_CAN2_APS_Sta_System, Init_CAN2_APS_V_Rq_EPAS_Ctrl]
    Init_CAN2_APS_D_FLL: value-spec=0
    Init_CAN2_APS_D_FLR: value-spec=0
    Init_CAN2_APS_D_RLL: value-spec=0
    Init_CAN2_APS_D_RLR: value-spec=0
    Init_CAN2_APS_ExitCondition: value-spec=0
    Init_CAN2_APS_HW_Ver: value-spec=0
    Init_CAN2_APS_Progress_PCT: value-spec=0
    Init_CAN2_APS_RQ_Display: value-spec=0
    Init_CAN2_APS_SW_Ver: value-spec=0
    Init_CAN2_FDC_VCU_RegenLimInd_Sta: value-spec=0
    Init_CAN2_FDC_VCU_SmartEcoSpdLim_Sta: value-spec=0
    Init_CAN2_FDC_VCU_SmartEco_Sta: value-spec=0
    Init_CAN2_PAS_A_FCL: value-spec=0
    Init_CAN2_PAS_A_FCR: value-spec=0
    Init_CAN2_PAS_A_FML: value-spec=0
    Init_CAN2_PAS_A_FMR: value-spec=0
    Init_CAN2_PAS_A_RCL: value-spec=0
    Init_CAN2_PAS_A_RCR: value-spec=0
    Init_CAN2_PAS_A_RML: value-spec=0
    Init_CAN2_PAS_A_RMR: value-spec=0
    Init_CAN2_PAS_Chime: value-spec=0
    Init_CAN2_PAS_D_FCL: value-spec=0
    Init_CAN2_PAS_D_FCR: value-spec=0
    Init_CAN2_PAS_D_FML: value-spec=0
    Init_CAN2_PAS_D_FMR: value-spec=0
    Init_CAN2_PAS_D_RCL: value-spec=0
    Init_CAN2_PAS_D_RCR: value-spec=0
    Init_CAN2_PAS_D_RML: value-spec=0
    Init_CAN2_PAS_D_RMR: value-spec=0
    Init_CAN2_PAS_Mod_Operation: value-spec=0
    Init_CAN2_PAS_SNSR_Layout: value-spec=0
    Init_CAN2_PAS_Sta_F_Sys: value-spec=0
    Init_CAN2_USS_Sta_FCL: value-spec=0
    Init_CAN2_USS_Sta_FCR: value-spec=0
    Init_CAN2_USS_Sta_FLL: value-spec=0
    Init_CAN2_USS_Sta_FLR: value-spec=0
    Init_CAN2_USS_Sta_FML: value-spec=0
    Init_CAN2_USS_Sta_FMR: value-spec=0
    Init_CAN2_USS_Sta_RCL: value-spec=0
    Init_CAN2_USS_Sta_RCR: value-spec=0
    Init_CAN2_USS_Sta_RLL: value-spec=0
    Init_CAN2_USS_Sta_RLR: value-spec=0
    Init_CAN2_USS_Sta_RML: value-spec=0
    Init_CAN2_USS_Sta_RMR: value-spec=0
    Init_CAN2_SG_FD_APS2: value-spec=fields=[Init_CAN2_APS_D_FLL, Init_CAN2_APS_D_FLR, Init_CAN2_APS_D_RLL, Init_CAN2_APS_D_RLR, Init_CAN2_APS_ExitCondition, Init_CAN2_APS_HW_Ver, Init_CAN2_APS_Progress_PCT, Init_CAN2_APS_RQ_Display, Init_CAN2_APS_SW_Ver, Init_CAN2_FDC_VCU_RegenLimInd_Sta, Init_CAN2_FDC_VCU_SmartEcoSpdLim_Sta, Init_CAN2_FDC_VCU_SmartEco_Sta, Init_CAN2_PAS_A_FCL, Init_CAN2_PAS_A_FCR, Init_CAN2_PAS_A_FML, Init_CAN2_PAS_A_FMR, Init_CAN2_PAS_A_RCL, Init_CAN2_PAS_A_RCR, Init_CAN2_PAS_A_RML, Init_CAN2_PAS_A_RMR, Init_CAN2_PAS_Chime, Init_CAN2_PAS_D_FCL, Init_CAN2_PAS_D_FCR, Init_CAN2_PAS_D_FML, Init_CAN2_PAS_D_FMR, Init_CAN2_PAS_D_RCL, Init_CAN2_PAS_D_RCR, Init_CAN2_PAS_D_RML, Init_CAN2_PAS_D_RMR, Init_CAN2_PAS_Mod_Operation, Init_CAN2_PAS_SNSR_Layout, Init_CAN2_PAS_Sta_F_Sys, Init_CAN2_USS_Sta_FCL, Init_CAN2_USS_Sta_FCR, Init_CAN2_USS_Sta_FLL, Init_CAN2_USS_Sta_FLR, Init_CAN2_USS_Sta_FML, Init_CAN2_USS_Sta_FMR, Init_CAN2_USS_Sta_RCL, Init_CAN2_USS_Sta_RCR, Init_CAN2_USS_Sta_RLL, Init_CAN2_USS_Sta_RLR, Init_CAN2_USS_Sta_RML, Init_CAN2_USS_Sta_RMR]
    Init_CAN2_APS3_LifeCount: value-spec=0
    Init_CAN2_APS3_checksum: value-spec=0
    Init_CAN2_APSOpenPTG: value-spec=0
    Init_CAN2_APS_DecReq: value-spec=0
    Init_CAN2_APS_DecReq_A: value-spec=0
    Init_CAN2_APS_Req: value-spec=0
    Init_CAN2_CAAS_Sta: value-spec=0
    Init_CAN2_SPTGDet: value-spec=0
    Init_CAN2_SPTG_Sta: value-spec=0
    Init_CAN2_SG_FD_APS3: value-spec=fields=[Init_CAN2_APS3_LifeCount, Init_CAN2_APS3_checksum, Init_CAN2_APSOpenPTG, Init_CAN2_APS_DecReq, Init_CAN2_APS_DecReq_A, Init_CAN2_APS_Req, Init_CAN2_CAAS_Sta, Init_CAN2_SPTGDet, Init_CAN2_SPTG_Sta]
    Init_CAN2_APMDoorControlSta: value-spec=0
    Init_CAN2_AllDoorSW: value-spec=0
    Init_CAN2_AntiTheftSeatFold: value-spec=0
    Init_CAN2_AntitheftSta: value-spec=0
    Init_CAN2_BCM_Buzzer_Req: value-spec=0
    Init_CAN2_BCM_DoorLock_Sta: value-spec=0
    Init_CAN2_BrakeLamp: value-spec=0
    Init_CAN2_CTDCtrl: value-spec=0
    Init_CAN2_CTDLockSW: value-spec=0
    Init_CAN2_CTDUnlockSW: value-spec=0
    Init_CAN2_CrashDetd: value-spec=0
    Init_CAN2_Dimmer: value-spec=0
    Init_CAN2_DimmerEN: value-spec=0
    Init_CAN2_DoorLockIND: value-spec=0
    Init_CAN2_DrDoorSW: value-spec=0
    Init_CAN2_FDC_BCM_LockAlarm_Cmd: value-spec=0
    Init_CAN2_FDC_THCM_APTCWarning_Sta: value-spec=0
    Init_CAN2_FollowMe: value-spec=0
    Init_CAN2_Fr_ChargingDoorCtrl: value-spec=0
    Init_CAN2_Fr_FogLamp: value-spec=0
    Init_CAN2_Fr_Wiper_H: value-spec=0
    Init_CAN2_Fr_Wiper_L: value-spec=0
    Init_CAN2_H_Beam: value-spec=0
    Init_CAN2_HazardSW: value-spec=0
    Init_CAN2_HoodSW: value-spec=0
    Init_CAN2_HornCtrl: value-spec=0
    Init_CAN2_LBSD: value-spec=0
    Init_CAN2_LDRL: value-spec=0
    Init_CAN2_LTurnLP: value-spec=0
    Init_CAN2_L_APM_WdwEnable: value-spec=0
    Init_CAN2_L_Beam: value-spec=0
    Init_CAN2_LockSetting: value-spec=0
    Init_CAN2_MirrorCtrl: value-spec=0
    Init_CAN2_MirrorDefog: value-spec=0
    Init_CAN2_PosLamp: value-spec=0
    Init_CAN2_PsDoorSW: value-spec=0
    Init_CAN2_RBSD: value-spec=0
    Init_CAN2_RDRL: value-spec=0
    Init_CAN2_RLDoorSW: value-spec=0
    Init_CAN2_RRDoorSW: value-spec=0
    Init_CAN2_RTurnLP: value-spec=0
    Init_CAN2_ReverseLamp: value-spec=0
    Init_CAN2_RoomLampH: value-spec=0
    Init_CAN2_RoomLampL: value-spec=0
    Init_CAN2_Rr_ChargingDoorCtrl: value-spec=0
    Init_CAN2_Rr_Defog: value-spec=0
    Init_CAN2_Rr_FogLamp: value-spec=0
    Init_CAN2_Rr_Wiper: value-spec=0
    Init_CAN2_TailgateHDSW: value-spec=0
    Init_CAN2_TailgateRemote: value-spec=0
    Init_CAN2_Tailgate_SW: value-spec=0
    Init_CAN2_TrunkRel: value-spec=0
    Init_CAN2_WasherCtrl: value-spec=0
    Init_CAN2_WiperFixMode: value-spec=0
    Init_CAN2_SG_FD_BCM1: value-spec=fields=[Init_CAN2_APMDoorControlSta, Init_CAN2_AllDoorSW, Init_CAN2_AntiTheftSeatFold, Init_CAN2_AntitheftSta, Init_CAN2_BCM_Buzzer_Req, Init_CAN2_BCM_DoorLock_Sta, Init_CAN2_BrakeLamp, Init_CAN2_CTDCtrl, Init_CAN2_CTDLockSW, Init_CAN2_CTDUnlockSW, Init_CAN2_CrashDetd, Init_CAN2_Dimmer, Init_CAN2_DimmerEN, Init_CAN2_DoorLockIND, Init_CAN2_DrDoorSW, Init_CAN2_FDC_BCM_LockAlarm_Cmd, Init_CAN2_FDC_THCM_APTCWarning_Sta, Init_CAN2_FollowMe, Init_CAN2_Fr_ChargingDoorCtrl, Init_CAN2_Fr_FogLamp, Init_CAN2_Fr_Wiper_H, Init_CAN2_Fr_Wiper_L, Init_CAN2_H_Beam, Init_CAN2_HazardSW, Init_CAN2_HoodSW, Init_CAN2_HornCtrl, Init_CAN2_LBSD, Init_CAN2_LDRL, Init_CAN2_LTurnLP, Init_CAN2_L_APM_WdwEnable, Init_CAN2_L_Beam, Init_CAN2_LockSetting, Init_CAN2_MirrorCtrl, Init_CAN2_MirrorDefog, Init_CAN2_PosLamp, Init_CAN2_PsDoorSW, Init_CAN2_RBSD, Init_CAN2_RDRL, Init_CAN2_RLDoorSW, Init_CAN2_RRDoorSW, Init_CAN2_RTurnLP, Init_CAN2_ReverseLamp, Init_CAN2_RoomLampH, Init_CAN2_RoomLampL, Init_CAN2_Rr_ChargingDoorCtrl, Init_CAN2_Rr_Defog, Init_CAN2_Rr_FogLamp, Init_CAN2_Rr_Wiper, Init_CAN2_TailgateHDSW, Init_CAN2_TailgateRemote, Init_CAN2_Tailgate_SW, Init_CAN2_TrunkRel, Init_CAN2_WasherCtrl, Init_CAN2_WiperFixMode]
    Init_CAN2_AmbLightBreath{1..3}: value-spec=0
    Init_CAN2_AmbLightBrightness{1..3}: value-spec=0
    Init_CAN2_AmbLightColor{1..3}: value-spec=0
    Init_CAN2_LampPwr: value-spec=0
    Init_CAN2_User1AmbLightColor: value-spec=0
    Init_CAN2_User1DrAmbLightBrightness: value-spec=0
    Init_CAN2_User1IPAmbLightBrightness: value-spec=0
    Init_CAN2_User2AmbLightColor: value-spec=0
    Init_CAN2_User2DrAmbLightBrightness: value-spec=0
    Init_CAN2_User2IPAmbLightBrightness: value-spec=0
    Init_CAN2_User3AmbLightColor: value-spec=0
    Init_CAN2_User3DrAmbLightBrightness: value-spec=0
    Init_CAN2_User3IPAmbLightBrightness: value-spec=0
    Init_CAN2_User4AmbLightColor: value-spec=0
    Init_CAN2_User4DrAmbLightBrightness: value-spec=0
    Init_CAN2_User4IPAmbLightBrightness: value-spec=0
    Init_CAN2_User5AmbLightColor: value-spec=0
    Init_CAN2_User5DrAmbLightBrightness: value-spec=0
    Init_CAN2_User5IPAmbLightBrightness: value-spec=0
    Init_CAN2_User6AmbLightColor: value-spec=0
    Init_CAN2_User6DrAmbLightBrightness: value-spec=0
    Init_CAN2_User6IPAmbLightBrightness: value-spec=0
    Init_CAN2_SG_FD_BCM2: value-spec=fields=[Init_CAN2_AmbLightBreath1, Init_CAN2_AmbLightBreath2, Init_CAN2_AmbLightBreath3, Init_CAN2_AmbLightBrightness1, Init_CAN2_AmbLightBrightness2, Init_CAN2_AmbLightBrightness3, Init_CAN2_AmbLightColor1, Init_CAN2_AmbLightColor2, Init_CAN2_AmbLightColor3, Init_CAN2_LampPwr, Init_CAN2_User1AmbLightColor, Init_CAN2_User1DrAmbLightBrightness, Init_CAN2_User1IPAmbLightBrightness, Init_CAN2_User2AmbLightColor, Init_CAN2_User2DrAmbLightBrightness, Init_CAN2_User2IPAmbLightBrightness, Init_CAN2_User3AmbLightColor, Init_CAN2_User3DrAmbLightBrightness, Init_CAN2_User3IPAmbLightBrightness, Init_CAN2_User4AmbLightColor, Init_CAN2_User4DrAmbLightBrightness, Init_CAN2_User4IPAmbLightBrightness, Init_CAN2_User5AmbLightColor, Init_CAN2_User5DrAmbLightBrightness, Init_CAN2_User5IPAmbLightBrightness, Init_CAN2_User6AmbLightColor, Init_CAN2_User6DrAmbLightBrightness, Init_CAN2_User6IPAmbLightBrightness]
    Init_CAN2_OTA_DL_Available: value-spec=0
    Init_CAN2_OTA_DL_Speed: value-spec=0
    Init_CAN2_OTA_Debug_Code: value-spec=0
    Init_CAN2_OTA_InVehicle_FW: value-spec=0
    Init_CAN2_OTA_Lock_Req: value-spec=0
    Init_CAN2_OTA_MDA_Status: value-spec=0
    Init_CAN2_OTA_Mode: value-spec=0
    Init_CAN2_OTA_Network_Type: value-spec=0
    Init_CAN2_OTA_Permit_Agreed: value-spec=0
    Init_CAN2_OTA_Progress_Rate: value-spec=0
    Init_CAN2_OTA_Remained_Time: value-spec=0
    Init_CAN2_OTA_TBOXResetReq: value-spec=0
    Init_CAN2_OTA_Up_Backcount: value-spec=0
    Init_CAN2_OTA_Update_Available: value-spec=0
    Init_CAN2_OTA_Updating_ECU: value-spec=0
    Init_CAN2_OTA_Updating_ECU_8bit: value-spec=0
    Init_CAN2_SG_FD_OTA1: value-spec=fields=[Init_CAN2_OTA_DL_Available, Init_CAN2_OTA_DL_Speed, Init_CAN2_OTA_Debug_Code, Init_CAN2_OTA_InVehicle_FW, Init_CAN2_OTA_Lock_Req, Init_CAN2_OTA_MDA_Status, Init_CAN2_OTA_Mode, Init_CAN2_OTA_Network_Type, Init_CAN2_OTA_Permit_Agreed, Init_CAN2_OTA_Progress_Rate, Init_CAN2_OTA_Remained_Time, Init_CAN2_OTA_TBOXResetReq, Init_CAN2_OTA_Up_Backcount, Init_CAN2_OTA_Update_Available, Init_CAN2_OTA_Updating_ECU, Init_CAN2_OTA_Updating_ECU_8bit]
    Init_CAN2_BatteryMode: value-spec=0
    Init_CAN2_CCU_ACLampSts: value-spec=0
    Init_CAN2_CCU_ACMaxLampSts: value-spec=0
    Init_CAN2_CCU_AutoLampSts: value-spec=0
    Init_CAN2_CCU_AutoMidLampSts: value-spec=0
    Init_CAN2_CCU_Dispaly_Request: value-spec=0
    Init_CAN2_CCU_EcoSts: value-spec=0
    Init_CAN2_CCU_FrtOnOffLampSts: value-spec=0
    Init_CAN2_CCU_HEATMaxLampSts: value-spec=0
    Init_CAN2_CCU_RrOnOffLampSts: value-spec=0
    Init_CAN2_CCU_SyncLampSts: value-spec=0
    Init_CAN2_CabinMode: value-spec=0
    Init_CAN2_EDriveMode: value-spec=0
    Init_CAN2_FD_AGS_Cmd: value-spec=0
    Init_CAN2_FD_RecyAuto_Cmd: value-spec=0
    Init_CAN2_Fr_Coolantflow: value-spec=0
    Init_CAN2_Fr_Coolanttemp: value-spec=40
    Init_CAN2_HPThermalRecoveryReq: value-spec=0
    Init_CAN2_Rr_Coolantflow: value-spec=0
    Init_CAN2_Rr_Coolanttemp: value-spec=40
    Init_CAN2_sigAirIntenZon1St: value-spec=0
    Init_CAN2_sigAirIntenZon3St: value-spec=0
    Init_CAN2_sigAmbAirT: value-spec=0
    Init_CAN2_sigCbnAirT: value-spec=0
    Init_CAN2_sigCbnPTCPwrAct: value-spec=0
    Init_CAN2_sigCbnSolarLeft: value-spec=253
    Init_CAN2_sigCbnSolarRight: value-spec=253
    Init_CAN2_sigClmtCmprPwrAct: value-spec=0
    Init_CAN2_sigClntTHvBattOut: value-spec=120
    Init_CAN2_sigDfrstSt: value-spec=0
    Init_CAN2_sigHvacSt: value-spec=0
    Init_CAN2_sigRecircSt: value-spec=0
    Init_CAN2_sigSetTempZon{1..3}St: value-spec=0
    Init_CAN2_sigWindDirZon1St: value-spec=0
    Init_CAN2_sigWindDirZon3St: value-spec=0
    Init_CAN2_SG_FD_THCM1: value-spec=fields=[Init_CAN2_BatteryMode, Init_CAN2_CCU_ACLampSts, Init_CAN2_CCU_ACMaxLampSts, Init_CAN2_CCU_AutoLampSts, Init_CAN2_CCU_AutoMidLampSts, Init_CAN2_CCU_Dispaly_Request, Init_CAN2_CCU_EcoSts, Init_CAN2_CCU_FrtOnOffLampSts, Init_CAN2_CCU_HEATMaxLampSts, Init_CAN2_CCU_RrOnOffLampSts, Init_CAN2_CCU_SyncLampSts, Init_CAN2_CabinMode, Init_CAN2_EDriveMode, Init_CAN2_FD_AGS_Cmd, Init_CAN2_FD_RecyAuto_Cmd, Init_CAN2_Fr_Coolantflow, Init_CAN2_Fr_Coolanttemp, Init_CAN2_HPThermalRecoveryReq, Init_CAN2_Rr_Coolantflow, Init_CAN2_Rr_Coolanttemp, Init_CAN2_sigAirIntenZon1St, Init_CAN2_sigAirIntenZon3St, Init_CAN2_sigAmbAirT, Init_CAN2_sigCbnAirT, Init_CAN2_sigCbnPTCPwrAct, Init_CAN2_sigCbnSolarLeft, Init_CAN2_sigCbnSolarRight, Init_CAN2_sigClmtCmprPwrAct, Init_CAN2_sigClntTHvBattOut, Init_CAN2_sigDfrstSt, Init_CAN2_sigHvacSt, Init_CAN2_sigRecircSt, Init_CAN2_sigSetTempZon1St, Init_CAN2_sigSetTempZon2St, Init_CAN2_sigSetTempZon3St, Init_CAN2_sigWindDirZon1St, Init_CAN2_sigWindDirZon3St]
    Init_CAN2_AutoLTips: value-spec=0
    Init_CAN2_CWheelTips: value-spec=0
    Init_CAN2_LFBatWarn: value-spec=0
    Init_CAN2_LFPressIndi: value-spec=0
    Init_CAN2_LFSensorFail: value-spec=0
    Init_CAN2_LFSensorMode: value-spec=0
    Init_CAN2_LFWheelDebug: value-spec=0
    Init_CAN2_LFWheelPSW: value-spec=0
    Init_CAN2_LFWheelPress: value-spec=0
    Init_CAN2_LFWheelTemp: value-spec=0
    Init_CAN2_LFWheelTmpIndi: value-spec=0
    Init_CAN2_LRBatWarn: value-spec=0
    Init_CAN2_LRPressIndi: value-spec=0
    Init_CAN2_LRSensorFail: value-spec=0
    Init_CAN2_LRSensorMode: value-spec=0
    Init_CAN2_LRWheelDebug: value-spec=0
    Init_CAN2_LRWheelPSW: value-spec=0
    Init_CAN2_LRWheelPress: value-spec=0
    Init_CAN2_LRWheelTemp: value-spec=0
    Init_CAN2_LRWheelTmpIndi: value-spec=0
    Init_CAN2_RFBatWarn: value-spec=0
    Init_CAN2_RFPressIndi: value-spec=0
    Init_CAN2_RFSensorFail: value-spec=0
    Init_CAN2_RFSensorMode: value-spec=0
    Init_CAN2_RFWheelDebug: value-spec=0
    Init_CAN2_RFWheelPSW: value-spec=0
    Init_CAN2_RFWheelPress: value-spec=0
    Init_CAN2_RFWheelTemp: value-spec=0
    Init_CAN2_RFWheelTmpIndi: value-spec=0
    Init_CAN2_RRBatWarn: value-spec=0
    Init_CAN2_RRPressIndi: value-spec=0
    Init_CAN2_RRSensorFail: value-spec=0
    Init_CAN2_RRSensorMode: value-spec=0
    Init_CAN2_RRWheelDebug: value-spec=0
    Init_CAN2_RRWheelPSW: value-spec=0
    Init_CAN2_RRWheelPress: value-spec=0
    Init_CAN2_RRWheelTemp: value-spec=0
    Init_CAN2_RRWheelTmpIndi: value-spec=0
    Init_CAN2_TPMSWarnIndi: value-spec=0
    Init_CAN2_TPMS_Cali_Butt_Allow: value-spec=0
    Init_CAN2_TPMS_Res_Butt_Allow: value-spec=0
    Init_CAN2_SG_FD_TPMS1: value-spec=fields=[Init_CAN2_AutoLTips, Init_CAN2_CWheelTips, Init_CAN2_LFBatWarn, Init_CAN2_LFPressIndi, Init_CAN2_LFSensorFail, Init_CAN2_LFSensorMode, Init_CAN2_LFWheelDebug, Init_CAN2_LFWheelPSW, Init_CAN2_LFWheelPress, Init_CAN2_LFWheelTemp, Init_CAN2_LFWheelTmpIndi, Init_CAN2_LRBatWarn, Init_CAN2_LRPressIndi, Init_CAN2_LRSensorFail, Init_CAN2_LRSensorMode, Init_CAN2_LRWheelDebug, Init_CAN2_LRWheelPSW, Init_CAN2_LRWheelPress, Init_CAN2_LRWheelTemp, Init_CAN2_LRWheelTmpIndi, Init_CAN2_RFBatWarn, Init_CAN2_RFPressIndi, Init_CAN2_RFSensorFail, Init_CAN2_RFSensorMode, Init_CAN2_RFWheelDebug, Init_CAN2_RFWheelPSW, Init_CAN2_RFWheelPress, Init_CAN2_RFWheelTemp, Init_CAN2_RFWheelTmpIndi, Init_CAN2_RRBatWarn, Init_CAN2_RRPressIndi, Init_CAN2_RRSensorFail, Init_CAN2_RRSensorMode, Init_CAN2_RRWheelDebug, Init_CAN2_RRWheelPSW, Init_CAN2_RRWheelPress, Init_CAN2_RRWheelTemp, Init_CAN2_RRWheelTmpIndi, Init_CAN2_TPMSWarnIndi, Init_CAN2_TPMS_Cali_Butt_Allow, Init_CAN2_TPMS_Res_Butt_Allow]
    Init_CAN2_ID1_ALTU: value-spec=0
    Init_CAN2_ID1_Loc_ALTU: value-spec=0
    Init_CAN2_ID1_message_ALTU: value-spec=0
    Init_CAN2_ID2_ALTU: value-spec=0
    Init_CAN2_ID2_Loc_ALTU: value-spec=0
    Init_CAN2_ID2_message_ALTU: value-spec=0
    Init_CAN2_ID3_ALTU: value-spec=0
    Init_CAN2_ID3_Loc_ALTU: value-spec=0
    Init_CAN2_ID3_message_ALTU: value-spec=0
    Init_CAN2_ID4_ALTU: value-spec=0
    Init_CAN2_ID4_Loc_ALTU: value-spec=0
    Init_CAN2_ID4_message_ALTU: value-spec=0
    Init_CAN2_IDin_ALTU: value-spec=0
    Init_CAN2_RF_FAT_ALTU: value-spec=0
    Init_CAN2_S{1..4}WheelDebug_ALTU: value-spec=0
    Init_CAN2_SG_FD_TPMS2: value-spec=fields=[Init_CAN2_ID1_ALTU, Init_CAN2_ID1_Loc_ALTU, Init_CAN2_ID1_message_ALTU, Init_CAN2_ID2_ALTU, Init_CAN2_ID2_Loc_ALTU, Init_CAN2_ID2_message_ALTU, Init_CAN2_ID3_ALTU, Init_CAN2_ID3_Loc_ALTU, Init_CAN2_ID3_message_ALTU, Init_CAN2_ID4_ALTU, Init_CAN2_ID4_Loc_ALTU, Init_CAN2_ID4_message_ALTU, Init_CAN2_IDin_ALTU, Init_CAN2_RF_FAT_ALTU, Init_CAN2_S1WheelDebug_ALTU, Init_CAN2_S2WheelDebug_ALTU, Init_CAN2_S3WheelDebug_ALTU, Init_CAN2_S4WheelDebug_ALTU]
    Init_CAN2_Req_OBCV2LEna: value-spec=0
    Init_CAN2_Req_V2LSwOn: value-spec=0
    Init_CAN2_Req_V2L_IVI_Popup: value-spec=0
    Init_CAN2_SG_FD_V2L1: value-spec=fields=[Init_CAN2_Req_OBCV2LEna, Init_CAN2_Req_V2LSwOn, Init_CAN2_Req_V2L_IVI_Popup]
    Init_CAN2_EVCCAplusPwrUpReq: value-spec=0
    Init_CAN2_FDADC12VDetAvg: value-spec=0
    Init_CAN2_Fr_TqSource: value-spec=0
    Init_CAN2_HVRlyOpFail: value-spec=0
    Init_CAN2_HVTHCMSysAvail: value-spec=0
    Init_CAN2_LVBattChrgtimeAct: value-spec=0
    Init_CAN2_LVBattVoltSta: value-spec=0
    Init_CAN2_LVChrgHoldTAct: value-spec=0
    Init_CAN2_LVSilentChrgLv: value-spec=0
    Init_CAN2_LVSilentChrgReq: value-spec=0
    Init_CAN2_LVSilentChrgSta: value-spec=0
    Init_CAN2_MCUActDisFail: value-spec=0
    Init_CAN2_PMMAllowECUSleep: value-spec=0
    Init_CAN2_PowerDownFault: value-spec=0
    Init_CAN2_PowerDownState: value-spec=0
    Init_CAN2_PowerUpFault: value-spec=0
    Init_CAN2_PowerUpState: value-spec=0
    Init_CAN2_PwrDownReq: value-spec=0
    Init_CAN2_PwrStaConstraint: value-spec=0
    Init_CAN2_PwrStaONTOIVIPopReq: value-spec=0
    Init_CAN2_PwrStaONTOIVIPopT: value-spec=0
    Init_CAN2_PwrStaSelect: value-spec=0
    Init_CAN2_PwrStaTOSta: value-spec=0
    Init_CAN2_PwrUpReq: value-spec=0
    Init_CAN2_Rr_TqSource: value-spec=0
    Init_CAN2_SchedChgTOSta: value-spec=0
    Init_CAN2_SilentChkAllowSleep: value-spec=0
    Init_CAN2_SysAllowReadySta: value-spec=0
    Init_CAN2_SysPwrSta: value-spec=0
    Init_CAN2_TCountSta: value-spec=0
    Init_CAN2_TimerAllowSleep: value-spec=0
    Init_CAN2_VCUBrkSWSta: value-spec=0
    Init_CAN2_VCUFLDoorSta: value-spec=0
    Init_CAN2_VCUFRDoorSta: value-spec=0
    Init_CAN2_VCUHoodSWSta: value-spec=0
    Init_CAN2_VCURLDoorSta: value-spec=0
    Init_CAN2_VCURRDoorSta: value-spec=0
    Init_CAN2_VCUTailgateSWSta: value-spec=0
    Init_CAN2_VehHVPwrAvail4THCM: value-spec=0
    Init_CAN2_SG_FD_VCU0: value-spec=fields=[Init_CAN2_EVCCAplusPwrUpReq, Init_CAN2_FDADC12VDetAvg, Init_CAN2_Fr_TqSource, Init_CAN2_HVRlyOpFail, Init_CAN2_HVTHCMSysAvail, Init_CAN2_LVBattChrgtimeAct, Init_CAN2_LVBattVoltSta, Init_CAN2_LVChrgHoldTAct, Init_CAN2_LVSilentChrgLv, Init_CAN2_LVSilentChrgReq, Init_CAN2_LVSilentChrgSta, Init_CAN2_MCUActDisFail, Init_CAN2_PMMAllowECUSleep, Init_CAN2_PowerDownFault, Init_CAN2_PowerDownState, Init_CAN2_PowerUpFault, Init_CAN2_PowerUpState, Init_CAN2_PwrDownReq, Init_CAN2_PwrStaConstraint, Init_CAN2_PwrStaONTOIVIPopReq, Init_CAN2_PwrStaONTOIVIPopT, Init_CAN2_PwrStaSelect, Init_CAN2_PwrStaTOSta, Init_CAN2_PwrUpReq, Init_CAN2_Rr_TqSource, Init_CAN2_SchedChgTOSta, Init_CAN2_SilentChkAllowSleep, Init_CAN2_SysAllowReadySta, Init_CAN2_SysPwrSta, Init_CAN2_TCountSta, Init_CAN2_TimerAllowSleep, Init_CAN2_VCUBrkSWSta, Init_CAN2_VCUFLDoorSta, Init_CAN2_VCUFRDoorSta, Init_CAN2_VCUHoodSWSta, Init_CAN2_VCURLDoorSta, Init_CAN2_VCURRDoorSta, Init_CAN2_VCUTailgateSWSta, Init_CAN2_VehHVPwrAvail4THCM]
    Init_CAN2_ActiveDischReq: value-spec=0
    Init_CAN2_CC_Crl_Sta: value-spec=0
    Init_CAN2_CS_VCU1_CAN2: value-spec=0
    Init_CAN2_CoastDwModeStaChk: value-spec=0
    Init_CAN2_CreepSW_Sta: value-spec=0
    Init_CAN2_DCDCEnaReq: value-spec=0
    Init_CAN2_DCDCVoltSetpoint: value-spec=0
    Init_CAN2_DemoModeStaChk: value-spec=0
    Init_CAN2_DisengageP_Fail: value-spec=0
    Init_CAN2_Dr_SeatSta: value-spec=0
    Init_CAN2_DynoModeStaChk: value-spec=0
    Init_CAN2_EngageP_Fail: value-spec=0
    Init_CAN2_FDC_VCU_PwrSaveReq_Cmd: value-spec=0
    Init_CAN2_FalseNPrevent_Sta: value-spec=0
    Init_CAN2_Fr_ActvDmpDisabReq: value-spec=0
    Init_CAN2_Fr_MCUEnaReq: value-spec=0
    Init_CAN2_HVBatCnctReq: value-spec=0
    Init_CAN2_HVSysReadyToCharge: value-spec=0
    Init_CAN2_LVChrgFuncStaChk: value-spec=0
    Init_CAN2_MSA_Crl_Sta: value-spec=0
    Init_CAN2_PrkReq: value-spec=0
    Init_CAN2_PwrSta: value-spec=0
    Init_CAN2_RC_VCU1_CAN2: value-spec=0
    Init_CAN2_Rr_ActvDmpDisabReq: value-spec=0
    Init_CAN2_Rr_MCUEnaReq: value-spec=0
    Init_CAN2_ShiftGearPosn: value-spec=0
    Init_CAN2_VCU_OPDHold: value-spec=0
    Init_CAN2_XWDMode: value-spec=0
    Init_CAN2_SG_FD_VCU1: value-spec=fields=[Init_CAN2_ActiveDischReq, Init_CAN2_CC_Crl_Sta, Init_CAN2_CS_VCU1_CAN2, Init_CAN2_CoastDwModeStaChk, Init_CAN2_CreepSW_Sta, Init_CAN2_DCDCEnaReq, Init_CAN2_DCDCVoltSetpoint, Init_CAN2_DemoModeStaChk, Init_CAN2_DisengageP_Fail, Init_CAN2_Dr_SeatSta, Init_CAN2_DynoModeStaChk, Init_CAN2_EngageP_Fail, Init_CAN2_FDC_VCU_PwrSaveReq_Cmd, Init_CAN2_FalseNPrevent_Sta, Init_CAN2_Fr_ActvDmpDisabReq, Init_CAN2_Fr_MCUEnaReq, Init_CAN2_HVBatCnctReq, Init_CAN2_HVSysReadyToCharge, Init_CAN2_LVChrgFuncStaChk, Init_CAN2_MSA_Crl_Sta, Init_CAN2_PrkReq, Init_CAN2_PwrSta, Init_CAN2_RC_VCU1_CAN2, Init_CAN2_Rr_ActvDmpDisabReq, Init_CAN2_Rr_MCUEnaReq, Init_CAN2_ShiftGearPosn, Init_CAN2_VCU_OPDHold, Init_CAN2_XWDMode]
    Init_CAN2_ACC_CtrlAvail: value-spec=0
    Init_CAN2_AccPedal_Override: value-spec=0
    Init_CAN2_ActAPSPosn: value-spec=0
    Init_CAN2_CS_VCU2_CAN1: value-spec=0
    Init_CAN2_DriverTq: value-spec=4300
    Init_CAN2_Fr_DriverTq: value-spec=10600
    Init_CAN2_RC_VCU2_CAN1: value-spec=0
    Init_CAN2_Rr_DriverTq: value-spec=10600
    Init_CAN2_VehActPwr: value-spec=600000
    Init_CAN2_SG_FD_VCU2: value-spec=fields=[Init_CAN2_ACC_CtrlAvail, Init_CAN2_AccPedal_Override, Init_CAN2_ActAPSPosn, Init_CAN2_CS_VCU2_CAN1, Init_CAN2_DriverTq, Init_CAN2_Fr_DriverTq, Init_CAN2_RC_VCU2_CAN1, Init_CAN2_Rr_DriverTq, Init_CAN2_VehActPwr]
    Init_CAN2_EVDriveMode: value-spec=0
    Init_CAN2_Eng_AGSCloseSta: value-spec=0
    Init_CAN2_Eng_ActvDmpDisabSta: value-spec=0
    Init_CAN2_Eng_CoastDwSta: value-spec=0
    Init_CAN2_Eng_PwrLockSta: value-spec=0
    Init_CAN2_VCU_ACCErr: value-spec=0
    Init_CAN2_VCU_ISAErr: value-spec=0
    Init_CAN2_VehMalfunLevel: value-spec=0
    Init_CAN2_ZoneDR_SCP_CommErr: value-spec=0
    Init_CAN2_SG_FD_VCU4: value-spec=fields=[Init_CAN2_EVDriveMode, Init_CAN2_Eng_AGSCloseSta, Init_CAN2_Eng_ActvDmpDisabSta, Init_CAN2_Eng_CoastDwSta, Init_CAN2_Eng_PwrLockSta, Init_CAN2_VCU_ACCErr, Init_CAN2_VCU_ISAErr, Init_CAN2_VehMalfunLevel, Init_CAN2_ZoneDR_SCP_CommErr]
    Init_CAN2_EDriveSysErr_AccPedalErr: value-spec=0
    Init_CAN2_EDriveSysErr_MCUErr: value-spec=0
    Init_CAN2_EDriveSysErr_ShifterErr: value-spec=0
    Init_CAN2_EDriveSysErr_VCUErr: value-spec=0
    Init_CAN2_HVSysErr_IsolationErr: value-spec=0
    Init_CAN2_HVSysErr_PackErr: value-spec=0
    Init_CAN2_HVSysErr_RelayErr: value-spec=0
    Init_CAN2_LVSysErr_PwrOutpErr: value-spec=0
    Init_CAN2_LimphomeAct: value-spec=0
    Init_CAN2_LowSOCWarn: value-spec=0
    Init_CAN2_PwrStaErr: value-spec=0
    Init_CAN2_Re_VehThdChkSta: value-spec=0
    Init_CAN2_SG_FD_VCU5: value-spec=fields=[Init_CAN2_EDriveSysErr_AccPedalErr, Init_CAN2_EDriveSysErr_MCUErr, Init_CAN2_EDriveSysErr_ShifterErr, Init_CAN2_EDriveSysErr_VCUErr, Init_CAN2_HVSysErr_IsolationErr, Init_CAN2_HVSysErr_PackErr, Init_CAN2_HVSysErr_RelayErr, Init_CAN2_LVSysErr_PwrOutpErr, Init_CAN2_LimphomeAct, Init_CAN2_LowSOCWarn, Init_CAN2_PwrStaErr, Init_CAN2_Re_VehThdChkSta]
    Init_CAN2_FUSION_HW_Ver{1..3}: value-spec=0
    Init_CAN2_FUSION_SW_CarModel{1..3}: value-spec=0
    Init_CAN2_FUSION_SW_Controller1: value-spec=0
    Init_CAN2_FUSION_SW_Controller2: value-spec=0
    Init_CAN2_FUSION_SW_Country1: value-spec=0
    Init_CAN2_FUSION_SW_Country2: value-spec=0
    Init_CAN2_FUSION_SW_Major1: value-spec=0
    Init_CAN2_FUSION_SW_Major2: value-spec=0
    Init_CAN2_FUSION_SW_Minor1: value-spec=0
    Init_CAN2_FUSION_SW_Minor2: value-spec=0
    Init_CAN2_FUSION_SW_Patch1: value-spec=0
    Init_CAN2_FUSION_SW_Patch2: value-spec=0
    Init_CAN2_FUSION_SW_SHA{1..8}: value-spec=0
    Init_CAN2_FUSION_SW_Var: value-spec=0
    Init_CAN2_FUSION_SW_change1: value-spec=0
    Init_CAN2_FUSION_SW_change2: value-spec=0
    Init_CAN2_FUSION_SW_dash1: value-spec=0
    Init_CAN2_FUSION_SW_dash2: value-spec=0
    Init_CAN2_SG_FD_VCU6: value-spec=fields=[Init_CAN2_FUSION_HW_Ver1, Init_CAN2_FUSION_HW_Ver2, Init_CAN2_FUSION_HW_Ver3, Init_CAN2_FUSION_SW_CarModel1, Init_CAN2_FUSION_SW_CarModel2, Init_CAN2_FUSION_SW_CarModel3, Init_CAN2_FUSION_SW_Controller1, Init_CAN2_FUSION_SW_Controller2, Init_CAN2_FUSION_SW_Country1, Init_CAN2_FUSION_SW_Country2, Init_CAN2_FUSION_SW_Major1, Init_CAN2_FUSION_SW_Major2, Init_CAN2_FUSION_SW_Minor1, Init_CAN2_FUSION_SW_Minor2, Init_CAN2_FUSION_SW_Patch1, Init_CAN2_FUSION_SW_Patch2, Init_CAN2_FUSION_SW_SHA1, Init_CAN2_FUSION_SW_SHA2, Init_CAN2_FUSION_SW_SHA3, Init_CAN2_FUSION_SW_SHA4, Init_CAN2_FUSION_SW_SHA5, Init_CAN2_FUSION_SW_SHA6, Init_CAN2_FUSION_SW_SHA7, Init_CAN2_FUSION_SW_SHA8, Init_CAN2_FUSION_SW_Var, Init_CAN2_FUSION_SW_change1, Init_CAN2_FUSION_SW_change2, Init_CAN2_FUSION_SW_dash1, Init_CAN2_FUSION_SW_dash2]
    Init_CAN2_CCMSA_SpdWar: value-spec=0
    Init_CAN2_SG_FD_VMC1: value-spec=fields=constant-reference=Init_CAN2_CCMSA_SpdWar
    Init_CAN2_AmbLightColorSet: value-spec=0
    Init_CAN2_AmbLightUserSet: value-spec=0
    Init_CAN2_BrkAbn_GoReady_SW: value-spec=0
    Init_CAN2_DRAmbLightBrightnessSet: value-spec=0
    Init_CAN2_FCP_FrEvt_BtnACMaxReq: value-spec=0
    Init_CAN2_FCP_FrEvt_BtnACReq: value-spec=0
    Init_CAN2_FCP_FrEvt_BtnAutoReq: value-spec=0
    Init_CAN2_FCP_FrEvt_BtnSyncReq: value-spec=0
    Init_CAN2_FCP_MidEvt_BtnAutoReq: value-spec=0
    Init_CAN2_IPAmbLightBrightnessSet: value-spec=0
    Init_CAN2_IVI_Lock_SoundSW_Sta: value-spec=0
    Init_CAN2_IVI_OTA_Upd_Sta: value-spec=0
    Init_CAN2_LINKtoDrive: value-spec=0
    Init_CAN2_OTA_CancelDL_Req: value-spec=0
    Init_CAN2_OTA_CompNTFY_Pres: value-spec=0
    Init_CAN2_OTA_DL_Req: value-spec=0
    Init_CAN2_OTA_SuspendDL_Req: value-spec=0
    Init_CAN2_OTA_UpdStart_Req: value-spec=0
    Init_CAN2_OpenDrOpenWdo_SW: value-spec=0
    Init_CAN2_PW_CLOSE_IMD: value-spec=0
    Init_CAN2_PW_CONTINUE_USE: value-spec=0
    Init_CAN2_Sched_OTA_wake: value-spec=0
    Init_CAN2_SmartEco_Mode_SW: value-spec=0
    Init_CAN2_Upd_Countdown_Cancel: value-spec=0
    Init_CAN2_Upd_Countdown_Skip: value-spec=0
    Init_CAN2_VehACModReq: value-spec=0
    Init_CAN2_SG_IVI1: value-spec=fields=[Init_CAN2_AmbLightColorSet, Init_CAN2_AmbLightUserSet, Init_CAN2_BrkAbn_GoReady_SW, Init_CAN2_DRAmbLightBrightnessSet, Init_CAN2_FCP_FrEvt_BtnACMaxReq, Init_CAN2_FCP_FrEvt_BtnACReq, Init_CAN2_FCP_FrEvt_BtnAutoReq, Init_CAN2_FCP_FrEvt_BtnSyncReq, Init_CAN2_FCP_MidEvt_BtnAutoReq, Init_CAN2_IPAmbLightBrightnessSet, Init_CAN2_IVI_Lock_SoundSW_Sta, Init_CAN2_IVI_OTA_Upd_Sta, Init_CAN2_LINKtoDrive, Init_CAN2_OTA_CancelDL_Req, Init_CAN2_OTA_CompNTFY_Pres, Init_CAN2_OTA_DL_Req, Init_CAN2_OTA_SuspendDL_Req, Init_CAN2_OTA_UpdStart_Req, Init_CAN2_OpenDrOpenWdo_SW, Init_CAN2_PW_CLOSE_IMD, Init_CAN2_PW_CONTINUE_USE, Init_CAN2_Sched_OTA_wake, Init_CAN2_SmartEco_Mode_SW, Init_CAN2_Upd_Countdown_Cancel, Init_CAN2_Upd_Countdown_Skip, Init_CAN2_VehACModReq]
    Init_CAN2_AC_Chg_Cur_Set: value-spec=0
    Init_CAN2_AEB_BUTT: value-spec=0
    Init_CAN2_AVM_Err_STA: value-spec=0
    Init_CAN2_AVM_OFF_Rec_Butt: value-spec=0
    Init_CAN2_AVM_Parking_mode: value-spec=0
    Init_CAN2_AVM_parking_cancel: value-spec=0
    Init_CAN2_AVM_parking_excute: value-spec=0
    Init_CAN2_Approach_Unlock_SW: value-spec=1
    Init_CAN2_BSDMute_BUTT: value-spec=0
    Init_CAN2_CAAS_Sw: value-spec=0
    Init_CAN2_CDL_Lock_Butt: value-spec=0
    Init_CAN2_CDL_Unlock_Butt: value-spec=0
    Init_CAN2_CameraWrn: value-spec=0
    Init_CAN2_DSEAT_anti_set: value-spec=0
    Init_CAN2_DSEAT_entryfun_set: value-spec=0
    Init_CAN2_DSEAT_vent_req: value-spec=0
    Init_CAN2_Distance_unit: value-spec=0
    Init_CAN2_ESC_SW_Cmd: value-spec=0
    Init_CAN2_FCWMute_BUTT: value-spec=0
    Init_CAN2_FFogLampSW: value-spec=0
    Init_CAN2_FS_Off_Sw: value-spec=0
    Init_CAN2_FalseNPrevent_SW: value-spec=1
    Init_CAN2_FollowMeSW: value-spec=0
    Init_CAN2_GPS_LAT: value-spec=0
    Init_CAN2_GPS_LONG: value-spec=0
    Init_CAN2_HeadLampSW: value-spec=0
    Init_CAN2_Hood_Latch_SW: value-spec=0
    Init_CAN2_IVI_AGSCloseSW: value-spec=0
    Init_CAN2_IVI_ActvDmpDisabSW: value-spec=0
    Init_CAN2_IVI_CoastDwSW: value-spec=0
    Init_CAN2_IVI_CreepSW_Req: value-spec=0
    Init_CAN2_IVI_ISA_OffsetSpd: value-spec=0
    Init_CAN2_IVI_LVChrgFuncSW: value-spec=0
    Init_CAN2_IVI_Mute_Sta: value-spec=0
    Init_CAN2_IVI_Night_Mode_Sta: value-spec=0
    Init_CAN2_IVI_PTG_Mode_SW: value-spec=0
    Init_CAN2_IVI_PTG_Open_Height: value-spec=0
    Init_CAN2_IVI_PTG_Sta_SW: value-spec=0
    Init_CAN2_IVI_PTG_USSta_SW: value-spec=0
    Init_CAN2_IVI_PW_Mode_Req: value-spec=0
    Init_CAN2_IVI_Panel_Act: value-spec=0
    Init_CAN2_IVI_Panel_X_Coor: value-spec=0
    Init_CAN2_IVI_Panel_Y_Coor: value-spec=0
    Init_CAN2_IVI_PwrLockSW: value-spec=0
    Init_CAN2_IVI_Pwroff_req: value-spec=0
    Init_CAN2_IVI_RR_Def_Req: value-spec=0
    Init_CAN2_IVI_Req_V2L: value-spec=0
    Init_CAN2_IVI_Screen: value-spec=0
    Init_CAN2_IVI_Start_Chg_req: value-spec=0
    Init_CAN2_IVI_Status: value-spec=0
    Init_CAN2_IVI_Stop_Chg_req: value-spec=0
    Init_CAN2_IVI_Trigger_req: value-spec=0
    Init_CAN2_IVI_Unlock_Chg_req: value-spec=0
    Init_CAN2_IVI_WI_MAIN_SW: value-spec=0
    Init_CAN2_LDWMute_BUTT: value-spec=0
    Init_CAN2_LKA_BUTT: value-spec=0
    Init_CAN2_LVDAMute_BUTT: value-spec=0
    Init_CAN2_L_Drv_ControlCommand: value-spec=127
    Init_CAN2_L_Pas_ControlCommand: value-spec=127
    Init_CAN2_L_RLD_ControlCommand: value-spec=127
    Init_CAN2_L_RRD_ControlCommand: value-spec=127
    Init_CAN2_METER_Malfunc_Sta: value-spec=0
    Init_CAN2_MFRD_N_Bright_Req: value-spec=0
    Init_CAN2_NAVI_Cam_Dist_info: value-spec=0
    Init_CAN2_NAVI_Direction_STA: value-spec=0
    Init_CAN2_NAVI_Distance_info: value-spec=0
    Init_CAN2_NAVI_ForwardLinkLevel: value-spec=0
    Init_CAN2_NAVI_LinkClass: value-spec=0
    Init_CAN2_NAVI_RoadClass: value-spec=0
    Init_CAN2_NAVI_SpeedLimit: value-spec=0
    Init_CAN2_NAVI_Speed_Limit_A: value-spec=0
    Init_CAN2_NAVI_State: value-spec=0
    Init_CAN2_NAVI_Tollgate: value-spec=0
    Init_CAN2_NAVI_Tunnel: value-spec=0
    Init_CAN2_ODAMute_BUTT: value-spec=0
    Init_CAN2_OFF_AC_MODE: value-spec=0
    Init_CAN2_PSEAT_vent_req: value-spec=0
    Init_CAN2_Perd_V2L: value-spec=0
    Init_CAN2_Pressure_unit: value-spec=0
    Init_CAN2_RCTA_BUTT: value-spec=0
    Init_CAN2_RFogLampSW: value-spec=0
    Init_CAN2_Roll_Eng_Mode: value-spec=0
    Init_CAN2_Roll_Mode_SW_Cmd: value-spec=0
    Init_CAN2_RoomLampMode: value-spec=0
    Init_CAN2_SLG_Sw: value-spec=0
    Init_CAN2_SLIF_BUTT: value-spec=0
    Init_CAN2_SOC_ADJ_BUTT: value-spec=0
    Init_CAN2_SOC_Limit_Set: value-spec=25
    Init_CAN2_SOC_V2LLimit: value-spec=0
    Init_CAN2_Sched_Chg_Start: value-spec=0
    Init_CAN2_Sched_Chg_Stop: value-spec=0
    Init_CAN2_Sched_Chg_butt: value-spec=0
    Init_CAN2_Sched_Chg_limit: value-spec=25
    Init_CAN2_Sched_Chg_wake: value-spec=0
    Init_CAN2_SenstivityPosition: value-spec=0
    Init_CAN2_SetUnlockSingle: value-spec=0
    Init_CAN2_TCS_SW_Cmd: value-spec=0
    Init_CAN2_TPMS_Cali_Butt: value-spec=0
    Init_CAN2_TPMS_Res_Butt: value-spec=0
    Init_CAN2_Temperature_unit: value-spec=0
    Init_CAN2_Time_system: value-spec=0
    Init_CAN2_TurnSwTimeSet: value-spec=0
    Init_CAN2_User_p_download: value-spec=0
    Init_CAN2_User_p_upload: value-spec=0
    Init_CAN2_Walkaway_Lock_SW: value-spec=1
    Init_CAN2_Wifi_Reset: value-spec=0
    Init_CAN2_Wifi_Sta_IVI_TBOX: value-spec=0
    Init_CAN2_sigAirIntenZon1Req: value-spec=0
    Init_CAN2_sigAirIntenZon3Req: value-spec=0
    Init_CAN2_sigDfrstReq: value-spec=0
    Init_CAN2_sigFaceReq: value-spec=0
    Init_CAN2_sigFootReq: value-spec=0
    Init_CAN2_sigHvacFrontReq: value-spec=0
    Init_CAN2_sigHvacRearReq: value-spec=0
    Init_CAN2_sigHvacReq: value-spec=0
    Init_CAN2_sigRecircReq: value-spec=0
    Init_CAN2_sigSetTempZon{1..3}Req: value-spec=0
    Init_CAN2_sigWindDirZon3Req: value-spec=7
    Init_CAN2_SG_IVI2: value-spec=fields=[Init_CAN2_AC_Chg_Cur_Set, Init_CAN2_AEB_BUTT, Init_CAN2_AVM_Err_STA, Init_CAN2_AVM_OFF_Rec_Butt, Init_CAN2_AVM_Parking_mode, Init_CAN2_AVM_parking_cancel, Init_CAN2_AVM_parking_excute, Init_CAN2_Approach_Unlock_SW, Init_CAN2_BSDMute_BUTT, Init_CAN2_CAAS_Sw, Init_CAN2_CDL_Lock_Butt, Init_CAN2_CDL_Unlock_Butt, Init_CAN2_CameraWrn, Init_CAN2_DSEAT_anti_set, Init_CAN2_DSEAT_entryfun_set, Init_CAN2_DSEAT_vent_req, Init_CAN2_Distance_unit, Init_CAN2_ESC_SW_Cmd, Init_CAN2_FCWMute_BUTT, Init_CAN2_FFogLampSW, Init_CAN2_FS_Off_Sw, Init_CAN2_FalseNPrevent_SW, Init_CAN2_FollowMeSW, Init_CAN2_GPS_LAT, Init_CAN2_GPS_LONG, Init_CAN2_HeadLampSW, Init_CAN2_Hood_Latch_SW, Init_CAN2_IVI_AGSCloseSW, Init_CAN2_IVI_ActvDmpDisabSW, Init_CAN2_IVI_CoastDwSW, Init_CAN2_IVI_CreepSW_Req, Init_CAN2_IVI_ISA_OffsetSpd, Init_CAN2_IVI_LVChrgFuncSW, Init_CAN2_IVI_Mute_Sta, Init_CAN2_IVI_Night_Mode_Sta, Init_CAN2_IVI_PTG_Mode_SW, Init_CAN2_IVI_PTG_Open_Height, Init_CAN2_IVI_PTG_Sta_SW, Init_CAN2_IVI_PTG_USSta_SW, Init_CAN2_IVI_PW_Mode_Req, Init_CAN2_IVI_Panel_Act, Init_CAN2_IVI_Panel_X_Coor, Init_CAN2_IVI_Panel_Y_Coor, Init_CAN2_IVI_PwrLockSW, Init_CAN2_IVI_Pwroff_req, Init_CAN2_IVI_RR_Def_Req, Init_CAN2_IVI_Req_V2L, Init_CAN2_IVI_Screen, Init_CAN2_IVI_Start_Chg_req, Init_CAN2_IVI_Status, Init_CAN2_IVI_Stop_Chg_req, Init_CAN2_IVI_Trigger_req, Init_CAN2_IVI_Unlock_Chg_req, Init_CAN2_IVI_WI_MAIN_SW, Init_CAN2_LDWMute_BUTT, Init_CAN2_LKA_BUTT, Init_CAN2_LVDAMute_BUTT, Init_CAN2_L_Drv_ControlCommand, Init_CAN2_L_Pas_ControlCommand, Init_CAN2_L_RLD_ControlCommand, Init_CAN2_L_RRD_ControlCommand, Init_CAN2_METER_Malfunc_Sta, Init_CAN2_MFRD_N_Bright_Req, Init_CAN2_NAVI_Cam_Dist_info, Init_CAN2_NAVI_Direction_STA, Init_CAN2_NAVI_Distance_info, Init_CAN2_NAVI_ForwardLinkLevel, Init_CAN2_NAVI_LinkClass, Init_CAN2_NAVI_RoadClass, Init_CAN2_NAVI_SpeedLimit, Init_CAN2_NAVI_Speed_Limit_A, Init_CAN2_NAVI_State, Init_CAN2_NAVI_Tollgate, Init_CAN2_NAVI_Tunnel, Init_CAN2_ODAMute_BUTT, Init_CAN2_OFF_AC_MODE, Init_CAN2_PSEAT_vent_req, Init_CAN2_Perd_V2L, Init_CAN2_Pressure_unit, Init_CAN2_RCTA_BUTT, Init_CAN2_RFogLampSW, Init_CAN2_Roll_Eng_Mode, Init_CAN2_Roll_Mode_SW_Cmd, Init_CAN2_RoomLampMode, Init_CAN2_SLG_Sw, Init_CAN2_SLIF_BUTT, Init_CAN2_SOC_ADJ_BUTT, Init_CAN2_SOC_Limit_Set, Init_CAN2_SOC_V2LLimit, Init_CAN2_Sched_Chg_Start, Init_CAN2_Sched_Chg_Stop, Init_CAN2_Sched_Chg_butt, Init_CAN2_Sched_Chg_limit, Init_CAN2_Sched_Chg_wake, Init_CAN2_SenstivityPosition, Init_CAN2_SetUnlockSingle, Init_CAN2_TCS_SW_Cmd, Init_CAN2_TPMS_Cali_Butt, Init_CAN2_TPMS_Res_Butt, Init_CAN2_Temperature_unit, Init_CAN2_Time_system, Init_CAN2_TurnSwTimeSet, Init_CAN2_User_p_download, Init_CAN2_User_p_upload, Init_CAN2_Walkaway_Lock_SW, Init_CAN2_Wifi_Reset, Init_CAN2_Wifi_Sta_IVI_TBOX, Init_CAN2_sigAirIntenZon1Req, Init_CAN2_sigAirIntenZon3Req, Init_CAN2_sigDfrstReq, Init_CAN2_sigFaceReq, Init_CAN2_sigFootReq, Init_CAN2_sigHvacFrontReq, Init_CAN2_sigHvacRearReq, Init_CAN2_sigHvacReq, Init_CAN2_sigRecircReq, Init_CAN2_sigSetTempZon1Req, Init_CAN2_sigSetTempZon2Req, Init_CAN2_sigSetTempZon3Req, Init_CAN2_sigWindDirZon3Req]
    Init_CAN2_IVI_Located_STA: value-spec=0
    Init_CAN2_IVI_Time_Check: value-spec=0
    Init_CAN2_IVI_Time_Day: value-spec=0
    Init_CAN2_IVI_Time_Hour: value-spec=0
    Init_CAN2_IVI_Time_Minute: value-spec=0
    Init_CAN2_IVI_Time_Month: value-spec=0
    Init_CAN2_IVI_Time_Second: value-spec=0
    Init_CAN2_IVI_Time_Year: value-spec=0
    Init_CAN2_SG_IVI6: value-spec=fields=[Init_CAN2_IVI_Located_STA, Init_CAN2_IVI_Time_Check, Init_CAN2_IVI_Time_Day, Init_CAN2_IVI_Time_Hour, Init_CAN2_IVI_Time_Minute, Init_CAN2_IVI_Time_Month, Init_CAN2_IVI_Time_Second, Init_CAN2_IVI_Time_Year]
    Init_CAN2_APCforDTE: value-spec=9999
    Init_CAN2_AVGPwrConsumption: value-spec=9999
    Init_CAN2_AvailableTrip: value-spec=0
    Init_CAN2_Averaged_vehspeed: value-spec=0
    Init_CAN2_Charge: value-spec=0
    Init_CAN2_LEDlitWarnReq: value-spec=0
    Init_CAN2_METER_KPH_Calcu: value-spec=0
    Init_CAN2_METER_KPH_Real: value-spec=0
    Init_CAN2_METER_MPH_Calcu: value-spec=0
    Init_CAN2_METER_MPH_Real: value-spec=0
    Init_CAN2_ODOMETER: value-spec=0
    Init_CAN2_ParkBrake: value-spec=0
    Init_CAN2_Spd_Crl_Mode: value-spec=0
    Init_CAN2_Spd_Crl_Sta: value-spec=0
    Init_CAN2_Trip_A: value-spec=0
    Init_CAN2_Trip_B: value-spec=0
    Init_CAN2_SG_METER1: value-spec=fields=[Init_CAN2_APCforDTE, Init_CAN2_AVGPwrConsumption, Init_CAN2_AvailableTrip, Init_CAN2_Averaged_vehspeed, Init_CAN2_Charge, Init_CAN2_LEDlitWarnReq, Init_CAN2_METER_KPH_Calcu, Init_CAN2_METER_KPH_Real, Init_CAN2_METER_MPH_Calcu, Init_CAN2_METER_MPH_Real, Init_CAN2_ODOMETER, Init_CAN2_ParkBrake, Init_CAN2_Spd_Crl_Mode, Init_CAN2_Spd_Crl_Sta, Init_CAN2_Trip_A, Init_CAN2_Trip_B]
    Init_CAN2_NM_FUSION_Active_WU: value-spec=0
    Init_CAN2_NM_FUSION_CSB: value-spec=0
    Init_CAN2_NM_FUSION_ERROR_State: value-spec=0
    Init_CAN2_NM_FUSION_Node_ID: value-spec=0
    Init_CAN2_NM_FUSION_PNI: value-spec=0
    Init_CAN2_NM_FUSION_Rpt_Msg_Req: value-spec=0
    Init_CAN2_SG_XNMm_FUSION: value-spec=fields=[Init_CAN2_NM_FUSION_Active_WU, Init_CAN2_NM_FUSION_CSB, Init_CAN2_NM_FUSION_ERROR_State, Init_CAN2_NM_FUSION_Node_ID, Init_CAN2_NM_FUSION_PNI, Init_CAN2_NM_FUSION_Rpt_Msg_Req]
    Init_CAN2_NM_HMI_Active_WU: value-spec=0
    Init_CAN2_NM_HMI_CSB: value-spec=0
    Init_CAN2_NM_HMI_ERROR_State: value-spec=0
    Init_CAN2_NM_HMI_Node_ID: value-spec=0
    Init_CAN2_NM_HMI_PNI: value-spec=0
    Init_CAN2_NM_HMI_Rpt_Msg_Req: value-spec=0
    Init_CAN2_SG_XNMm_HMI: value-spec=fields=[Init_CAN2_NM_HMI_Active_WU, Init_CAN2_NM_HMI_CSB, Init_CAN2_NM_HMI_ERROR_State, Init_CAN2_NM_HMI_Node_ID, Init_CAN2_NM_HMI_PNI, Init_CAN2_NM_HMI_Rpt_Msg_Req]
    Init_CAN2_NM_IVI_Active_WU: value-spec=0
    Init_CAN2_NM_IVI_CSB: value-spec=0
    Init_CAN2_NM_IVI_ERROR_State: value-spec=0
    Init_CAN2_NM_IVI_Node_ID: value-spec=0
    Init_CAN2_NM_IVI_PNI: value-spec=0
    Init_CAN2_NM_IVI_Rpt_Msg_Req: value-spec=0
    Init_CAN2_SG_XNMm_IVI: value-spec=fields=[Init_CAN2_NM_IVI_Active_WU, Init_CAN2_NM_IVI_CSB, Init_CAN2_NM_IVI_ERROR_State, Init_CAN2_NM_IVI_Node_ID, Init_CAN2_NM_IVI_PNI, Init_CAN2_NM_IVI_Rpt_Msg_Req]
    Init_CAN2_NM_Telltale_Active_WU: value-spec=0
    Init_CAN2_NM_Telltale_CSB: value-spec=0
    Init_CAN2_NM_Telltale_ERROR_State: value-spec=0
    Init_CAN2_NM_Telltale_Node_ID: value-spec=0
    Init_CAN2_NM_Telltale_PNI: value-spec=0
    Init_CAN2_NM_Telltale_Rpt_Msg_Req: value-spec=0
    Init_CAN2_SG_XNMm_Telltale: value-spec=fields=[Init_CAN2_NM_Telltale_Active_WU, Init_CAN2_NM_Telltale_CSB, Init_CAN2_NM_Telltale_ERROR_State, Init_CAN2_NM_Telltale_Node_ID, Init_CAN2_NM_Telltale_PNI, Init_CAN2_NM_Telltale_Rpt_Msg_Req]
package /CAN2/ImplementationDataTypes
  25 x impl type, all with category=STRUCTURE:
    DT_CAN2_SG_FD_APS1
      4 x element, all with category=TYPE_REFERENCE:
        CAN2_APS_Angle_Target: implementation-data-type=uint16
        CAN2_APS_Rq_EPAS_Ctrl: implementation-data-type=uint8
        CAN2_APS_Sta_System: implementation-data-type=uint8
        CAN2_APS_V_Rq_EPAS_Ctrl: implementation-data-type=uint8
    DT_CAN2_SG_FD_APS2
      44 x element, all with category=TYPE_REFERENCE:
        CAN2_APS_D_FLL: implementation-data-type=uint16
        CAN2_APS_D_FLR: implementation-data-type=uint16
        CAN2_APS_D_RLL: implementation-data-type=uint16
        CAN2_APS_D_RLR: implementation-data-type=uint16
        CAN2_APS_ExitCondition: implementation-data-type=uint8
        CAN2_APS_HW_Ver: implementation-data-type=uint8
        CAN2_APS_Progress_PCT: implementation-data-type=uint8
        CAN2_APS_RQ_Display: implementation-data-type=uint8
        CAN2_APS_SW_Ver: implementation-data-type=uint8
        CAN2_FDC_VCU_RegenLimInd_Sta: implementation-data-type=uint8
        CAN2_FDC_VCU_SmartEcoSpdLim_Sta: implementation-data-type=uint8
        CAN2_FDC_VCU_SmartEco_Sta: implementation-data-type=uint8
        CAN2_PAS_A_FCL: implementation-data-type=uint8
        CAN2_PAS_A_FCR: implementation-data-type=uint8
        CAN2_PAS_A_FML: implementation-data-type=uint8
        CAN2_PAS_A_FMR: implementation-data-type=uint8
        CAN2_PAS_A_RCL: implementation-data-type=uint8
        CAN2_PAS_A_RCR: implementation-data-type=uint8
        CAN2_PAS_A_RML: implementation-data-type=uint8
        CAN2_PAS_A_RMR: implementation-data-type=uint8
        CAN2_PAS_Chime: implementation-data-type=uint8
        CAN2_PAS_D_FCL: implementation-data-type=uint8
        CAN2_PAS_D_FCR: implementation-data-type=uint8
        CAN2_PAS_D_FML: implementation-data-type=uint8
        CAN2_PAS_D_FMR: implementation-data-type=uint8
        CAN2_PAS_D_RCL: implementation-data-type=uint8
        CAN2_PAS_D_RCR: implementation-data-type=uint8
        CAN2_PAS_D_RML: implementation-data-type=uint8
        CAN2_PAS_D_RMR: implementation-data-type=uint8
        CAN2_PAS_Mod_Operation: implementation-data-type=uint8
        CAN2_PAS_SNSR_Layout: implementation-data-type=uint8
        CAN2_PAS_Sta_F_Sys: implementation-data-type=uint8
        CAN2_USS_Sta_FCL: implementation-data-type=uint8
        CAN2_USS_Sta_FCR: implementation-data-type=uint8
        CAN2_USS_Sta_FLL: implementation-data-type=uint8
        CAN2_USS_Sta_FLR: implementation-data-type=uint8
        CAN2_USS_Sta_FML: implementation-data-type=uint8
        CAN2_USS_Sta_FMR: implementation-data-type=uint8
        CAN2_USS_Sta_RCL: implementation-data-type=uint8
        CAN2_USS_Sta_RCR: implementation-data-type=uint8
        CAN2_USS_Sta_RLL: implementation-data-type=uint8
        CAN2_USS_Sta_RLR: implementation-data-type=uint8
        CAN2_USS_Sta_RML: implementation-data-type=uint8
        CAN2_USS_Sta_RMR: implementation-data-type=uint8
    DT_CAN2_SG_FD_APS3
      9 x element, all with category=TYPE_REFERENCE, implementation-data-type=uint8:
        CAN2_APS3_LifeCount
        CAN2_APS3_checksum
        CAN2_APSOpenPTG
        CAN2_APS_DecReq
        CAN2_APS_DecReq_A
        CAN2_APS_Req
        CAN2_CAAS_Sta
        CAN2_SPTGDet
        CAN2_SPTG_Sta
    DT_CAN2_SG_FD_BCM1
      54 x element, all with category=TYPE_REFERENCE, implementation-data-type=uint8:
        CAN2_APMDoorControlSta
        CAN2_AllDoorSW
        CAN2_AntiTheftSeatFold
        CAN2_AntitheftSta
        CAN2_BCM_Buzzer_Req
        CAN2_BCM_DoorLock_Sta
        CAN2_BrakeLamp
        CAN2_CTDCtrl
        CAN2_CTDLockSW
        CAN2_CTDUnlockSW
        CAN2_CrashDetd
        CAN2_Dimmer
        CAN2_DimmerEN
        CAN2_DoorLockIND
        CAN2_DrDoorSW
        CAN2_FDC_BCM_LockAlarm_Cmd
        CAN2_FDC_THCM_APTCWarning_Sta
        CAN2_FollowMe
        CAN2_Fr_ChargingDoorCtrl
        CAN2_Fr_FogLamp
        CAN2_Fr_Wiper_H
        CAN2_Fr_Wiper_L
        CAN2_H_Beam
        CAN2_HazardSW
        CAN2_HoodSW
        CAN2_HornCtrl
        CAN2_LBSD
        CAN2_LDRL
        CAN2_LTurnLP
        CAN2_L_APM_WdwEnable
        CAN2_L_Beam
        CAN2_LockSetting
        CAN2_MirrorCtrl
        CAN2_MirrorDefog
        CAN2_PosLamp
        CAN2_PsDoorSW
        CAN2_RBSD
        CAN2_RDRL
        CAN2_RLDoorSW
        CAN2_RRDoorSW
        CAN2_RTurnLP
        CAN2_ReverseLamp
        CAN2_RoomLampH
        CAN2_RoomLampL
        CAN2_Rr_ChargingDoorCtrl
        CAN2_Rr_Defog
        CAN2_Rr_FogLamp
        CAN2_Rr_Wiper
        CAN2_TailgateHDSW
        CAN2_TailgateRemote
        CAN2_Tailgate_SW
        CAN2_TrunkRel
        CAN2_WasherCtrl
        CAN2_WiperFixMode
    DT_CAN2_SG_FD_BCM2
      28 x element, all with category=TYPE_REFERENCE, implementation-data-type=uint8:
        CAN2_AmbLightBreath{1..3}
        CAN2_AmbLightBrightness{1..3}
        CAN2_AmbLightColor{1..3}
        CAN2_LampPwr
        CAN2_User1AmbLightColor
        CAN2_User1DrAmbLightBrightness
        CAN2_User1IPAmbLightBrightness
        CAN2_User2AmbLightColor
        CAN2_User2DrAmbLightBrightness
        CAN2_User2IPAmbLightBrightness
        CAN2_User3AmbLightColor
        CAN2_User3DrAmbLightBrightness
        CAN2_User3IPAmbLightBrightness
        CAN2_User4AmbLightColor
        CAN2_User4DrAmbLightBrightness
        CAN2_User4IPAmbLightBrightness
        CAN2_User5AmbLightColor
        CAN2_User5DrAmbLightBrightness
        CAN2_User5IPAmbLightBrightness
        CAN2_User6AmbLightColor
        CAN2_User6DrAmbLightBrightness
        CAN2_User6IPAmbLightBrightness
    DT_CAN2_SG_FD_OTA1
      16 x element, all with category=TYPE_REFERENCE:
        CAN2_OTA_DL_Available: implementation-data-type=uint8
        CAN2_OTA_DL_Speed: implementation-data-type=uint32
        CAN2_OTA_Debug_Code: implementation-data-type=uint8
        CAN2_OTA_InVehicle_FW: implementation-data-type=uint8
        CAN2_OTA_Lock_Req: implementation-data-type=uint8
        CAN2_OTA_MDA_Status: implementation-data-type=uint8
        CAN2_OTA_Mode: implementation-data-type=uint8
        CAN2_OTA_Network_Type: implementation-data-type=uint8
        CAN2_OTA_Permit_Agreed: implementation-data-type=uint8
        CAN2_OTA_Progress_Rate: implementation-data-type=uint8
        CAN2_OTA_Remained_Time: implementation-data-type=uint16
        CAN2_OTA_TBOXResetReq: implementation-data-type=uint8
        CAN2_OTA_Up_Backcount: implementation-data-type=uint8
        CAN2_OTA_Update_Available: implementation-data-type=uint8
        CAN2_OTA_Updating_ECU: implementation-data-type=uint8
        CAN2_OTA_Updating_ECU_8bit: implementation-data-type=uint8
    DT_CAN2_SG_FD_THCM1
      37 x element, all with category=TYPE_REFERENCE:
        CAN2_BatteryMode: implementation-data-type=uint8
        CAN2_CCU_ACLampSts: implementation-data-type=uint8
        CAN2_CCU_ACMaxLampSts: implementation-data-type=uint8
        CAN2_CCU_AutoLampSts: implementation-data-type=uint8
        CAN2_CCU_AutoMidLampSts: implementation-data-type=uint8
        CAN2_CCU_Dispaly_Request: implementation-data-type=uint8
        CAN2_CCU_EcoSts: implementation-data-type=uint8
        CAN2_CCU_FrtOnOffLampSts: implementation-data-type=uint8
        CAN2_CCU_HEATMaxLampSts: implementation-data-type=uint8
        CAN2_CCU_RrOnOffLampSts: implementation-data-type=uint8
        CAN2_CCU_SyncLampSts: implementation-data-type=uint8
        CAN2_CabinMode: implementation-data-type=uint8
        CAN2_EDriveMode: implementation-data-type=uint8
        CAN2_FD_AGS_Cmd: implementation-data-type=uint8
        CAN2_FD_RecyAuto_Cmd: implementation-data-type=uint8
        CAN2_Fr_Coolantflow: implementation-data-type=uint8
        CAN2_Fr_Coolanttemp: implementation-data-type=uint16
        CAN2_HPThermalRecoveryReq: implementation-data-type=uint8
        CAN2_Rr_Coolantflow: implementation-data-type=uint8
        CAN2_Rr_Coolanttemp: implementation-data-type=uint16
        CAN2_sigAirIntenZon1St: implementation-data-type=uint8
        CAN2_sigAirIntenZon3St: implementation-data-type=uint8
        CAN2_sigAmbAirT: implementation-data-type=uint8
        CAN2_sigCbnAirT: implementation-data-type=uint8
        CAN2_sigCbnPTCPwrAct: implementation-data-type=uint8
        CAN2_sigCbnSolarLeft: implementation-data-type=uint8
        CAN2_sigCbnSolarRight: implementation-data-type=uint8
        CAN2_sigClmtCmprPwrAct: implementation-data-type=uint8
        CAN2_sigClntTHvBattOut: implementation-data-type=uint8
        CAN2_sigDfrstSt: implementation-data-type=uint8
        CAN2_sigHvacSt: implementation-data-type=uint8
        CAN2_sigRecircSt: implementation-data-type=uint8
        CAN2_sigSetTempZon{1..3}St: implementation-data-type=uint8
        CAN2_sigWindDirZon1St: implementation-data-type=uint8
        CAN2_sigWindDirZon3St: implementation-data-type=uint8
    DT_CAN2_SG_FD_TPMS1
      41 x element, all with category=TYPE_REFERENCE, implementation-data-type=uint8:
        CAN2_AutoLTips
        CAN2_CWheelTips
        CAN2_LFBatWarn
        CAN2_LFPressIndi
        CAN2_LFSensorFail
        CAN2_LFSensorMode
        CAN2_LFWheelDebug
        CAN2_LFWheelPSW
        CAN2_LFWheelPress
        CAN2_LFWheelTemp
        CAN2_LFWheelTmpIndi
        CAN2_LRBatWarn
        CAN2_LRPressIndi
        CAN2_LRSensorFail
        CAN2_LRSensorMode
        CAN2_LRWheelDebug
        CAN2_LRWheelPSW
        CAN2_LRWheelPress
        CAN2_LRWheelTemp
        CAN2_LRWheelTmpIndi
        CAN2_RFBatWarn
        CAN2_RFPressIndi
        CAN2_RFSensorFail
        CAN2_RFSensorMode
        CAN2_RFWheelDebug
        CAN2_RFWheelPSW
        CAN2_RFWheelPress
        CAN2_RFWheelTemp
        CAN2_RFWheelTmpIndi
        CAN2_RRBatWarn
        CAN2_RRPressIndi
        CAN2_RRSensorFail
        CAN2_RRSensorMode
        CAN2_RRWheelDebug
        CAN2_RRWheelPSW
        CAN2_RRWheelPress
        CAN2_RRWheelTemp
        CAN2_RRWheelTmpIndi
        CAN2_TPMSWarnIndi
        CAN2_TPMS_Cali_Butt_Allow
        CAN2_TPMS_Res_Butt_Allow
    DT_CAN2_SG_FD_TPMS2
      18 x element, all with category=TYPE_REFERENCE:
        CAN2_ID1_ALTU: implementation-data-type=uint32
        CAN2_ID1_Loc_ALTU: implementation-data-type=uint8
        CAN2_ID1_message_ALTU: implementation-data-type=uint8
        CAN2_ID2_ALTU: implementation-data-type=uint32
        CAN2_ID2_Loc_ALTU: implementation-data-type=uint8
        CAN2_ID2_message_ALTU: implementation-data-type=uint8
        CAN2_ID3_ALTU: implementation-data-type=uint32
        CAN2_ID3_Loc_ALTU: implementation-data-type=uint8
        CAN2_ID3_message_ALTU: implementation-data-type=uint8
        CAN2_ID4_ALTU: implementation-data-type=uint32
        CAN2_ID4_Loc_ALTU: implementation-data-type=uint8
        CAN2_ID4_message_ALTU: implementation-data-type=uint8
        CAN2_IDin_ALTU: implementation-data-type=uint32
        CAN2_RF_FAT_ALTU: implementation-data-type=uint8
        CAN2_S{1..4}WheelDebug_ALTU: implementation-data-type=uint8
    DT_CAN2_SG_FD_V2L1
      element CAN2_Req_OBCV2LEna: implementation-data-type=uint8
      element CAN2_Req_V2LSwOn: implementation-data-type=uint8
      element CAN2_Req_V2L_IVI_Popup: implementation-data-type=uint8
    DT_CAN2_SG_FD_VCU0
      39 x element, all with category=TYPE_REFERENCE:
        CAN2_EVCCAplusPwrUpReq: implementation-data-type=uint8
        CAN2_FDADC12VDetAvg: implementation-data-type=uint8
        CAN2_Fr_TqSource: implementation-data-type=uint8
        CAN2_HVRlyOpFail: implementation-data-type=uint8
        CAN2_HVTHCMSysAvail: implementation-data-type=uint8
        CAN2_LVBattChrgtimeAct: implementation-data-type=uint16
        CAN2_LVBattVoltSta: implementation-data-type=uint8
        CAN2_LVChrgHoldTAct: implementation-data-type=uint16
        CAN2_LVSilentChrgLv: implementation-data-type=uint8
        CAN2_LVSilentChrgReq: implementation-data-type=uint8
        CAN2_LVSilentChrgSta: implementation-data-type=uint8
        CAN2_MCUActDisFail: implementation-data-type=uint8
        CAN2_PMMAllowECUSleep: implementation-data-type=uint8
        CAN2_PowerDownFault: implementation-data-type=uint8
        CAN2_PowerDownState: implementation-data-type=uint8
        CAN2_PowerUpFault: implementation-data-type=uint8
        CAN2_PowerUpState: implementation-data-type=uint8
        CAN2_PwrDownReq: implementation-data-type=uint8
        CAN2_PwrStaConstraint: implementation-data-type=uint8
        CAN2_PwrStaONTOIVIPopReq: implementation-data-type=uint8
        CAN2_PwrStaONTOIVIPopT: implementation-data-type=uint16
        CAN2_PwrStaSelect: implementation-data-type=uint8
        CAN2_PwrStaTOSta: implementation-data-type=uint8
        CAN2_PwrUpReq: implementation-data-type=uint8
        CAN2_Rr_TqSource: implementation-data-type=uint8
        CAN2_SchedChgTOSta: implementation-data-type=uint8
        CAN2_SilentChkAllowSleep: implementation-data-type=uint8
        CAN2_SysAllowReadySta: implementation-data-type=uint8
        CAN2_SysPwrSta: implementation-data-type=uint8
        CAN2_TCountSta: implementation-data-type=uint8
        CAN2_TimerAllowSleep: implementation-data-type=uint8
        CAN2_VCUBrkSWSta: implementation-data-type=uint8
        CAN2_VCUFLDoorSta: implementation-data-type=uint8
        CAN2_VCUFRDoorSta: implementation-data-type=uint8
        CAN2_VCUHoodSWSta: implementation-data-type=uint8
        CAN2_VCURLDoorSta: implementation-data-type=uint8
        CAN2_VCURRDoorSta: implementation-data-type=uint8
        CAN2_VCUTailgateSWSta: implementation-data-type=uint8
        CAN2_VehHVPwrAvail4THCM: implementation-data-type=uint8
    DT_CAN2_SG_FD_VCU1
      28 x element, all with category=TYPE_REFERENCE, implementation-data-type=uint8:
        CAN2_ActiveDischReq
        CAN2_CC_Crl_Sta
        CAN2_CS_VCU1_CAN2
        CAN2_CoastDwModeStaChk
        CAN2_CreepSW_Sta
        CAN2_DCDCEnaReq
        CAN2_DCDCVoltSetpoint
        CAN2_DemoModeStaChk
        CAN2_DisengageP_Fail
        CAN2_Dr_SeatSta
        CAN2_DynoModeStaChk
        CAN2_EngageP_Fail
        CAN2_FDC_VCU_PwrSaveReq_Cmd
        CAN2_FalseNPrevent_Sta
        CAN2_Fr_ActvDmpDisabReq
        CAN2_Fr_MCUEnaReq
        CAN2_HVBatCnctReq
        CAN2_HVSysReadyToCharge
        CAN2_LVChrgFuncStaChk
        CAN2_MSA_Crl_Sta
        CAN2_PrkReq
        CAN2_PwrSta
        CAN2_RC_VCU1_CAN2
        CAN2_Rr_ActvDmpDisabReq
        CAN2_Rr_MCUEnaReq
        CAN2_ShiftGearPosn
        CAN2_VCU_OPDHold
        CAN2_XWDMode
    DT_CAN2_SG_FD_VCU2
      9 x element, all with category=TYPE_REFERENCE:
        CAN2_ACC_CtrlAvail: implementation-data-type=uint8
        CAN2_AccPedal_Override: implementation-data-type=uint8
        CAN2_ActAPSPosn: implementation-data-type=uint8
        CAN2_CS_VCU2_CAN1: implementation-data-type=uint8
        CAN2_DriverTq: implementation-data-type=uint16
        CAN2_Fr_DriverTq: implementation-data-type=uint16
        CAN2_RC_VCU2_CAN1: implementation-data-type=uint8
        CAN2_Rr_DriverTq: implementation-data-type=uint16
        CAN2_VehActPwr: implementation-data-type=uint32
    DT_CAN2_SG_FD_VCU4
      9 x element, all with category=TYPE_REFERENCE, implementation-data-type=uint8:
        CAN2_EVDriveMode
        CAN2_Eng_AGSCloseSta
        CAN2_Eng_ActvDmpDisabSta
        CAN2_Eng_CoastDwSta
        CAN2_Eng_PwrLockSta
        CAN2_VCU_ACCErr
        CAN2_VCU_ISAErr
        CAN2_VehMalfunLevel
        CAN2_ZoneDR_SCP_CommErr
    DT_CAN2_SG_FD_VCU5
      12 x element, all with category=TYPE_REFERENCE, implementation-data-type=uint8:
        CAN2_EDriveSysErr_AccPedalErr
        CAN2_EDriveSysErr_MCUErr
        CAN2_EDriveSysErr_ShifterErr
        CAN2_EDriveSysErr_VCUErr
        CAN2_HVSysErr_IsolationErr
        CAN2_HVSysErr_PackErr
        CAN2_HVSysErr_RelayErr
        CAN2_LVSysErr_PwrOutpErr
        CAN2_LimphomeAct
        CAN2_LowSOCWarn
        CAN2_PwrStaErr
        CAN2_Re_VehThdChkSta
    DT_CAN2_SG_FD_VCU6
      29 x element, all with category=TYPE_REFERENCE, implementation-data-type=uint8:
        CAN2_FUSION_HW_Ver{1..3}
        CAN2_FUSION_SW_CarModel{1..3}
        CAN2_FUSION_SW_Controller1
        CAN2_FUSION_SW_Controller2
        CAN2_FUSION_SW_Country1
        CAN2_FUSION_SW_Country2
        CAN2_FUSION_SW_Major1
        CAN2_FUSION_SW_Major2
        CAN2_FUSION_SW_Minor1
        CAN2_FUSION_SW_Minor2
        CAN2_FUSION_SW_Patch1
        CAN2_FUSION_SW_Patch2
        CAN2_FUSION_SW_SHA{1..8}
        CAN2_FUSION_SW_Var
        CAN2_FUSION_SW_change1
        CAN2_FUSION_SW_change2
        CAN2_FUSION_SW_dash1
        CAN2_FUSION_SW_dash2
    DT_CAN2_SG_FD_VMC1
      element CAN2_CCMSA_SpdWar: implementation-data-type=uint8
    DT_CAN2_SG_IVI1
      26 x element, all with category=TYPE_REFERENCE, implementation-data-type=uint8:
        CAN2_AmbLightColorSet
        CAN2_AmbLightUserSet
        CAN2_BrkAbn_GoReady_SW
        CAN2_DRAmbLightBrightnessSet
        CAN2_FCP_FrEvt_BtnACMaxReq
        CAN2_FCP_FrEvt_BtnACReq
        CAN2_FCP_FrEvt_BtnAutoReq
        CAN2_FCP_FrEvt_BtnSyncReq
        CAN2_FCP_MidEvt_BtnAutoReq
        CAN2_IPAmbLightBrightnessSet
        CAN2_IVI_Lock_SoundSW_Sta
        CAN2_IVI_OTA_Upd_Sta
        CAN2_LINKtoDrive
        CAN2_OTA_CancelDL_Req
        CAN2_OTA_CompNTFY_Pres
        CAN2_OTA_DL_Req
        CAN2_OTA_SuspendDL_Req
        CAN2_OTA_UpdStart_Req
        CAN2_OpenDrOpenWdo_SW
        CAN2_PW_CLOSE_IMD
        CAN2_PW_CONTINUE_USE
        CAN2_Sched_OTA_wake
        CAN2_SmartEco_Mode_SW
        CAN2_Upd_Countdown_Cancel
        CAN2_Upd_Countdown_Skip
        CAN2_VehACModReq
    DT_CAN2_SG_IVI2
      120 x element, all with category=TYPE_REFERENCE:
        CAN2_AC_Chg_Cur_Set: implementation-data-type=uint8
        CAN2_AEB_BUTT: implementation-data-type=uint8
        CAN2_AVM_Err_STA: implementation-data-type=uint8
        CAN2_AVM_OFF_Rec_Butt: implementation-data-type=uint8
        CAN2_AVM_Parking_mode: implementation-data-type=uint8
        CAN2_AVM_parking_cancel: implementation-data-type=uint8
        CAN2_AVM_parking_excute: implementation-data-type=uint8
        CAN2_Approach_Unlock_SW: implementation-data-type=uint8
        CAN2_BSDMute_BUTT: implementation-data-type=uint8
        CAN2_CAAS_Sw: implementation-data-type=uint8
        CAN2_CDL_Lock_Butt: implementation-data-type=uint8
        CAN2_CDL_Unlock_Butt: implementation-data-type=uint8
        CAN2_CameraWrn: implementation-data-type=uint8
        CAN2_DSEAT_anti_set: implementation-data-type=uint8
        CAN2_DSEAT_entryfun_set: implementation-data-type=uint8
        CAN2_DSEAT_vent_req: implementation-data-type=uint8
        CAN2_Distance_unit: implementation-data-type=uint8
        CAN2_ESC_SW_Cmd: implementation-data-type=uint8
        CAN2_FCWMute_BUTT: implementation-data-type=uint8
        CAN2_FFogLampSW: implementation-data-type=uint8
        CAN2_FS_Off_Sw: implementation-data-type=uint8
        CAN2_FalseNPrevent_SW: implementation-data-type=uint8
        CAN2_FollowMeSW: implementation-data-type=uint8
        CAN2_GPS_LAT: implementation-data-type=uint32
        CAN2_GPS_LONG: implementation-data-type=uint32
        CAN2_HeadLampSW: implementation-data-type=uint8
        CAN2_Hood_Latch_SW: implementation-data-type=uint8
        CAN2_IVI_AGSCloseSW: implementation-data-type=uint8
        CAN2_IVI_ActvDmpDisabSW: implementation-data-type=uint8
        CAN2_IVI_CoastDwSW: implementation-data-type=uint8
        CAN2_IVI_CreepSW_Req: implementation-data-type=uint8
        CAN2_IVI_ISA_OffsetSpd: implementation-data-type=uint8
        CAN2_IVI_LVChrgFuncSW: implementation-data-type=uint8
        CAN2_IVI_Mute_Sta: implementation-data-type=uint8
        CAN2_IVI_Night_Mode_Sta: implementation-data-type=uint8
        CAN2_IVI_PTG_Mode_SW: implementation-data-type=uint8
        CAN2_IVI_PTG_Open_Height: implementation-data-type=uint8
        CAN2_IVI_PTG_Sta_SW: implementation-data-type=uint8
        CAN2_IVI_PTG_USSta_SW: implementation-data-type=uint8
        CAN2_IVI_PW_Mode_Req: implementation-data-type=uint8
        CAN2_IVI_Panel_Act: implementation-data-type=uint8
        CAN2_IVI_Panel_X_Coor: implementation-data-type=uint16
        CAN2_IVI_Panel_Y_Coor: implementation-data-type=uint16
        CAN2_IVI_PwrLockSW: implementation-data-type=uint8
        CAN2_IVI_Pwroff_req: implementation-data-type=uint8
        CAN2_IVI_RR_Def_Req: implementation-data-type=uint8
        CAN2_IVI_Req_V2L: implementation-data-type=uint8
        CAN2_IVI_Screen: implementation-data-type=uint8
        CAN2_IVI_Start_Chg_req: implementation-data-type=uint8
        CAN2_IVI_Status: implementation-data-type=uint8
        CAN2_IVI_Stop_Chg_req: implementation-data-type=uint8
        CAN2_IVI_Trigger_req: implementation-data-type=uint8
        CAN2_IVI_Unlock_Chg_req: implementation-data-type=uint8
        CAN2_IVI_WI_MAIN_SW: implementation-data-type=uint8
        CAN2_LDWMute_BUTT: implementation-data-type=uint8
        CAN2_LKA_BUTT: implementation-data-type=uint8
        CAN2_LVDAMute_BUTT: implementation-data-type=uint8
        CAN2_L_Drv_ControlCommand: implementation-data-type=uint8
        CAN2_L_Pas_ControlCommand: implementation-data-type=uint8
        CAN2_L_RLD_ControlCommand: implementation-data-type=uint8
        CAN2_L_RRD_ControlCommand: implementation-data-type=uint8
        CAN2_METER_Malfunc_Sta: implementation-data-type=uint8
        CAN2_MFRD_N_Bright_Req: implementation-data-type=uint8
        CAN2_NAVI_Cam_Dist_info: implementation-data-type=uint8
        CAN2_NAVI_Direction_STA: implementation-data-type=uint8
        CAN2_NAVI_Distance_info: implementation-data-type=uint32
        CAN2_NAVI_ForwardLinkLevel: implementation-data-type=uint8
        CAN2_NAVI_LinkClass: implementation-data-type=uint8
        CAN2_NAVI_RoadClass: implementation-data-type=uint8
        CAN2_NAVI_SpeedLimit: implementation-data-type=uint8
        CAN2_NAVI_Speed_Limit_A: implementation-data-type=uint8
        CAN2_NAVI_State: implementation-data-type=uint8
        CAN2_NAVI_Tollgate: implementation-data-type=uint16
        CAN2_NAVI_Tunnel: implementation-data-type=uint16
        CAN2_ODAMute_BUTT: implementation-data-type=uint8
        CAN2_OFF_AC_MODE: implementation-data-type=uint8
        CAN2_PSEAT_vent_req: implementation-data-type=uint8
        CAN2_Perd_V2L: implementation-data-type=uint8
        CAN2_Pressure_unit: implementation-data-type=uint8
        CAN2_RCTA_BUTT: implementation-data-type=uint8
        CAN2_RFogLampSW: implementation-data-type=uint8
        CAN2_Roll_Eng_Mode: implementation-data-type=uint8
        CAN2_Roll_Mode_SW_Cmd: implementation-data-type=uint8
        CAN2_RoomLampMode: implementation-data-type=uint8
        CAN2_SLG_Sw: implementation-data-type=uint8
        CAN2_SLIF_BUTT: implementation-data-type=uint8
        CAN2_SOC_ADJ_BUTT: implementation-data-type=uint8
        CAN2_SOC_Limit_Set: implementation-data-type=uint8
        CAN2_SOC_V2LLimit: implementation-data-type=uint8
        CAN2_Sched_Chg_Start: implementation-data-type=uint8
        CAN2_Sched_Chg_Stop: implementation-data-type=uint8
        CAN2_Sched_Chg_butt: implementation-data-type=uint8
        CAN2_Sched_Chg_limit: implementation-data-type=uint8
        CAN2_Sched_Chg_wake: implementation-data-type=uint8
        CAN2_SenstivityPosition: implementation-data-type=uint8
        CAN2_SetUnlockSingle: implementation-data-type=uint8
        CAN2_TCS_SW_Cmd: implementation-data-type=uint8
        CAN2_TPMS_Cali_Butt: implementation-data-type=uint8
        CAN2_TPMS_Res_Butt: implementation-data-type=uint8
        CAN2_Temperature_unit: implementation-data-type=uint8
        CAN2_Time_system: implementation-data-type=uint8
        CAN2_TurnSwTimeSet: implementation-data-type=uint8
        CAN2_User_p_download: implementation-data-type=uint8
        CAN2_User_p_upload: implementation-data-type=uint8
        CAN2_Walkaway_Lock_SW: implementation-data-type=uint8
        CAN2_Wifi_Reset: implementation-data-type=uint8
        CAN2_Wifi_Sta_IVI_TBOX: implementation-data-type=uint8
        CAN2_sigAirIntenZon1Req: implementation-data-type=uint8
        CAN2_sigAirIntenZon3Req: implementation-data-type=uint8
        CAN2_sigDfrstReq: implementation-data-type=uint8
        CAN2_sigFaceReq: implementation-data-type=uint8
        CAN2_sigFootReq: implementation-data-type=uint8
        CAN2_sigHvacFrontReq: implementation-data-type=uint8
        CAN2_sigHvacRearReq: implementation-data-type=uint8
        CAN2_sigHvacReq: implementation-data-type=uint8
        CAN2_sigRecircReq: implementation-data-type=uint8
        CAN2_sigSetTempZon{1..3}Req: implementation-data-type=uint8
        CAN2_sigWindDirZon3Req: implementation-data-type=uint8
    DT_CAN2_SG_IVI6
      8 x element, all with category=TYPE_REFERENCE, implementation-data-type=uint8:
        CAN2_IVI_Located_STA
        CAN2_IVI_Time_Check
        CAN2_IVI_Time_Day
        CAN2_IVI_Time_Hour
        CAN2_IVI_Time_Minute
        CAN2_IVI_Time_Month
        CAN2_IVI_Time_Second
        CAN2_IVI_Time_Year
    DT_CAN2_SG_METER1
      16 x element, all with category=TYPE_REFERENCE:
        CAN2_APCforDTE: implementation-data-type=uint16
        CAN2_AVGPwrConsumption: implementation-data-type=uint16
        CAN2_AvailableTrip: implementation-data-type=uint16
        CAN2_Averaged_vehspeed: implementation-data-type=uint16
        CAN2_Charge: implementation-data-type=uint8
        CAN2_LEDlitWarnReq: implementation-data-type=uint8
        CAN2_METER_KPH_Calcu: implementation-data-type=uint8
        CAN2_METER_KPH_Real: implementation-data-type=uint16
        CAN2_METER_MPH_Calcu: implementation-data-type=uint8
        CAN2_METER_MPH_Real: implementation-data-type=uint16
        CAN2_ODOMETER: implementation-data-type=uint32
        CAN2_ParkBrake: implementation-data-type=uint8
        CAN2_Spd_Crl_Mode: implementation-data-type=uint8
        CAN2_Spd_Crl_Sta: implementation-data-type=uint8
        CAN2_Trip_A: implementation-data-type=uint32
        CAN2_Trip_B: implementation-data-type=uint32
    DT_CAN2_SG_XNMm_FUSION
      6 x element, all with category=TYPE_REFERENCE, implementation-data-type=uint8:
        CAN2_NM_FUSION_Active_WU
        CAN2_NM_FUSION_CSB
        CAN2_NM_FUSION_ERROR_State
        CAN2_NM_FUSION_Node_ID
        CAN2_NM_FUSION_PNI
        CAN2_NM_FUSION_Rpt_Msg_Req
    DT_CAN2_SG_XNMm_HMI
      6 x element, all with category=TYPE_REFERENCE, implementation-data-type=uint8:
        CAN2_NM_HMI_Active_WU
        CAN2_NM_HMI_CSB
        CAN2_NM_HMI_ERROR_State
        CAN2_NM_HMI_Node_ID
        CAN2_NM_HMI_PNI
        CAN2_NM_HMI_Rpt_Msg_Req
    DT_CAN2_SG_XNMm_IVI
      6 x element, all with category=TYPE_REFERENCE, implementation-data-type=uint8:
        CAN2_NM_IVI_Active_WU
        CAN2_NM_IVI_CSB
        CAN2_NM_IVI_ERROR_State
        CAN2_NM_IVI_Node_ID
        CAN2_NM_IVI_PNI
        CAN2_NM_IVI_Rpt_Msg_Req
    DT_CAN2_SG_XNMm_Telltale
      6 x element, all with category=TYPE_REFERENCE, implementation-data-type=uint8:
        CAN2_NM_Telltale_Active_WU
        CAN2_NM_Telltale_CSB
        CAN2_NM_Telltale_ERROR_State
        CAN2_NM_Telltale_Node_ID
        CAN2_NM_Telltale_PNI
        CAN2_NM_Telltale_Rpt_Msg_Req
