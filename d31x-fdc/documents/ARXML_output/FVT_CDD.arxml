AUTOSAR XML (schema 4-3-0)
package /FVT_CDD_Interface_ARPkg
  8 x client server interface:
    IF_E2E_CAN3_VCU1
      operation CSOP_Write_CAN3_VCU1
    IF_E2E_CAN3_VCU1_toNIDEC
      operation CSOP_Write_CAN3_VCU1_toNIDEC
    IF_E2E_CAN4_VCU1
      operation CSOP_Write_CAN4_VCU1
    IF_FDCCDD_Inner
      operation CSOP_FDC_AppCallSleep
    IF_HALINCDD
      47 x operation:
        CSOP_nmGetCan6TxErrorCount
          arg u8_canChannel: type=uint8, direction=IN, server-argument-impl-policy=USE-ARGUMENT-TYPE
          arg u8_pCan6TxErrorCount: type=uint8, direction=OUT, server-argument-impl-policy=USE-ARGUMENT-TYPE
          arg u8_isGetRx: type=uint8, direction=IN, server-argument-impl-policy=USE-ARGUMENT-TYPE
        CSOP_nmGetCan6RxErrorCount
          arg u8_canChannel: type=uint8, direction=IN, server-argument-impl-policy=USE-ARGUMENT-TYPE
          arg u8_pCan6RxErrorCount: type=uint8, direction=OUT, server-argument-impl-policy=USE-ARGUMENT-TYPE
          arg u8_isGetRx: type=uint8, direction=IN, server-argument-impl-policy=USE-ARGUMENT-TYPE
        CSOP_nmGetCan5TxErrorCount
          arg u8_canChannel: type=uint8, direction=IN, server-argument-impl-policy=USE-ARGUMENT-TYPE
          arg u8_pCan5TxErrorCount: type=uint8, direction=OUT, server-argument-impl-policy=USE-ARGUMENT-TYPE
          arg u8_isGetRx: type=uint8, direction=IN, server-argument-impl-policy=USE-ARGUMENT-TYPE
        CSOP_nmGetCan5RxErrorCount
          arg u8_canChannel: type=uint8, direction=IN, server-argument-impl-policy=USE-ARGUMENT-TYPE
          arg u8_pCan5RxErrorCount: type=uint8, direction=OUT, server-argument-impl-policy=USE-ARGUMENT-TYPE
          arg u8_isGetRx: type=uint8, direction=IN, server-argument-impl-policy=USE-ARGUMENT-TYPE
        CSOP_nmGetCan4TxErrorCount
          arg u8_canChannel: type=uint8, direction=IN, server-argument-impl-policy=USE-ARGUMENT-TYPE
          arg u8_pCan4TxErrorCount: type=uint8, direction=OUT, server-argument-impl-policy=USE-ARGUMENT-TYPE
          arg u8_isGetRx: type=uint8, direction=IN, server-argument-impl-policy=USE-ARGUMENT-TYPE
        CSOP_nmGetCan4RxErrorCount
          arg u8_canChannel: type=uint8, direction=IN, server-argument-impl-policy=USE-ARGUMENT-TYPE
          arg u8_pCan4RxErrorCount: type=uint8, direction=OUT, server-argument-impl-policy=USE-ARGUMENT-TYPE
          arg u8_isGetRx: type=uint8, direction=IN, server-argument-impl-policy=USE-ARGUMENT-TYPE
        CSOP_nmGetCan3TxErrorCount
          arg u8_canChannel: type=uint8, direction=IN, server-argument-impl-policy=USE-ARGUMENT-TYPE
          arg u8_pCan3TxErrorCount: type=uint8, direction=OUT, server-argument-impl-policy=USE-ARGUMENT-TYPE
          arg u8_isGetRx: type=uint8, direction=IN, server-argument-impl-policy=USE-ARGUMENT-TYPE
        CSOP_nmGetCan3RxErrorCount
          arg u8_canChannel: type=uint8, direction=IN, server-argument-impl-policy=USE-ARGUMENT-TYPE
          arg u8_pCan3RxErrorCount: type=uint8, direction=OUT, server-argument-impl-policy=USE-ARGUMENT-TYPE
          arg u8_isGetRx: type=uint8, direction=IN, server-argument-impl-policy=USE-ARGUMENT-TYPE
        CSOP_nmGetCan2TxErrorCount
          arg u8_canChannel: type=uint8, direction=IN, server-argument-impl-policy=USE-ARGUMENT-TYPE
          arg u8_pCan2TxErrorCount: type=uint8, direction=OUT, server-argument-impl-policy=USE-ARGUMENT-TYPE
          arg u8_isGetRx: type=uint8, direction=IN, server-argument-impl-policy=USE-ARGUMENT-TYPE
        CSOP_nmGetCan2RxErrorCount
          arg u8_canChannel: type=uint8, direction=IN, server-argument-impl-policy=USE-ARGUMENT-TYPE
          arg u8_pCan2RxErrorCount: type=uint8, direction=OUT, server-argument-impl-policy=USE-ARGUMENT-TYPE
          arg u8_isGetRx: type=uint8, direction=IN, server-argument-impl-policy=USE-ARGUMENT-TYPE
        CSOP_nmGetCan1TxErrorCount
          arg u8_canChannel: type=uint8, direction=IN, server-argument-impl-policy=USE-ARGUMENT-TYPE
          arg u8_pCan1TxErrorCount: type=uint8, direction=OUT, server-argument-impl-policy=USE-ARGUMENT-TYPE
          arg u8_isGetRx: type=uint8, direction=IN, server-argument-impl-policy=USE-ARGUMENT-TYPE
        CSOP_nmGetCan1RxErrorCount
          arg u8_canChannel: type=uint8, direction=IN, server-argument-impl-policy=USE-ARGUMENT-TYPE
          arg u8_pCan1RxErrorCount: type=uint8, direction=OUT, server-argument-impl-policy=USE-ARGUMENT-TYPE
          arg u8_isGetRx: type=uint8, direction=IN, server-argument-impl-policy=USE-ARGUMENT-TYPE
        CSOP_AnyNmID
          arg u8_AnyNMID: type=uint8, direction=OUT, server-argument-impl-policy=USE-ARGUMENT-TYPE
        CSOP_GetAcoreRebootCmd
          arg u8_AcoreRebootCmd: type=uint8, direction=OUT, server-argument-impl-policy=USE-ARGUMENT-TYPE
        CSOP_ReadPedalZeroPosReq
          arg u8_ReadPedalZeroPosReq: type=uint8, direction=OUT, server-argument-impl-policy=USE-ARGUMENT-TYPE
        CSOP_ResetPedalZeroPosReq
          arg u8_ResetPedalZeroPosReq: type=uint8, direction=OUT, server-argument-impl-policy=USE-ARGUMENT-TYPE
        CSOP_ResetPedalZeroPosDone
        CSOP_TPMSSensorIDRegGetSta
          arg u8_TPMSSensorIDRegSta: type=uint8, direction=OUT, server-argument-impl-policy=USE-ARGUMENT-TYPE
        CSOP_TPMSSensorIDRegSetResults
          arg u8Array2_TPMSSensorIDRegResults: type=u8Array2_TPMSSensorIDRegResults_type, direction=IN, server-argument-impl-policy=USE-ARGUMENT-TYPE
        CSOP_CAN1BusOff
          arg u8_CAN1BusOff: type=uint8, direction=OUT, server-argument-impl-policy=USE-ARGUMENT-TYPE
        CSOP_CAN2BusOff
          arg u8_CAN2BusOff: type=uint8, direction=OUT, server-argument-impl-policy=USE-ARGUMENT-TYPE
        CSOP_CAN3BusOff
          arg u8_CAN3BusOff: type=uint8, direction=OUT, server-argument-impl-policy=USE-ARGUMENT-TYPE
        CSOP_CAN4BusOff
          arg u8_CAN4BusOff: type=uint8, direction=OUT, server-argument-impl-policy=USE-ARGUMENT-TYPE
        CSOP_CAN5BusOff
          arg u8_CAN5BusOff: type=uint8, direction=OUT, server-argument-impl-policy=USE-ARGUMENT-TYPE
        CSOP_CAN6BusOff
          arg u8_CAN6BusOff: type=uint8, direction=OUT, server-argument-impl-policy=USE-ARGUMENT-TYPE
        CSOP_DIDgetDKCdata
          4 x arg, all with server-argument-impl-policy=USE-ARGUMENT-TYPE:
            u8_DidStaDKC: type=uint8, direction=OUT
            u8Array8_DidDataDKC: type=u8_DKCRandomYArray8_type, direction=OUT
            u16_lengthDIDDKC: type=uint16, direction=IN
            u16_DIDDKC: type=uint16, direction=IN
        CSOP_DIDgetXWDdata
          4 x arg, all with server-argument-impl-policy=USE-ARGUMENT-TYPE:
            u8_DidStaXWD: type=uint8, direction=OUT
            u8_DidDataXWD: type=uint8, direction=OUT
            u16_lengthDIDXWD: type=uint16, direction=IN
            u16_DIDXWD: type=uint16, direction=IN
        CSOP_DKCDecrypt
          arg u8Array16_AESkey: type=u8_DKCArray16_type, direction=IN, server-argument-impl-policy=USE-ARGUMENT-TYPE
          arg u8Array16_RawData: type=u8_DKCArray16_type, direction=IN, server-argument-impl-policy=USE-ARGUMENT-TYPE
          arg u8Array16_ResultData: type=u8_DKCArray16_type, direction=OUT, server-argument-impl-policy=USE-ARGUMENT-TYPE
        CSOP_GetAcoreReadyToSleep
          arg s8_AcoreReadyToSleep: type=sint8, direction=OUT, server-argument-impl-policy=USE-ARGUMENT-TYPE
        CSOP_GetAuxBattVoltage
          arg u16_AuxBattVol100mV: type=uint16, direction=OUT, server-argument-impl-policy=USE-ARGUMENT-TYPE
        CSOP_GetBootReason
          arg u8_BootReason: type=uint8, direction=OUT, server-argument-impl-policy=USE-ARGUMENT-TYPE
        CSOP_GetBootPath
          arg u32_BootPath: type=uint32, direction=OUT, server-argument-impl-policy=USE-ARGUMENT-TYPE
        CSOP_GetEvccAplusPwrUpReq
          arg u8_EvccAplusPwrUpReq: type=uint8, direction=OUT, server-argument-impl-policy=USE-ARGUMENT-TYPE
        CSOP_GetNmState
          arg u8_CurrentNMState: type=uint8, direction=OUT, server-argument-impl-policy=USE-ARGUMENT-TYPE
        CSOP_GetNvmProtectState
          arg u8_NvmProtectSta: type=uint8, direction=OUT, server-argument-impl-policy=USE-ARGUMENT-TYPE
        CSOP_GetSWID
          arg u8Array33_SWID: type=u8_SWIDArray33_type, direction=OUT, server-argument-impl-policy=USE-ARGUMENT-TYPE
        CSOP_GetVinCode
          arg u8Array17_VinCode: type=u8Array17_VinCode_type, direction=OUT, server-argument-impl-policy=USE-ARGUMENT-TYPE
        CSOP_GetVinpAllowMoveThdOta
          arg u8_AllowMovThdOTA: type=uint8, direction=OUT, server-argument-impl-policy=USE-ARGUMENT-TYPE
        CSOP_GetVinpPwrReqOta
          arg u8_PwrReqOTA: type=uint8, direction=OUT, server-argument-impl-policy=USE-ARGUMENT-TYPE
        CSOP_GetWISR
          arg u32_WISR: type=uint32, direction=OUT, server-argument-impl-policy=USE-ARGUMENT-TYPE
        CSOP_HALINCDD_DIRECT
          6 x arg, all with direction=OUT, server-argument-impl-policy=USE-ARGUMENT-TYPE:
            u8_BrakeSW: type=uint8
            u8_BrakeLamp: type=uint8
            u16_Pedal1Vol: type=uint16
            u16_Pedal2Vol: type=uint16
            u16_Pedal1Ref5V: type=uint16
            u16_Pedal2Ref5V: type=uint16
        CSOP_HALINCDD_IOEXPANDER
          11 x arg, all with type=uint8, direction=OUT, server-argument-impl-policy=USE-ARGUMENT-TYPE:
            u8_HoodSW
            u8_TailgateSW
            u8_DrDoorSW
            u8_PsDoorSW
            u8_RRDoorSW
            u8_RLDoorSW
            u8_CTDSW
            u8_HazardSW
            u8_TrunkHanSW
            u8_SeatSW
            u8_CrashSignal
        CSOP_IPCF_Handler
        CSOP_PAS_Handler
        CSOP_TPMS_GetRawData
          arg u8_TPMSDataInSta: type=boolean, direction=OUT, server-argument-impl-policy=USE-ARGUMENT-TYPE
          arg u8Array9_TPMSData: type=u8_TPMSDataArray9_type, direction=OUT, server-argument-impl-policy=USE-ARGUMENT-TYPE
        CSOP_UDS_Main
        u8Array4_HWID
          arg u8Array4_HWID: type=u8_HWIDArray4_type, direction=OUT, server-argument-impl-policy=USE-ARGUMENT-TYPE
    IF_HALOUTCDD
      5 x operation:
        CSOP_AppNmStateReq
          arg u8_WakeUpReq: type=uint8, direction=IN, server-argument-impl-policy=USE-ARGUMENT-TYPE
          arg u8_SleepReq: type=uint8, direction=IN, server-argument-impl-policy=USE-ARGUMENT-TYPE
        CSOP_IVIReset
          arg u8_RstValue: type=uint8, direction=IN, server-argument-impl-policy=USE-ARGUMENT-TYPE
        CSOP_SetSysPwrStat
          arg u8_SysPwrStat: type=uint8, direction=IN, server-argument-impl-policy=USE-ARGUMENT-TYPE
        CSOP_SleepRequest
          arg u32_SleepyState: type=uint32, direction=IN, server-argument-impl-policy=USE-ARGUMENT-TYPE
          arg u32_Wakeup_Timer_s: type=uint32, direction=IN, server-argument-impl-policy=USE-ARGUMENT-TYPE
        CSOP_SetAcoreRebootCmdACK
    IF_VESCDD
      operation CSOP_FrameRawData
        6 x arg, all with direction=OUT, server-argument-impl-policy=USE-ARGUMENT-TYPE:
          channel: type=uint8
          fd: type=uint8
          ext: type=uint8
          id: type=uint32
          dlc: type=uint8
          FrameRawData: type=u8_IpcfDataArray64_type
    IF_WDGCDD
      operation CSOP_Call_WDG_AppEnd
      operation CSOP_Call_WDG_AppStart
      operation CSOP_Call_Watchdog
  impl type u8_DKCRandomYArray8_type: category=ARRAY
    element u8_DKCRandomY_Data: category=VALUE, array-size=8, array-size-semantics=FIXED-SIZE, base-type=uint8
package /Impl_Types_ARPkg
  7 x impl type, all with category=ARRAY:
    u8Array17_VinCode_type
      element u8_Element: category=VALUE, array-size=17, array-size-semantics=FIXED-SIZE, base-type=uint8
    u8Array2_TPMSSensorIDRegResults_type
      element u8_Element: category=VALUE, array-size=2, array-size-semantics=FIXED-SIZE, base-type=uint8
    u8_DKCArray16_type
      element u8_DKC_Data: category=VALUE, array-size=16, array-size-semantics=FIXED-SIZE, base-type=uint8
    u8_HWIDArray4_type
      element u8_HWID_Data: category=VALUE, array-size=4, array-size-semantics=FIXED-SIZE, base-type=uint8
    u8_IpcfDataArray64_type
      element u8_IpcfDataElement: category=VALUE, array-size=64, array-size-semantics=FIXED-SIZE, base-type=uint8
    u8_SWIDArray33_type
      element u8_SWID_Data: category=VALUE, array-size=33, array-size-semantics=FIXED-SIZE, base-type=uint8
    u8_TPMSDataArray9_type
      element u8TPMSDataElement: category=VALUE, array-size=9, array-size-semantics=FIXED-SIZE, base-type=uint8
