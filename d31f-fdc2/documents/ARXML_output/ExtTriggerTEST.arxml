AUTOSAR XML (schema 4-3-0)
package /ExtTrigger_ARPkg
  trigger interface IF_ExtTrig_FwUpdate
    trigger Trig_FwUpdateEvent
  trigger interface IF_ExtTrig_IpcfDataReceive
    trigger Trig_IpcfDataReceiveEvent
  trigger interface IF_TestTrigger
    trigger TestTrigSource: sw-impl-policy=QUEUED
