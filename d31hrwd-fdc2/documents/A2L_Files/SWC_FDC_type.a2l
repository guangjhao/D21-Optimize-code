ASAP2_VERSION 1 31
/begin PROJECT ProjectName "Project Comment Goes Here"
/begin HEADER "Header Comments go here" /end HEADER
/begin MODULE ModuleName "Module Comment Goes Here"
/begin MOD_COMMON "Mod Common Comment Here" BYTE_ORDER MSB_LAST /end MOD_COMMON
/begin RECORD_LAYOUT Scalar_BOOLEAN FNC_VALUES 1 UBYTE COLUMN_DIR DIRECT /end RECORD_LAYOUT
/begin RECORD_LAYOUT Scalar_UBYTE FNC_VALUES 1 UBYTE COLUMN_DIR DIRECT /end RECORD_LAYOUT
/begin RECORD_LAYOUT Scalar_UWORD FNC_VALUES 1 UWORD COLUMN_DIR DIRECT /end RECORD_LAYOUT
/begin RECORD_LAYOUT Scalar_SWORD FNC_VALUES 1 SWORD COLUMN_DIR DIRECT /end RECORD_LAYOUT
/begin RECORD_LAYOUT Scalar_FLOAT32_IEEE FNC_VALUES 1 FLOAT32_IEEE COLUMN_DIR DIRECT /end RECORD_LAYOUT
/begin RECORD_LAYOUT Lookup1D_UBYTE FNC_VALUES 1 UBYTE COLUMN_DIR DIRECT /end RECORD_LAYOUT
/begin RECORD_LAYOUT Lookup1D_X_UBYTE AXIS_PTS_X 1 UBYTE INDEX_INCR DIRECT /end RECORD_LAYOUT
/begin RECORD_LAYOUT Lookup1D_X_WORD AXIS_PTS_X 1 SWORD INDEX_INCR DIRECT /end RECORD_LAYOUT
/begin RECORD_LAYOUT Lookup1D_ULONG FNC_VALUES 1 ULONG COLUMN_DIR DIRECT /end RECORD_LAYOUT
/begin RECORD_LAYOUT Lookup1D_X_ULONG AXIS_PTS_X 1 ULONG INDEX_INCR DIRECT /end RECORD_LAYOUT
/begin RECORD_LAYOUT Lookup1D_SLONG FNC_VALUES 1 SLONG COLUMN_DIR DIRECT /end RECORD_LAYOUT
/begin RECORD_LAYOUT Lookup1D_X_LONG AXIS_PTS_X 1 SLONG INDEX_INCR DIRECT /end RECORD_LAYOUT
/begin RECORD_LAYOUT Lookup1D_FLOAT32_IEEE FNC_VALUES 1 FLOAT32_IEEE COLUMN_DIR DIRECT /end RECORD_LAYOUT
/begin RECORD_LAYOUT Lookup1D_X_FLOAT32_IEEE AXIS_PTS_X 1 FLOAT32_IEEE INDEX_INCR DIRECT /end RECORD_LAYOUT
/begin RECORD_LAYOUT Lookup2D_FLOAT32_IEEE FNC_VALUES 1 FLOAT32_IEEE COLUMN_DIR DIRECT /end RECORD_LAYOUT
/begin RECORD_LAYOUT Lookup2D_X_FLOAT32_IEEE AXIS_PTS_X 1 FLOAT32_IEEE INDEX_INCR DIRECT /end RECORD_LAYOUT
/begin CHARACTERISTIC MVMC_OPDDisSlideRate_Y_pct "" CURVE 0x0000 /* @ECU_Address@MVMC_OPDDisSlideRate_Y_pct@ */ Lookup1D_FLOAT32_IEEE 0 SWC_FDC_type_CM_single_pct -10.0 125.0
 /begin AXIS_DESCR COM_AXIS VVMC_EstSlope_Deg SWC_FDC_type_CM_single_Deg 8 -180.0 18.0 AXIS_PTS_REF AVMC_OPDDisSlideRate_X_Deg /end AXIS_DESCR
/end CHARACTERISTIC
/begin AXIS_PTS AVMC_OPDDisSlideRate_X_Deg "" 0x0000 /* @ECU_Address@AVMC_OPDDisSlideRate_X_Deg@ */ VVMC_EstSlope_Deg Lookup1D_X_FLOAT32_IEEE 0 SWC_FDC_type_CM_single_Deg 8 -180.0 18.0 /end AXIS_PTS
/begin CHARACTERISTIC MVMC_AggressJerkPCT4AT_Y_pct "" CURVE 0x0000 /* @ECU_Address@MVMC_AggressJerkPCT4AT_Y_pct@ */ Lookup1D_FLOAT32_IEEE 0 SWC_FDC_type_CM_single_pct 0.0 100.0
 /begin AXIS_DESCR COM_AXIS VVMC_MeterIndSpeedForCalcu_kph SWC_FDC_type_CM_single_kph 17 0.0 255.0 AXIS_PTS_REF AVMC_AggressJerkPCT4AT_X_kph /end AXIS_DESCR
/end CHARACTERISTIC
/begin AXIS_PTS AVMC_AggressJerkPCT4AT_X_kph "" 0x0000 /* @ECU_Address@AVMC_AggressJerkPCT4AT_X_kph@ */ VVMC_MeterIndSpeedForCalcu_kph Lookup1D_X_FLOAT32_IEEE 0 SWC_FDC_type_CM_single_kph 17 0.0 255.0 /end AXIS_PTS
/begin CHARACTERISTIC MVMC_AggressJerkPCT_Y_pct "" CURVE 0x0000 /* @ECU_Address@MVMC_AggressJerkPCT_Y_pct@ */ Lookup1D_FLOAT32_IEEE 0 SWC_FDC_type_CM_single_pct 0.0 100.0
 /begin AXIS_DESCR COM_AXIS VVMC_MeterIndSpeedForCalcu_kph SWC_FDC_type_CM_single_kph 17 0.0 255.0 AXIS_PTS_REF AVMC_AggressJerkPCT_X_kph /end AXIS_DESCR
/end CHARACTERISTIC
/begin AXIS_PTS AVMC_AggressJerkPCT_X_kph "" 0x0000 /* @ECU_Address@AVMC_AggressJerkPCT_X_kph@ */ VVMC_MeterIndSpeedForCalcu_kph Lookup1D_X_FLOAT32_IEEE 0 SWC_FDC_type_CM_single_kph 17 0.0 255.0 /end AXIS_PTS
/begin CHARACTERISTIC MVMC_AggressLimitPCT4AT_Y_pct "" CURVE 0x0000 /* @ECU_Address@MVMC_AggressLimitPCT4AT_Y_pct@ */ Lookup1D_FLOAT32_IEEE 0 SWC_FDC_type_CM_single_pct 0.0 100.0
 /begin AXIS_DESCR COM_AXIS NO_INPUT_QUANTITY SWC_FDC_type_CM_single_kph 17 0.0 255.0 AXIS_PTS_REF AVMC_AggressLimitPCT4AT_X_kph /end AXIS_DESCR
/end CHARACTERISTIC
/begin AXIS_PTS AVMC_AggressLimitPCT4AT_X_kph "" 0x0000 /* @ECU_Address@AVMC_AggressLimitPCT4AT_X_kph@ */ NO_INPUT_QUANTITY Lookup1D_X_FLOAT32_IEEE 0 SWC_FDC_type_CM_single_kph 17 0.0 255.0 /end AXIS_PTS
/begin CHARACTERISTIC MVMC_AggressLimitPCT_Y_pct "" CURVE 0x0000 /* @ECU_Address@MVMC_AggressLimitPCT_Y_pct@ */ Lookup1D_FLOAT32_IEEE 0 SWC_FDC_type_CM_single_pct 0.0 100.0
 /begin AXIS_DESCR COM_AXIS NO_INPUT_QUANTITY SWC_FDC_type_CM_single_kph 17 0.0 255.0 AXIS_PTS_REF AVMC_AggressLimitPCT_X_kph /end AXIS_DESCR
/end CHARACTERISTIC
/begin AXIS_PTS AVMC_AggressLimitPCT_X_kph "" 0x0000 /* @ECU_Address@AVMC_AggressLimitPCT_X_kph@ */ NO_INPUT_QUANTITY Lookup1D_X_FLOAT32_IEEE 0 SWC_FDC_type_CM_single_kph 17 0.0 255.0 /end AXIS_PTS
/begin CHARACTERISTIC MVMC_SoftJerkPCT_Y_pct "" CURVE 0x0000 /* @ECU_Address@MVMC_SoftJerkPCT_Y_pct@ */ Lookup1D_FLOAT32_IEEE 0 SWC_FDC_type_CM_single_pct 0.0 100.0
 /begin AXIS_DESCR COM_AXIS VVMC_MeterIndSpeedForCalcu_kph SWC_FDC_type_CM_single_kph 17 0.0 255.0 AXIS_PTS_REF AVMC_SoftJerkPCT_X_kph /end AXIS_DESCR
/end CHARACTERISTIC
/begin AXIS_PTS AVMC_SoftJerkPCT_X_kph "" 0x0000 /* @ECU_Address@AVMC_SoftJerkPCT_X_kph@ */ VVMC_MeterIndSpeedForCalcu_kph Lookup1D_X_FLOAT32_IEEE 0 SWC_FDC_type_CM_single_kph 17 0.0 255.0 /end AXIS_PTS
/begin CHARACTERISTIC MVMC_SoftLimitPCT_Y_pct "" CURVE 0x0000 /* @ECU_Address@MVMC_SoftLimitPCT_Y_pct@ */ Lookup1D_FLOAT32_IEEE 0 SWC_FDC_type_CM_single_pct 0.0 100.0
 /begin AXIS_DESCR COM_AXIS NO_INPUT_QUANTITY SWC_FDC_type_CM_single_kph 17 0.0 255.0 AXIS_PTS_REF AVMC_SoftLimitPCT_X_kph /end AXIS_DESCR
/end CHARACTERISTIC
/begin AXIS_PTS AVMC_SoftLimitPCT_X_kph "" 0x0000 /* @ECU_Address@AVMC_SoftLimitPCT_X_kph@ */ NO_INPUT_QUANTITY Lookup1D_X_FLOAT32_IEEE 0 SWC_FDC_type_CM_single_kph 17 0.0 255.0 /end AXIS_PTS
/begin CHARACTERISTIC MTHC_Qeq_Y_K "" CURVE 0x0000 /* @ECU_Address@MTHC_Qeq_Y_K@ */ Lookup1D_FLOAT32_IEEE 0 SWC_FDC_type_CM_single_K 0.0 500.0
 /begin AXIS_DESCR COM_AXIS NO_INPUT_QUANTITY SWC_FDC_type_CM_single_kmh 6 0.0 200.0 AXIS_PTS_REF ATHC_Qeq_X_kmh /end AXIS_DESCR
/end CHARACTERISTIC
/begin AXIS_PTS ATHC_Qeq_X_kmh "" 0x0000 /* @ECU_Address@ATHC_Qeq_X_kmh@ */ NO_INPUT_QUANTITY Lookup1D_X_FLOAT32_IEEE 0 SWC_FDC_type_CM_single_kmh 6 0.0 200.0 /end AXIS_PTS
/begin CHARACTERISTIC MTHC_VbaseH_Y_K "" CURVE 0x0000 /* @ECU_Address@MTHC_VbaseH_Y_K@ */ Lookup1D_FLOAT32_IEEE 0 SWC_FDC_type_CM_single_K 0.0 1.0
 /begin AXIS_DESCR COM_AXIS NO_INPUT_QUANTITY SWC_FDC_type_CM_single_C 8 -40.0 85.0 AXIS_PTS_REF ATHC_VbaseH_X_C /end AXIS_DESCR
/end CHARACTERISTIC
/begin AXIS_PTS ATHC_VbaseH_X_C "" 0x0000 /* @ECU_Address@ATHC_VbaseH_X_C@ */ NO_INPUT_QUANTITY Lookup1D_X_FLOAT32_IEEE 0 SWC_FDC_type_CM_single_C 8 -40.0 85.0 /end AXIS_PTS
/begin CHARACTERISTIC MTHC_VbaseD_Y_K "" CURVE 0x0000 /* @ECU_Address@MTHC_VbaseD_Y_K@ */ Lookup1D_FLOAT32_IEEE 0 SWC_FDC_type_CM_single_K 0.0 1.0
 /begin AXIS_DESCR COM_AXIS NO_INPUT_QUANTITY SWC_FDC_type_CM_single_C 8 -40.0 85.0 AXIS_PTS_REF ATHC_VbaseD_X_C /end AXIS_DESCR
/end CHARACTERISTIC
/begin AXIS_PTS ATHC_VbaseD_X_C "" 0x0000 /* @ECU_Address@ATHC_VbaseD_X_C@ */ NO_INPUT_QUANTITY Lookup1D_X_FLOAT32_IEEE 0 SWC_FDC_type_CM_single_C 8 -40.0 85.0 /end AXIS_PTS
/begin CHARACTERISTIC MTHC_VbaseC_Z_K "" MAP 0x0000 /* @ECU_Address@MTHC_VbaseC_Z_K@ */ Lookup2D_FLOAT32_IEEE 0 SWC_FDC_type_CM_single_K 0.0 1.0
 /begin AXIS_DESCR COM_AXIS NO_INPUT_QUANTITY SWC_FDC_type_CM_single_C 8 -40.0 85.0 AXIS_PTS_REF ATHC_VbaseC_X_C /end AXIS_DESCR
 /begin AXIS_DESCR COM_AXIS NO_INPUT_QUANTITY SWC_FDC_type_CM_single_W 8 0.0 10000.0 AXIS_PTS_REF ATHC_VbaseC_Y_W /end AXIS_DESCR
/end CHARACTERISTIC
/begin AXIS_PTS ATHC_VbaseC_Y_W "" 0x0000 /* @ECU_Address@ATHC_VbaseC_Y_W@ */ NO_INPUT_QUANTITY Lookup2D_X_FLOAT32_IEEE 0 SWC_FDC_type_CM_single_W 8 0.0 10000.0 /end AXIS_PTS
/begin AXIS_PTS ATHC_VbaseC_X_C "" 0x0000 /* @ECU_Address@ATHC_VbaseC_X_C@ */ NO_INPUT_QUANTITY Lookup2D_X_FLOAT32_IEEE 0 SWC_FDC_type_CM_single_C 8 -40.0 85.0 /end AXIS_PTS
/begin CHARACTERISTIC MTQD_EstInitVehWeight_Y_kg "" CURVE 0x0000 /* @ECU_Address@MTQD_EstInitVehWeight_Y_kg@ */ Lookup1D_FLOAT32_IEEE 0 SWC_FDC_type_CM_single_kg 0.0 5000.0
 /begin AXIS_DESCR COM_AXIS NO_INPUT_QUANTITY SWC_FDC_type_CM_single_c 10 0.0 10.0 AXIS_PTS_REF ATQD_EstInitVehWeight_X_c /end AXIS_DESCR
/end CHARACTERISTIC
/begin AXIS_PTS ATQD_EstInitVehWeight_X_c "" 0x0000 /* @ECU_Address@ATQD_EstInitVehWeight_X_c@ */ NO_INPUT_QUANTITY Lookup1D_X_FLOAT32_IEEE 0 SWC_FDC_type_CM_single_c 10 0.0 10.0 /end AXIS_PTS
/begin CHARACTERISTIC MTQD_FrGenActReduce_Z_Nm "" MAP 0x0000 /* @ECU_Address@MTQD_FrGenActReduce_Z_Nm@ */ Lookup2D_FLOAT32_IEEE 0 SWC_FDC_type_CM_single_Nm -100000.0 0.0
 /begin AXIS_DESCR COM_AXIS NO_INPUT_QUANTITY SWC_FDC_type_CM_single_rpm 22 -100000.0 100000.0 AXIS_PTS_REF ATQD_FrMotActReduce_X_rpm /end AXIS_DESCR
 /begin AXIS_DESCR COM_AXIS NO_INPUT_QUANTITY SWC_FDC_type_CM_single_C 12 -100.0 300.0 AXIS_PTS_REF ATQD_FrMotActReduce_Y_C /end AXIS_DESCR
/end CHARACTERISTIC
/begin AXIS_PTS ATQD_FrMotActReduce_Y_C "" 0x0000 /* @ECU_Address@ATQD_FrMotActReduce_Y_C@ */ NO_INPUT_QUANTITY Lookup2D_X_FLOAT32_IEEE 0 SWC_FDC_type_CM_single_C 12 -100.0 300.0 /end AXIS_PTS
/begin AXIS_PTS ATQD_FrMotActReduce_X_rpm "" 0x0000 /* @ECU_Address@ATQD_FrMotActReduce_X_rpm@ */ NO_INPUT_QUANTITY Lookup2D_X_FLOAT32_IEEE 0 SWC_FDC_type_CM_single_rpm 22 -100000.0 100000.0 /end AXIS_PTS
/begin CHARACTERISTIC MTQD_FrMotActReduce_Z_Nm "" MAP 0x0000 /* @ECU_Address@MTQD_FrMotActReduce_Z_Nm@ */ Lookup2D_FLOAT32_IEEE 0 SWC_FDC_type_CM_single_Nm 0.0 100000.0
 /begin AXIS_DESCR COM_AXIS NO_INPUT_QUANTITY SWC_FDC_type_CM_single_rpm 22 -100000.0 100000.0 AXIS_PTS_REF ATQD_FrMotActReduce_X_rpm /end AXIS_DESCR
 /begin AXIS_DESCR COM_AXIS NO_INPUT_QUANTITY SWC_FDC_type_CM_single_C 12 -100.0 300.0 AXIS_PTS_REF ATQD_FrMotActReduce_Y_C /end AXIS_DESCR
/end CHARACTERISTIC
/begin CHARACTERISTIC MTQD_RrGenActReduce_Z_Nm "" MAP 0x0000 /* @ECU_Address@MTQD_RrGenActReduce_Z_Nm@ */ Lookup2D_FLOAT32_IEEE 0 SWC_FDC_type_CM_single_Nm -100000.0 0.0
 /begin AXIS_DESCR COM_AXIS NO_INPUT_QUANTITY SWC_FDC_type_CM_single_rpm 22 -100000.0 100000.0 AXIS_PTS_REF ATQD_FrMotActReduce_X_rpm /end AXIS_DESCR
 /begin AXIS_DESCR COM_AXIS NO_INPUT_QUANTITY SWC_FDC_type_CM_single_C 12 -100.0 300.0 AXIS_PTS_REF ATQD_FrMotActReduce_Y_C /end AXIS_DESCR
/end CHARACTERISTIC
/begin CHARACTERISTIC MTQD_RrMotActReduce_Z_Nm "" MAP 0x0000 /* @ECU_Address@MTQD_RrMotActReduce_Z_Nm@ */ Lookup2D_FLOAT32_IEEE 0 SWC_FDC_type_CM_single_Nm 0.0 100000.0
 /begin AXIS_DESCR COM_AXIS NO_INPUT_QUANTITY SWC_FDC_type_CM_single_rpm 22 -100000.0 100000.0 AXIS_PTS_REF ATQD_FrMotActReduce_X_rpm /end AXIS_DESCR
 /begin AXIS_DESCR COM_AXIS NO_INPUT_QUANTITY SWC_FDC_type_CM_single_C 12 -100.0 300.0 AXIS_PTS_REF ATQD_FrMotActReduce_Y_C /end AXIS_DESCR
/end CHARACTERISTIC
/begin CHARACTERISTIC MTQD_BOSEnBPSPosn_Y_pct "" CURVE 0x0000 /* @ECU_Address@MTQD_BOSEnBPSPosn_Y_pct@ */ Lookup1D_FLOAT32_IEEE 0 SWC_FDC_type_CM_single_pct -10.0 125.0
 /begin AXIS_DESCR COM_AXIS VTQD_VehActSpd_kph SWC_FDC_type_CM_single_kph 27 -10.0 300.0 AXIS_PTS_REF ATQD_BOSEnBPSPosn_X_kph /end AXIS_DESCR
/end CHARACTERISTIC
/begin AXIS_PTS ATQD_BOSEnBPSPosn_X_kph "" 0x0000 /* @ECU_Address@ATQD_BOSEnBPSPosn_X_kph@ */ VTQD_VehActSpd_kph Lookup1D_X_FLOAT32_IEEE 0 SWC_FDC_type_CM_single_kph 27 -10.0 300.0 /end AXIS_PTS
/begin CHARACTERISTIC MTQD_BOSMap_Z_pct "" MAP 0x0000 /* @ECU_Address@MTQD_BOSMap_Z_pct@ */ Lookup2D_FLOAT32_IEEE 0 SWC_FDC_type_CM_single_pct 0.0 110.0
 /begin AXIS_DESCR COM_AXIS VTQD_TqTargetShaftSpd_rpm SWC_FDC_type_CM_single_rpm 4 -100000.0 100000.0 AXIS_PTS_REF ATQD_BOSMap_X_rpm /end AXIS_DESCR
 /begin AXIS_DESCR COM_AXIS VTQD_ActBPSPosn_pct SWC_FDC_type_CM_single_pct 11 0.0 110.0 AXIS_PTS_REF ATQD_BOSMap_Y_pct /end AXIS_DESCR
/end CHARACTERISTIC
/begin AXIS_PTS ATQD_BOSMap_Y_pct "" 0x0000 /* @ECU_Address@ATQD_BOSMap_Y_pct@ */ VTQD_ActBPSPosn_pct Lookup2D_X_FLOAT32_IEEE 0 SWC_FDC_type_CM_single_pct 11 0.0 110.0 /end AXIS_PTS
/begin AXIS_PTS ATQD_BOSMap_X_rpm "" 0x0000 /* @ECU_Address@ATQD_BOSMap_X_rpm@ */ VTQD_TqTargetShaftSpd_rpm Lookup2D_X_FLOAT32_IEEE 0 SWC_FDC_type_CM_single_rpm 4 -100000.0 100000.0 /end AXIS_PTS
/begin CHARACTERISTIC MTQD_CreepBPSDisPosnR_Y_pct "" CURVE 0x0000 /* @ECU_Address@MTQD_CreepBPSDisPosnR_Y_pct@ */ Lookup1D_FLOAT32_IEEE 0 SWC_FDC_type_CM_single_pct 0.0 125.0
 /begin AXIS_DESCR COM_AXIS NO_INPUT_QUANTITY SWC_FDC_type_CM_single_Deg 21 -180.0 180.0 AXIS_PTS_REF ATQD_CreepBPSDisPosnR_X_Deg /end AXIS_DESCR
/end CHARACTERISTIC
/begin AXIS_PTS ATQD_CreepBPSDisPosnR_X_Deg "" 0x0000 /* @ECU_Address@ATQD_CreepBPSDisPosnR_X_Deg@ */ NO_INPUT_QUANTITY Lookup1D_X_FLOAT32_IEEE 0 SWC_FDC_type_CM_single_Deg 21 -180.0 180.0 /end AXIS_PTS
/begin CHARACTERISTIC MTQD_CreepBPSDisPosn_Y_pct "" CURVE 0x0000 /* @ECU_Address@MTQD_CreepBPSDisPosn_Y_pct@ */ Lookup1D_FLOAT32_IEEE 0 SWC_FDC_type_CM_single_pct 0.0 125.0
 /begin AXIS_DESCR COM_AXIS NO_INPUT_QUANTITY SWC_FDC_type_CM_single_deg 21 -100.0 100.0 AXIS_PTS_REF ATQD_CreepBPSDisPosn_X_Deg /end AXIS_DESCR
/end CHARACTERISTIC
/begin AXIS_PTS ATQD_CreepBPSDisPosn_X_Deg "" 0x0000 /* @ECU_Address@ATQD_CreepBPSDisPosn_X_Deg@ */ NO_INPUT_QUANTITY Lookup1D_X_FLOAT32_IEEE 0 SWC_FDC_type_CM_single_deg 21 -100.0 100.0 /end AXIS_PTS
/begin CHARACTERISTIC MTQD_CreepBPSEnPosnR_Y_pct "" CURVE 0x0000 /* @ECU_Address@MTQD_CreepBPSEnPosnR_Y_pct@ */ Lookup1D_FLOAT32_IEEE 0 SWC_FDC_type_CM_single_pct 0.0 125.0
 /begin AXIS_DESCR COM_AXIS NO_INPUT_QUANTITY SWC_FDC_type_CM_single_Deg 21 -180.0 180.0 AXIS_PTS_REF ATQD_CreepBPSEnPosnR_X_Deg /end AXIS_DESCR
/end CHARACTERISTIC
/begin AXIS_PTS ATQD_CreepBPSEnPosnR_X_Deg "" 0x0000 /* @ECU_Address@ATQD_CreepBPSEnPosnR_X_Deg@ */ NO_INPUT_QUANTITY Lookup1D_X_FLOAT32_IEEE 0 SWC_FDC_type_CM_single_Deg 21 -180.0 180.0 /end AXIS_PTS
/begin CHARACTERISTIC MTQD_CreepBPSEnPosn_Y_pct "" CURVE 0x0000 /* @ECU_Address@MTQD_CreepBPSEnPosn_Y_pct@ */ Lookup1D_FLOAT32_IEEE 0 SWC_FDC_type_CM_single_pct 0.0 125.0
 /begin AXIS_DESCR COM_AXIS NO_INPUT_QUANTITY SWC_FDC_type_CM_single_deg 21 -100.0 100.0 AXIS_PTS_REF ATQD_CreepBPSEnPosn_X_Deg /end AXIS_DESCR
/end CHARACTERISTIC
/begin AXIS_PTS ATQD_CreepBPSEnPosn_X_Deg "" 0x0000 /* @ECU_Address@ATQD_CreepBPSEnPosn_X_Deg@ */ NO_INPUT_QUANTITY Lookup1D_X_FLOAT32_IEEE 0 SWC_FDC_type_CM_single_deg 21 -100.0 100.0 /end AXIS_PTS
/begin CHARACTERISTIC MTQD_CreepBaseTqD_Z_Nm "" MAP 0x0000 /* @ECU_Address@MTQD_CreepBaseTqD_Z_Nm@ */ Lookup2D_FLOAT32_IEEE 0 SWC_FDC_type_CM_single_Nm -100000.0 100000.0
 /begin AXIS_DESCR COM_AXIS VTQD_VehActSpd_kph SWC_FDC_type_CM_single_kph 21 -20.0 20.0 AXIS_PTS_REF ATQD_CreepBaseTqD_X_kph /end AXIS_DESCR
 /begin AXIS_DESCR COM_AXIS NO_INPUT_QUANTITY SWC_FDC_type_CM_single_deg 27 -90.0 90.0 AXIS_PTS_REF ATQD_CreepBaseTqD_Y_Deg /end AXIS_DESCR
/end CHARACTERISTIC
/begin AXIS_PTS ATQD_CreepBaseTqD_Y_Deg "" 0x0000 /* @ECU_Address@ATQD_CreepBaseTqD_Y_Deg@ */ NO_INPUT_QUANTITY Lookup2D_X_FLOAT32_IEEE 0 SWC_FDC_type_CM_single_deg 27 -90.0 90.0 /end AXIS_PTS
/begin AXIS_PTS ATQD_CreepBaseTqD_X_kph "" 0x0000 /* @ECU_Address@ATQD_CreepBaseTqD_X_kph@ */ VTQD_VehActSpd_kph Lookup2D_X_FLOAT32_IEEE 0 SWC_FDC_type_CM_single_kph 21 -20.0 20.0 /end AXIS_PTS
/begin CHARACTERISTIC MTQD_CreepBaseTqR_Z_Nm "" MAP 0x0000 /* @ECU_Address@MTQD_CreepBaseTqR_Z_Nm@ */ Lookup2D_FLOAT32_IEEE 0 SWC_FDC_type_CM_single_Nm -100000.0 100000.0
 /begin AXIS_DESCR COM_AXIS VTQD_VehActSpd_kph SWC_FDC_type_CM_single_kph 21 -20.0 20.0 AXIS_PTS_REF ATQD_CreepBaseTqR_X_kph /end AXIS_DESCR
 /begin AXIS_DESCR COM_AXIS NO_INPUT_QUANTITY SWC_FDC_type_CM_single_deg 27 -90.0 90.0 AXIS_PTS_REF ATQD_CreepBaseTqR_Y_Deg /end AXIS_DESCR
/end CHARACTERISTIC
/begin AXIS_PTS ATQD_CreepBaseTqR_Y_Deg "" 0x0000 /* @ECU_Address@ATQD_CreepBaseTqR_Y_Deg@ */ NO_INPUT_QUANTITY Lookup2D_X_FLOAT32_IEEE 0 SWC_FDC_type_CM_single_deg 27 -90.0 90.0 /end AXIS_PTS
/begin AXIS_PTS ATQD_CreepBaseTqR_X_kph "" 0x0000 /* @ECU_Address@ATQD_CreepBaseTqR_X_kph@ */ VTQD_VehActSpd_kph Lookup2D_X_FLOAT32_IEEE 0 SWC_FDC_type_CM_single_kph 21 -20.0 20.0 /end AXIS_PTS
/begin CHARACTERISTIC MTQD_CreepDeltaTq_Y_Nm "" CURVE 0x0000 /* @ECU_Address@MTQD_CreepDeltaTq_Y_Nm@ */ Lookup1D_FLOAT32_IEEE 0 SWC_FDC_type_CM_single_Nm -100000.0 100000.0
 /begin AXIS_DESCR COM_AXIS VTQD_CreepErrSpd_kph SWC_FDC_type_CM_single_kph 41 -30.0 20.0 AXIS_PTS_REF ATQD_CreepDeltaTq_X_kph /end AXIS_DESCR
/end CHARACTERISTIC
/begin AXIS_PTS ATQD_CreepDeltaTq_X_kph "" 0x0000 /* @ECU_Address@ATQD_CreepDeltaTq_X_kph@ */ VTQD_CreepErrSpd_kph Lookup1D_X_FLOAT32_IEEE 0 SWC_FDC_type_CM_single_kph 41 -30.0 20.0 /end AXIS_PTS
/begin CHARACTERISTIC MTQD_CreepIterm_Z_Nm "" MAP 0x0000 /* @ECU_Address@MTQD_CreepIterm_Z_Nm@ */ Lookup2D_FLOAT32_IEEE 0 SWC_FDC_type_CM_single_Nm -1000.0 1000.0
 /begin AXIS_DESCR COM_AXIS VTQD_CreepErrSpd_kph SWC_FDC_type_CM_single_kph 41 -100.0 100.0 AXIS_PTS_REF ATQD_CreepIterm_X_kph /end AXIS_DESCR
 /begin AXIS_DESCR COM_AXIS VTQD_VehActSpd_kph SWC_FDC_type_CM_single_kph 7 -100.0 100.0 AXIS_PTS_REF ATQD_CreepIterm_Y_kph /end AXIS_DESCR
/end CHARACTERISTIC
/begin AXIS_PTS ATQD_CreepIterm_Y_kph "" 0x0000 /* @ECU_Address@ATQD_CreepIterm_Y_kph@ */ VTQD_VehActSpd_kph Lookup2D_X_FLOAT32_IEEE 0 SWC_FDC_type_CM_single_kph 7 -100.0 100.0 /end AXIS_PTS
/begin AXIS_PTS ATQD_CreepIterm_X_kph "" 0x0000 /* @ECU_Address@ATQD_CreepIterm_X_kph@ */ VTQD_CreepErrSpd_kph Lookup2D_X_FLOAT32_IEEE 0 SWC_FDC_type_CM_single_kph 41 -100.0 100.0 /end AXIS_PTS
/begin CHARACTERISTIC MTQD_CreepPreloadTq_Z_Nm "" MAP 0x0000 /* @ECU_Address@MTQD_CreepPreloadTq_Z_Nm@ */ Lookup2D_FLOAT32_IEEE 0 SWC_FDC_type_CM_single_Nm 0.0 100000.0
 /begin AXIS_DESCR COM_AXIS NO_INPUT_QUANTITY SWC_FDC_type_CM_single_kph 13 0.0 300.0 AXIS_PTS_REF ATQD_CreepPreloadTq_X_kph /end AXIS_DESCR
 /begin AXIS_DESCR COM_AXIS VTQD_CreepPreloadTime_s SWC_FDC_type_CM_single_s 27 0.0 100.0 AXIS_PTS_REF ATQD_CreepPreloadTq_Y_s /end AXIS_DESCR
/end CHARACTERISTIC
/begin AXIS_PTS ATQD_CreepPreloadTq_Y_s "" 0x0000 /* @ECU_Address@ATQD_CreepPreloadTq_Y_s@ */ VTQD_CreepPreloadTime_s Lookup2D_X_FLOAT32_IEEE 0 SWC_FDC_type_CM_single_s 27 0.0 100.0 /end AXIS_PTS
/begin AXIS_PTS ATQD_CreepPreloadTq_X_kph "" 0x0000 /* @ECU_Address@ATQD_CreepPreloadTq_X_kph@ */ NO_INPUT_QUANTITY Lookup2D_X_FLOAT32_IEEE 0 SWC_FDC_type_CM_single_kph 13 0.0 300.0 /end AXIS_PTS
/begin CHARACTERISTIC MTQD_CreepPreloadTime_Y_s "" CURVE 0x0000 /* @ECU_Address@MTQD_CreepPreloadTime_Y_s@ */ Lookup1D_FLOAT32_IEEE 0 SWC_FDC_type_CM_single_s 0.0 3600.0
 /begin AXIS_DESCR COM_AXIS VTQD_VehActSpd_kph SWC_FDC_type_CM_single_kph 13 0.0 300.0 AXIS_PTS_REF ATQD_CreepPreloadTime_X_kph /end AXIS_DESCR
/end CHARACTERISTIC
/begin AXIS_PTS ATQD_CreepPreloadTime_X_kph "" 0x0000 /* @ECU_Address@ATQD_CreepPreloadTime_X_kph@ */ VTQD_VehActSpd_kph Lookup1D_X_FLOAT32_IEEE 0 SWC_FDC_type_CM_single_kph 13 0.0 300.0 /end AXIS_PTS
/begin CHARACTERISTIC MTQD_CreepProtTq_Y_Nm "" CURVE 0x0000 /* @ECU_Address@MTQD_CreepProtTq_Y_Nm@ */ Lookup1D_FLOAT32_IEEE 0 SWC_FDC_type_CM_single_pct -100000.0 100000.0
 /begin AXIS_DESCR COM_AXIS NO_INPUT_QUANTITY SWC_FDC_type_CM_single_deg 21 -100.0 100.0 AXIS_PTS_REF ATQD_CreepProtTq_X_Deg /end AXIS_DESCR
/end CHARACTERISTIC
/begin AXIS_PTS ATQD_CreepProtTq_X_Deg "" 0x0000 /* @ECU_Address@ATQD_CreepProtTq_X_Deg@ */ NO_INPUT_QUANTITY Lookup1D_X_FLOAT32_IEEE 0 SWC_FDC_type_CM_single_deg 21 -100.0 100.0 /end AXIS_PTS
/begin CHARACTERISTIC MTQD_CreepPterm_Z_Nm "" MAP 0x0000 /* @ECU_Address@MTQD_CreepPterm_Z_Nm@ */ Lookup2D_FLOAT32_IEEE 0 SWC_FDC_type_CM_single_Nm -1000.0 1000.0
 /begin AXIS_DESCR COM_AXIS VTQD_CreepErrSpd_kph SWC_FDC_type_CM_single_kph 18 -100.0 100.0 AXIS_PTS_REF ATQD_CreepPterm_X_kph /end AXIS_DESCR
 /begin AXIS_DESCR COM_AXIS VTQD_VehActSpd_kph SWC_FDC_type_CM_single_kph 19 -100.0 100.0 AXIS_PTS_REF ATQD_CreepPterm_Y_kph /end AXIS_DESCR
/end CHARACTERISTIC
/begin AXIS_PTS ATQD_CreepPterm_Y_kph "" 0x0000 /* @ECU_Address@ATQD_CreepPterm_Y_kph@ */ VTQD_VehActSpd_kph Lookup2D_X_FLOAT32_IEEE 0 SWC_FDC_type_CM_single_kph 19 -100.0 100.0 /end AXIS_PTS
/begin AXIS_PTS ATQD_CreepPterm_X_kph "" 0x0000 /* @ECU_Address@ATQD_CreepPterm_X_kph@ */ VTQD_CreepErrSpd_kph Lookup2D_X_FLOAT32_IEEE 0 SWC_FDC_type_CM_single_kph 18 -100.0 100.0 /end AXIS_PTS
/begin CHARACTERISTIC MTQD_CreepTargetSpdD_Y_kph "" CURVE 0x0000 /* @ECU_Address@MTQD_CreepTargetSpdD_Y_kph@ */ Lookup1D_FLOAT32_IEEE 0 SWC_FDC_type_CM_single_kph 0.0 255.0
 /begin AXIS_DESCR COM_AXIS VTQD_ActBPSPosn_pct SWC_FDC_type_CM_single_deg 21 -100.0 100.0 AXIS_PTS_REF ATQD_CreepTargetSpdD_X_pct /end AXIS_DESCR
/end CHARACTERISTIC
/begin AXIS_PTS ATQD_CreepTargetSpdD_X_pct "" 0x0000 /* @ECU_Address@ATQD_CreepTargetSpdD_X_pct@ */ VTQD_ActBPSPosn_pct Lookup1D_X_FLOAT32_IEEE 0 SWC_FDC_type_CM_single_deg 21 -100.0 100.0 /end AXIS_PTS
/begin CHARACTERISTIC MTQD_CreepTargetSpdR_Y_kph "" CURVE 0x0000 /* @ECU_Address@MTQD_CreepTargetSpdR_Y_kph@ */ Lookup1D_FLOAT32_IEEE 0 SWC_FDC_type_CM_single_kph 0.0 255.0
 /begin AXIS_DESCR COM_AXIS VTQD_ActBPSPosn_pct SWC_FDC_type_CM_single_deg 21 -100.0 100.0 AXIS_PTS_REF ATQD_CreepTargetSpdR_X_pct /end AXIS_DESCR
/end CHARACTERISTIC
/begin AXIS_PTS ATQD_CreepTargetSpdR_X_pct "" 0x0000 /* @ECU_Address@ATQD_CreepTargetSpdR_X_pct@ */ VTQD_ActBPSPosn_pct Lookup1D_X_FLOAT32_IEEE 0 SWC_FDC_type_CM_single_deg 21 -100.0 100.0 /end AXIS_PTS
/begin CHARACTERISTIC MTQD_OPDHoldEnSpd_Y_kph "" CURVE 0x0000 /* @ECU_Address@MTQD_OPDHoldEnSpd_Y_kph@ */ Lookup1D_FLOAT32_IEEE 0 SWC_FDC_type_CM_single_kph -10.0 300.0
 /begin AXIS_DESCR COM_AXIS NO_INPUT_QUANTITY SWC_FDC_type_CM_single_Deg 13 -180.0 180.0 AXIS_PTS_REF ATQD_OPDHoldEnSpd_X_Deg /end AXIS_DESCR
/end CHARACTERISTIC
/begin AXIS_PTS ATQD_OPDHoldEnSpd_X_Deg "" 0x0000 /* @ECU_Address@ATQD_OPDHoldEnSpd_X_Deg@ */ NO_INPUT_QUANTITY Lookup1D_X_FLOAT32_IEEE 0 SWC_FDC_type_CM_single_Deg 13 -180.0 180.0 /end AXIS_PTS
/begin CHARACTERISTIC MTQD_WhlSkipDisCreep_Y_enum "" CURVE 0x0000 /* @ECU_Address@MTQD_WhlSkipDisCreep_Y_enum@ */ Lookup1D_UBYTE 0 SWC_FDC_type_CM_uint8_enum 0.0 5.0
 /begin AXIS_DESCR COM_AXIS VTQD_ActWhlSkipSta_enum SWC_FDC_type_CM_uint8_enum 16 0.0 255.0 AXIS_PTS_REF ATQD_WhlSkipDisCreep_X_enum /end AXIS_DESCR
/end CHARACTERISTIC
/begin AXIS_PTS ATQD_WhlSkipDisCreep_X_enum "" 0x0000 /* @ECU_Address@ATQD_WhlSkipDisCreep_X_enum@ */ VTQD_ActWhlSkipSta_enum Lookup1D_X_UBYTE 0 SWC_FDC_type_CM_uint8_enum 16 0.0 255.0 /end AXIS_PTS
/begin CHARACTERISTIC MTQD_EscapeModePedTq_Z_Nm "" MAP 0x0000 /* @ECU_Address@MTQD_EscapeModePedTq_Z_Nm@ */ Lookup2D_FLOAT32_IEEE 0 SWC_FDC_type_CM_single_Nm -100000.0 100000.0
 /begin AXIS_DESCR COM_AXIS VTQD_ActAPSPosn_pct SWC_FDC_type_CM_single_pct 7 -10.0 125.0 AXIS_PTS_REF ATQD_EscapeModePedTq_X_pct /end AXIS_DESCR
 /begin AXIS_DESCR COM_AXIS VTQD_MaxShaftSpd_rpm SWC_FDC_type_CM_single_rpm 9 -100000.0 100000.0 AXIS_PTS_REF ATQD_EscapeModePedTq_Y_rpm /end AXIS_DESCR
/end CHARACTERISTIC
/begin AXIS_PTS ATQD_EscapeModePedTq_Y_rpm "" 0x0000 /* @ECU_Address@ATQD_EscapeModePedTq_Y_rpm@ */ VTQD_MaxShaftSpd_rpm Lookup2D_X_FLOAT32_IEEE 0 SWC_FDC_type_CM_single_rpm 9 -100000.0 100000.0 /end AXIS_PTS
/begin AXIS_PTS ATQD_EscapeModePedTq_X_pct "" 0x0000 /* @ECU_Address@ATQD_EscapeModePedTq_X_pct@ */ VTQD_ActAPSPosn_pct Lookup2D_X_FLOAT32_IEEE 0 SWC_FDC_type_CM_single_pct 7 -10.0 125.0 /end AXIS_PTS
/begin CHARACTERISTIC MTQD_PreLoadTq_Y_Nm "" CURVE 0x0000 /* @ECU_Address@MTQD_PreLoadTq_Y_Nm@ */ Lookup1D_FLOAT32_IEEE 0 SWC_FDC_type_CM_single_Nm -100.0 500.0
 /begin AXIS_DESCR COM_AXIS VTQD_PreLoadHoldtime_s SWC_FDC_type_CM_single_s 10 0.0 100.0 AXIS_PTS_REF ATQD_PreLoadTq_X_s /end AXIS_DESCR
/end CHARACTERISTIC
/begin AXIS_PTS ATQD_PreLoadTq_X_s "" 0x0000 /* @ECU_Address@ATQD_PreLoadTq_X_s@ */ VTQD_PreLoadHoldtime_s Lookup1D_X_FLOAT32_IEEE 0 SWC_FDC_type_CM_single_s 10 0.0 100.0 /end AXIS_PTS
/begin CHARACTERISTIC MTQD_OrigPedTqLowLim_Z_Nm "" MAP 0x0000 /* @ECU_Address@MTQD_OrigPedTqLowLim_Z_Nm@ */ Lookup2D_FLOAT32_IEEE 0 SWC_FDC_type_CM_single_Nm -100000.0 100000.0
 /begin AXIS_DESCR COM_AXIS NO_INPUT_QUANTITY SWC_FDC_type_CM_single_Deg 25 0.0 900.0 AXIS_PTS_REF ATQD_OrigPedTqLowLim_X_Deg /end AXIS_DESCR
 /begin AXIS_DESCR COM_AXIS NO_INPUT_QUANTITY SWC_FDC_type_CM_single_pct 25 -125.0 125.0 AXIS_PTS_REF ATQD_OrigPedTqLowLim_Y_pct /end AXIS_DESCR
/end CHARACTERISTIC
/begin AXIS_PTS ATQD_OrigPedTqLowLim_Y_pct "" 0x0000 /* @ECU_Address@ATQD_OrigPedTqLowLim_Y_pct@ */ NO_INPUT_QUANTITY Lookup2D_X_FLOAT32_IEEE 0 SWC_FDC_type_CM_single_pct 25 -125.0 125.0 /end AXIS_PTS
/begin AXIS_PTS ATQD_OrigPedTqLowLim_X_Deg "" 0x0000 /* @ECU_Address@ATQD_OrigPedTqLowLim_X_Deg@ */ NO_INPUT_QUANTITY Lookup2D_X_FLOAT32_IEEE 0 SWC_FDC_type_CM_single_Deg 25 0.0 900.0 /end AXIS_PTS
/begin CHARACTERISTIC MTQD_PedalMapClimbUpLim_Z_Nm "" MAP 0x0000 /* @ECU_Address@MTQD_PedalMapClimbUpLim_Z_Nm@ */ Lookup2D_FLOAT32_IEEE 0 SWC_FDC_type_CM_single_Nm -100000.0 100000.0
 /begin AXIS_DESCR COM_AXIS NO_INPUT_QUANTITY SWC_FDC_type_CM_single_rpm 21 -1000.0 1000.0 AXIS_PTS_REF ATQD_PedalMapClimbUpLim_X_rpm /end AXIS_DESCR
 /begin AXIS_DESCR COM_AXIS VTQD_GRADE_Deg SWC_FDC_type_CM_single_Deg 27 -180.0 180.0 AXIS_PTS_REF ATQD_PedalMapClimbUpLim_Y_Deg /end AXIS_DESCR
/end CHARACTERISTIC
/begin AXIS_PTS ATQD_PedalMapClimbUpLim_Y_Deg "" 0x0000 /* @ECU_Address@ATQD_PedalMapClimbUpLim_Y_Deg@ */ VTQD_GRADE_Deg Lookup2D_X_FLOAT32_IEEE 0 SWC_FDC_type_CM_single_Deg 27 -180.0 180.0 /end AXIS_PTS
/begin AXIS_PTS ATQD_PedalMapClimbUpLim_X_rpm "" 0x0000 /* @ECU_Address@ATQD_PedalMapClimbUpLim_X_rpm@ */ NO_INPUT_QUANTITY Lookup2D_X_FLOAT32_IEEE 0 SWC_FDC_type_CM_single_rpm 21 -1000.0 1000.0 /end AXIS_PTS
/begin CHARACTERISTIC MTQD_SlideRegenTqGain_Z_Nm "" MAP 0x0000 /* @ECU_Address@MTQD_SlideRegenTqGain_Z_Nm@ */ Lookup2D_FLOAT32_IEEE 0 SWC_FDC_type_CM_single_Nm -100000.0 100000.0
 /begin AXIS_DESCR COM_AXIS NO_INPUT_QUANTITY SWC_FDC_type_CM_single_Gps 30 -10.0 10.0 AXIS_PTS_REF ATQD_SlideRegenTqGain_X_Gps /end AXIS_DESCR
 /begin AXIS_DESCR COM_AXIS VTQD_SlideRateDev_pct SWC_FDC_type_CM_single_pct 38 -125.0 125.0 AXIS_PTS_REF ATQD_SlideRegenTqGain_Y_pct /end AXIS_DESCR
/end CHARACTERISTIC
/begin AXIS_PTS ATQD_SlideRegenTqGain_Y_pct "" 0x0000 /* @ECU_Address@ATQD_SlideRegenTqGain_Y_pct@ */ VTQD_SlideRateDev_pct Lookup2D_X_FLOAT32_IEEE 0 SWC_FDC_type_CM_single_pct 38 -125.0 125.0 /end AXIS_PTS
/begin AXIS_PTS ATQD_SlideRegenTqGain_X_Gps "" 0x0000 /* @ECU_Address@ATQD_SlideRegenTqGain_X_Gps@ */ NO_INPUT_QUANTITY Lookup2D_X_FLOAT32_IEEE 0 SWC_FDC_type_CM_single_Gps 30 -10.0 10.0 /end AXIS_PTS
/begin CHARACTERISTIC MTQD_YawTqLowLim_Y_Nm "" CURVE 0x0000 /* @ECU_Address@MTQD_YawTqLowLim_Y_Nm@ */ Lookup1D_FLOAT32_IEEE 0 SWC_FDC_type_CM_single_Nm -100000.0 100000.0
 /begin AXIS_DESCR COM_AXIS VTQD_TqLowLimYawDev_degps SWC_FDC_type_CM_single_degps 24 -150.0 150.0 AXIS_PTS_REF ATQD_YawTqLowLim_X_degps /end AXIS_DESCR
/end CHARACTERISTIC
/begin AXIS_PTS ATQD_YawTqLowLim_X_degps "" 0x0000 /* @ECU_Address@ATQD_YawTqLowLim_X_degps@ */ VTQD_TqLowLimYawDev_degps Lookup1D_X_FLOAT32_IEEE 0 SWC_FDC_type_CM_single_degps 24 -150.0 150.0 /end AXIS_PTS
/begin CHARACTERISTIC MTQD_APSDecReq_Z_mps2 "" MAP 0x0000 /* @ECU_Address@MTQD_APSDecReq_Z_mps2@ */ Lookup2D_FLOAT32_IEEE 0 SWC_FDC_type_CM_single_mps2 -20.0 20.0
 /begin AXIS_DESCR COM_AXIS VTQD_VehActSpd_kph SWC_FDC_type_CM_single_kph 29 -100.0 100.0 AXIS_PTS_REF ATQD_APSDecReq_X_kph /end AXIS_DESCR
 /begin AXIS_DESCR COM_AXIS VTQD_ActOPDHoldAccDev_mps2 SWC_FDC_type_CM_single_mps2 25 -20.0 20.0 AXIS_PTS_REF ATQD_APSDecReq_Y_mps2 /end AXIS_DESCR
/end CHARACTERISTIC
/begin AXIS_PTS ATQD_APSDecReq_Y_mps2 "" 0x0000 /* @ECU_Address@ATQD_APSDecReq_Y_mps2@ */ VTQD_ActOPDHoldAccDev_mps2 Lookup2D_X_FLOAT32_IEEE 0 SWC_FDC_type_CM_single_mps2 25 -20.0 20.0 /end AXIS_PTS
/begin AXIS_PTS ATQD_APSDecReq_X_kph "" 0x0000 /* @ECU_Address@ATQD_APSDecReq_X_kph@ */ VTQD_VehActSpd_kph Lookup2D_X_FLOAT32_IEEE 0 SWC_FDC_type_CM_single_kph 29 -100.0 100.0 /end AXIS_PTS
/begin CHARACTERISTIC MTQD_APSDecReqCMD_Y_mps2 "" CURVE 0x0000 /* @ECU_Address@MTQD_APSDecReqCMD_Y_mps2@ */ Lookup1D_FLOAT32_IEEE 0 SWC_FDC_type_CM_single_mps2 -20.0 20.0
 /begin AXIS_DESCR COM_AXIS VTQD_VehActSpd_kph SWC_FDC_type_CM_single_kph 16 0.0 300.0 AXIS_PTS_REF ATQD_APSDecReqCMD_X_kph /end AXIS_DESCR
/end CHARACTERISTIC
/begin AXIS_PTS ATQD_APSDecReqCMD_X_kph "" 0x0000 /* @ECU_Address@ATQD_APSDecReqCMD_X_kph@ */ VTQD_VehActSpd_kph Lookup1D_X_FLOAT32_IEEE 0 SWC_FDC_type_CM_single_kph 16 0.0 300.0 /end AXIS_PTS
/begin CHARACTERISTIC MTQD_APSDecReqTs_Y_c "" CURVE 0x0000 /* @ECU_Address@MTQD_APSDecReqTs_Y_c@ */ Lookup1D_FLOAT32_IEEE 0 SWC_FDC_type_CM_single_c 0.0 1.0
 /begin AXIS_DESCR COM_AXIS VTQD_ActAPSPosn_pct SWC_FDC_type_CM_single_c 11 -10.0 125.0 AXIS_PTS_REF ATQD_APSDecReqTs_X_pct /end AXIS_DESCR
/end CHARACTERISTIC
/begin AXIS_PTS ATQD_APSDecReqTs_X_pct "" 0x0000 /* @ECU_Address@ATQD_APSDecReqTs_X_pct@ */ VTQD_ActAPSPosn_pct Lookup1D_X_FLOAT32_IEEE 0 SWC_FDC_type_CM_single_c 11 -10.0 125.0 /end AXIS_PTS
/begin CHARACTERISTIC MTQD_APSDecTimeGain_Z_c "" MAP 0x0000 /* @ECU_Address@MTQD_APSDecTimeGain_Z_c@ */ Lookup2D_FLOAT32_IEEE 0 SWC_FDC_type_CM_single_c 0.0 300.0
 /begin AXIS_DESCR COM_AXIS NO_INPUT_QUANTITY SWC_FDC_type_CM_single_Deg 29 -180.0 180.0 AXIS_PTS_REF ATQD_APSDecTimeGain_X_Deg /end AXIS_DESCR
 /begin AXIS_DESCR COM_AXIS VTQD_APSReqTimer_s SWC_FDC_type_CM_single_s 31 0.0 3600.0 AXIS_PTS_REF ATQD_APSDecTimeGain_Y_s /end AXIS_DESCR
/end CHARACTERISTIC
/begin AXIS_PTS ATQD_APSDecTimeGain_Y_s "" 0x0000 /* @ECU_Address@ATQD_APSDecTimeGain_Y_s@ */ VTQD_APSReqTimer_s Lookup2D_X_FLOAT32_IEEE 0 SWC_FDC_type_CM_single_s 31 0.0 3600.0 /end AXIS_PTS
/begin AXIS_PTS ATQD_APSDecTimeGain_X_Deg "" 0x0000 /* @ECU_Address@ATQD_APSDecTimeGain_X_Deg@ */ NO_INPUT_QUANTITY Lookup2D_X_FLOAT32_IEEE 0 SWC_FDC_type_CM_single_Deg 29 -180.0 180.0 /end AXIS_PTS
/begin CHARACTERISTIC MTQD_APSReqLowSpd_Y_kph "" CURVE 0x0000 /* @ECU_Address@MTQD_APSReqLowSpd_Y_kph@ */ Lookup1D_FLOAT32_IEEE 0 SWC_FDC_type_CM_single_kph -10.0 300.0
 /begin AXIS_DESCR COM_AXIS NO_INPUT_QUANTITY SWC_FDC_type_CM_single_Deg 17 -180.0 180.0 AXIS_PTS_REF ATQD_APSReqLowSpd_X_Deg /end AXIS_DESCR
/end CHARACTERISTIC
/begin AXIS_PTS ATQD_APSReqLowSpd_X_Deg "" 0x0000 /* @ECU_Address@ATQD_APSReqLowSpd_X_Deg@ */ NO_INPUT_QUANTITY Lookup1D_X_FLOAT32_IEEE 0 SWC_FDC_type_CM_single_Deg 17 -180.0 180.0 /end AXIS_PTS
/begin CHARACTERISTIC MTQD_AutoHoldReleaseBPS_Y_pct "" CURVE 0x0000 /* @ECU_Address@MTQD_AutoHoldReleaseBPS_Y_pct@ */ Lookup1D_FLOAT32_IEEE 0 SWC_FDC_type_CM_single_pct -10.0 125.0
 /begin AXIS_DESCR COM_AXIS NO_INPUT_QUANTITY SWC_FDC_type_CM_single_Deg 27 -180.0 180.0 AXIS_PTS_REF ATQD_AutoHoldReleaseBPS_X_Deg /end AXIS_DESCR
/end CHARACTERISTIC
/begin AXIS_PTS ATQD_AutoHoldReleaseBPS_X_Deg "" 0x0000 /* @ECU_Address@ATQD_AutoHoldReleaseBPS_X_Deg@ */ NO_INPUT_QUANTITY Lookup1D_X_FLOAT32_IEEE 0 SWC_FDC_type_CM_single_Deg 27 -180.0 180.0 /end AXIS_PTS
/begin CHARACTERISTIC MTQD_OPDHoldDownRelDelay_Y_s "" CURVE 0x0000 /* @ECU_Address@MTQD_OPDHoldDownRelDelay_Y_s@ */ Lookup1D_FLOAT32_IEEE 0 SWC_FDC_type_CM_single_s 0.0 3600.0
 /begin AXIS_DESCR COM_AXIS NO_INPUT_QUANTITY SWC_FDC_type_CM_single_Deg 11 -180.0 180.0 AXIS_PTS_REF ATQD_OPDHoldDownRelDelay_X_Deg /end AXIS_DESCR
/end CHARACTERISTIC
/begin AXIS_PTS ATQD_OPDHoldDownRelDelay_X_Deg "" 0x0000 /* @ECU_Address@ATQD_OPDHoldDownRelDelay_X_Deg@ */ NO_INPUT_QUANTITY Lookup1D_X_FLOAT32_IEEE 0 SWC_FDC_type_CM_single_Deg 11 -180.0 180.0 /end AXIS_PTS
/begin CHARACTERISTIC MTQD_OPDHoldRelDetTime_Y_s "" CURVE 0x0000 /* @ECU_Address@MTQD_OPDHoldRelDetTime_Y_s@ */ Lookup1D_FLOAT32_IEEE 0 SWC_FDC_type_CM_single_s 0.0 3600.0
 /begin AXIS_DESCR COM_AXIS NO_INPUT_QUANTITY SWC_FDC_type_CM_single_Deg 27 -180.0 180.0 AXIS_PTS_REF ATQD_OPDHoldRelDetTime_X_Deg /end AXIS_DESCR
/end CHARACTERISTIC
/begin AXIS_PTS ATQD_OPDHoldRelDetTime_X_Deg "" 0x0000 /* @ECU_Address@ATQD_OPDHoldRelDetTime_X_Deg@ */ NO_INPUT_QUANTITY Lookup1D_X_FLOAT32_IEEE 0 SWC_FDC_type_CM_single_Deg 27 -180.0 180.0 /end AXIS_PTS
/begin CHARACTERISTIC MTQD_OPDHoldReleaseTq_Y_Nm "" CURVE 0x0000 /* @ECU_Address@MTQD_OPDHoldReleaseTq_Y_Nm@ */ Lookup1D_FLOAT32_IEEE 0 SWC_FDC_type_CM_single_Nm -100000.0 100000.0
 /begin AXIS_DESCR COM_AXIS NO_INPUT_QUANTITY SWC_FDC_type_CM_single_Deg 27 -180.0 180.0 AXIS_PTS_REF ATQD_OPDHoldReleaseTq_X_Deg /end AXIS_DESCR
/end CHARACTERISTIC
/begin AXIS_PTS ATQD_OPDHoldReleaseTq_X_Deg "" 0x0000 /* @ECU_Address@ATQD_OPDHoldReleaseTq_X_Deg@ */ NO_INPUT_QUANTITY Lookup1D_X_FLOAT32_IEEE 0 SWC_FDC_type_CM_single_Deg 27 -180.0 180.0 /end AXIS_PTS
/begin CHARACTERISTIC MTQD_WhlSkipDisOPDHold_Y_enum "" CURVE 0x0000 /* @ECU_Address@MTQD_WhlSkipDisOPDHold_Y_enum@ */ Lookup1D_UBYTE 0 SWC_FDC_type_CM_uint8_enum 0.0 5.0
 /begin AXIS_DESCR COM_AXIS VTQD_ActWhlSkipSta_enum SWC_FDC_type_CM_uint8_enum 16 0.0 255.0 AXIS_PTS_REF ATQD_WhlSkipDisOPDHold_X_enum /end AXIS_DESCR
/end CHARACTERISTIC
/begin AXIS_PTS ATQD_WhlSkipDisOPDHold_X_enum "" 0x0000 /* @ECU_Address@ATQD_WhlSkipDisOPDHold_X_enum@ */ VTQD_ActWhlSkipSta_enum Lookup1D_X_UBYTE 0 SWC_FDC_type_CM_uint8_enum 16 0.0 255.0 /end AXIS_PTS
/begin CHARACTERISTIC MTQR_AltRDCActiveFEDUTs_Z_c "" MAP 0x0000 /* @ECU_Address@MTQR_AltRDCActiveFEDUTs_Z_c@ */ Lookup2D_FLOAT32_IEEE 0 SWC_FDC_type_CM_single_c 0.0 1.0
 /begin AXIS_DESCR COM_AXIS NO_INPUT_QUANTITY SWC_FDC_type_CM_single_pct 23 -125.0 125.0 AXIS_PTS_REF ATQR_AltRDCActiveFEDUTs_X_pct /end AXIS_DESCR
 /begin AXIS_DESCR COM_AXIS NO_INPUT_QUANTITY SWC_FDC_type_CM_single_enum 9 0.0 15.0 AXIS_PTS_REF ATQR_AltRDCActiveFEDUTs_Y_enum /end AXIS_DESCR
/end CHARACTERISTIC
/begin AXIS_PTS ATQR_AltRDCActiveFEDUTs_Y_enum "" 0x0000 /* @ECU_Address@ATQR_AltRDCActiveFEDUTs_Y_enum@ */ NO_INPUT_QUANTITY Lookup2D_X_FLOAT32_IEEE 0 SWC_FDC_type_CM_single_enum 9 0.0 15.0 /end AXIS_PTS
/begin AXIS_PTS ATQR_AltRDCActiveFEDUTs_X_pct "" 0x0000 /* @ECU_Address@ATQR_AltRDCActiveFEDUTs_X_pct@ */ NO_INPUT_QUANTITY Lookup2D_X_FLOAT32_IEEE 0 SWC_FDC_type_CM_single_pct 23 -125.0 125.0 /end AXIS_PTS
/begin CHARACTERISTIC MTQR_CreepFEDUTs_Z_c "" MAP 0x0000 /* @ECU_Address@MTQR_CreepFEDUTs_Z_c@ */ Lookup2D_FLOAT32_IEEE 0 SWC_FDC_type_CM_single_c 0.0 1.0
 /begin AXIS_DESCR COM_AXIS NO_INPUT_QUANTITY SWC_FDC_type_CM_single_rpm 9 -100000.0 100000.0 AXIS_PTS_REF ATQR_CreepFEDUTs_X_rpm /end AXIS_DESCR
 /begin AXIS_DESCR COM_AXIS VTQR_FEDUWhlTqReqSmoothDelay_Nm SWC_FDC_type_CM_single_Nm 10 -10000.0 10000.0 AXIS_PTS_REF ATQR_CreepFEDUTs_Y_Nm /end AXIS_DESCR
/end CHARACTERISTIC
/begin AXIS_PTS ATQR_CreepFEDUTs_Y_Nm "" 0x0000 /* @ECU_Address@ATQR_CreepFEDUTs_Y_Nm@ */ VTQR_FEDUWhlTqReqSmoothDelay_Nm Lookup2D_X_FLOAT32_IEEE 0 SWC_FDC_type_CM_single_Nm 10 -10000.0 10000.0 /end AXIS_PTS
/begin AXIS_PTS ATQR_CreepFEDUTs_X_rpm "" 0x0000 /* @ECU_Address@ATQR_CreepFEDUTs_X_rpm@ */ NO_INPUT_QUANTITY Lookup2D_X_FLOAT32_IEEE 0 SWC_FDC_type_CM_single_rpm 9 -100000.0 100000.0 /end AXIS_PTS
/begin CHARACTERISTIC MTQR_FEDUTIPOutTs_Y_c "" CURVE 0x0000 /* @ECU_Address@MTQR_FEDUTIPOutTs_Y_c@ */ Lookup1D_FLOAT32_IEEE 0 SWC_FDC_type_CM_single_c 0.0 1.0
 /begin AXIS_DESCR COM_AXIS NO_INPUT_QUANTITY SWC_FDC_type_CM_single_rpm 24 -100000.0 100000.0 AXIS_PTS_REF ATQR_FEDUTIPOutTs_X_rpm /end AXIS_DESCR
/end CHARACTERISTIC
/begin AXIS_PTS ATQR_FEDUTIPOutTs_X_rpm "" 0x0000 /* @ECU_Address@ATQR_FEDUTIPOutTs_X_rpm@ */ NO_INPUT_QUANTITY Lookup1D_X_FLOAT32_IEEE 0 SWC_FDC_type_CM_single_rpm 24 -100000.0 100000.0 /end AXIS_PTS
/begin CHARACTERISTIC MTQR_VMCFEDUTs_Z_c "" MAP 0x0000 /* @ECU_Address@MTQR_VMCFEDUTs_Z_c@ */ Lookup2D_FLOAT32_IEEE 0 SWC_FDC_type_CM_single_c 0.0 1.0
 /begin AXIS_DESCR COM_AXIS NO_INPUT_QUANTITY SWC_FDC_type_CM_single_rpm 24 -100000.0 100000.0 AXIS_PTS_REF ATQR_VMCFEDUTs_X_rpm /end AXIS_DESCR
 /begin AXIS_DESCR COM_AXIS VTQR_FEDUWhlTqReqSmoothDelay_Nm SWC_FDC_type_CM_single_Nm 18 -10000.0 10000.0 AXIS_PTS_REF ATQR_VMCFEDUTs_Y_Nm /end AXIS_DESCR
/end CHARACTERISTIC
/begin AXIS_PTS ATQR_VMCFEDUTs_Y_Nm "" 0x0000 /* @ECU_Address@ATQR_VMCFEDUTs_Y_Nm@ */ VTQR_FEDUWhlTqReqSmoothDelay_Nm Lookup2D_X_FLOAT32_IEEE 0 SWC_FDC_type_CM_single_Nm 18 -10000.0 10000.0 /end AXIS_PTS
/begin AXIS_PTS ATQR_VMCFEDUTs_X_rpm "" 0x0000 /* @ECU_Address@ATQR_VMCFEDUTs_X_rpm@ */ NO_INPUT_QUANTITY Lookup2D_X_FLOAT32_IEEE 0 SWC_FDC_type_CM_single_rpm 24 -100000.0 100000.0 /end AXIS_PTS
/begin CHARACTERISTIC KTHC_DTymin1_K "" VALUE 0x0000 /* @ECU_Address@KTHC_DTymin1_K@ */ Scalar_FLOAT32_IEEE 0 SWC_FDC_type_CM_single_K 0.0 10.0 /end CHARACTERISTIC
/begin CHARACTERISTIC KTHC_DTymin2_K "" VALUE 0x0000 /* @ECU_Address@KTHC_DTymin2_K@ */ Scalar_FLOAT32_IEEE 0 SWC_FDC_type_CM_single_K 0.0 10.0 /end CHARACTERISTIC
/begin CHARACTERISTIC KTHC_DTymin3_K "" VALUE 0x0000 /* @ECU_Address@KTHC_DTymin3_K@ */ Scalar_FLOAT32_IEEE 0 SWC_FDC_type_CM_single_K 0.0 10.0 /end CHARACTERISTIC
/begin CHARACTERISTIC KTHC_DTymin4_K "" VALUE 0x0000 /* @ECU_Address@KTHC_DTymin4_K@ */ Scalar_FLOAT32_IEEE 0 SWC_FDC_type_CM_single_K 0.0 10.0 /end CHARACTERISTIC
/begin CHARACTERISTIC KTHC_DTymin5_K "" VALUE 0x0000 /* @ECU_Address@KTHC_DTymin5_K@ */ Scalar_FLOAT32_IEEE 0 SWC_FDC_type_CM_single_K 0.0 10.0 /end CHARACTERISTIC
/begin CHARACTERISTIC KTHC_T1Maxamb_C "" VALUE 0x0000 /* @ECU_Address@KTHC_T1Maxamb_C@ */ Scalar_FLOAT32_IEEE 0 SWC_FDC_type_CM_single_C -40.0 200.0 /end CHARACTERISTIC
/begin CHARACTERISTIC KTHC_T1winSetpointBC_C "" VALUE 0x0000 /* @ECU_Address@KTHC_T1winSetpointBC_C@ */ Scalar_FLOAT32_IEEE 0 SWC_FDC_type_CM_single_C -40.0 200.0 /end CHARACTERISTIC
/begin CHARACTERISTIC KTHC_T2Maxamb_C "" VALUE 0x0000 /* @ECU_Address@KTHC_T2Maxamb_C@ */ Scalar_FLOAT32_IEEE 0 SWC_FDC_type_CM_single_C -40.0 200.0 /end CHARACTERISTIC
/begin CHARACTERISTIC KTHC_T2Minamb_C "" VALUE 0x0000 /* @ECU_Address@KTHC_T2Minamb_C@ */ Scalar_FLOAT32_IEEE 0 SWC_FDC_type_CM_single_C -40.0 200.0 /end CHARACTERISTIC
/begin CHARACTERISTIC KTHC_T2winSetpointBC_C "" VALUE 0x0000 /* @ECU_Address@KTHC_T2winSetpointBC_C@ */ Scalar_FLOAT32_IEEE 0 SWC_FDC_type_CM_single_C -40.0 200.0 /end CHARACTERISTIC
/begin CHARACTERISTIC KTHC_T3Maxamb_C "" VALUE 0x0000 /* @ECU_Address@KTHC_T3Maxamb_C@ */ Scalar_FLOAT32_IEEE 0 SWC_FDC_type_CM_single_C -40.0 200.0 /end CHARACTERISTIC
/begin CHARACTERISTIC KTHC_T3Minamb_C "" VALUE 0x0000 /* @ECU_Address@KTHC_T3Minamb_C@ */ Scalar_FLOAT32_IEEE 0 SWC_FDC_type_CM_single_C -40.0 200.0 /end CHARACTERISTIC
/begin CHARACTERISTIC KTHC_T4Maxamb_C "" VALUE 0x0000 /* @ECU_Address@KTHC_T4Maxamb_C@ */ Scalar_FLOAT32_IEEE 0 SWC_FDC_type_CM_single_C -40.0 200.0 /end CHARACTERISTIC
/begin CHARACTERISTIC KTHC_T4Minamb_C "" VALUE 0x0000 /* @ECU_Address@KTHC_T4Minamb_C@ */ Scalar_FLOAT32_IEEE 0 SWC_FDC_type_CM_single_C -40.0 200.0 /end CHARACTERISTIC
/begin CHARACTERISTIC KTHC_T4winSetpointBC_C "" VALUE 0x0000 /* @ECU_Address@KTHC_T4winSetpointBC_C@ */ Scalar_FLOAT32_IEEE 0 SWC_FDC_type_CM_single_C -40.0 200.0 /end CHARACTERISTIC
/begin CHARACTERISTIC KTHC_T5Minamb_C "" VALUE 0x0000 /* @ECU_Address@KTHC_T5Minamb_C@ */ Scalar_FLOAT32_IEEE 0 SWC_FDC_type_CM_single_C -40.0 200.0 /end CHARACTERISTIC
/begin CHARACTERISTIC KTHC_T5winSetpointBC_C "" VALUE 0x0000 /* @ECU_Address@KTHC_T5winSetpointBC_C@ */ Scalar_FLOAT32_IEEE 0 SWC_FDC_type_CM_single_C -40.0 200.0 /end CHARACTERISTIC
/begin CHARACTERISTIC KTHC_Tambmin_C "" VALUE 0x0000 /* @ECU_Address@KTHC_Tambmin_C@ */ Scalar_FLOAT32_IEEE 0 SWC_FDC_type_CM_single_C -40.0 200.0 /end CHARACTERISTIC
/begin CHARACTERISTIC KTHC_VBlowerMid_K "" VALUE 0x0000 /* @ECU_Address@KTHC_VBlowerMid_K@ */ Scalar_FLOAT32_IEEE 0 SWC_FDC_type_CM_single_K 0.0 1.0 /end CHARACTERISTIC
/begin CHARACTERISTIC KTHC_VBlowerSetLow_K "" VALUE 0x0000 /* @ECU_Address@KTHC_VBlowerSetLow_K@ */ Scalar_FLOAT32_IEEE 0 SWC_FDC_type_CM_single_K 0.0 1.0 /end CHARACTERISTIC
/begin CHARACTERISTIC KTHC_VBlowerdfog_K "" VALUE 0x0000 /* @ECU_Address@KTHC_VBlowerdfog_K@ */ Scalar_FLOAT32_IEEE 0 SWC_FDC_type_CM_single_K 0.0 1.0 /end CHARACTERISTIC
/begin CHARACTERISTIC KTPM_DataInVehSpdThreshold_kph "" VALUE 0x0000 /* @ECU_Address@KTPM_DataInVehSpdThreshold_kph@ */ Scalar_FLOAT32_IEEE 0 SWC_FDC_type_CM_single_kph 0.0 255.0 /end CHARACTERISTIC
/begin CHARACTERISTIC KTQD_ACCOvrdCancelPedTqRat_Nm "" VALUE 0x0000 /* @ECU_Address@KTQD_ACCOvrdCancelPedTqRat_Nm@ */ Scalar_FLOAT32_IEEE 0 SWC_FDC_type_CM_single_Nm 0.0 3000.0 /end CHARACTERISTIC
/begin CHARACTERISTIC KTQD_ACCOvrdCancelResPedTq_pct "" VALUE 0x0000 /* @ECU_Address@KTQD_ACCOvrdCancelResPedTq_pct@ */ Scalar_FLOAT32_IEEE 0 SWC_FDC_type_CM_single_pct 0.0 100.0 /end CHARACTERISTIC
/begin CHARACTERISTIC KTQD_ADASHoldDelayEnTime_s "" VALUE 0x0000 /* @ECU_Address@KTQD_ADASHoldDelayEnTime_s@ */ Scalar_FLOAT32_IEEE 0 SWC_FDC_type_CM_single_s 0.0 3600.0 /end CHARACTERISTIC
/begin CHARACTERISTIC KTQD_ADASHoldPreLoadspd_kph "" VALUE 0x0000 /* @ECU_Address@KTQD_ADASHoldPreLoadspd_kph@ */ Scalar_FLOAT32_IEEE 0 SWC_FDC_type_CM_single_kph 0.0 300.0 /end CHARACTERISTIC
/begin CHARACTERISTIC KTQD_AEBEmergBrkSpd_kph "" VALUE 0x0000 /* @ECU_Address@KTQD_AEBEmergBrkSpd_kph@ */ Scalar_FLOAT32_IEEE 0 SWC_FDC_type_CM_single_kph -10.0 255.0 /end CHARACTERISTIC
/begin CHARACTERISTIC KTQD_APSCMDEnCreepSpd_kph "" VALUE 0x0000 /* @ECU_Address@KTQD_APSCMDEnCreepSpd_kph@ */ Scalar_FLOAT32_IEEE 0 SWC_FDC_type_CM_single_kph 0.0 300.0 /end CHARACTERISTIC
/begin CHARACTERISTIC KTQD_APSDecReqMaxTime_s "" VALUE 0x0000 /* @ECU_Address@KTQD_APSDecReqMaxTime_s@ */ Scalar_FLOAT32_IEEE 0 SWC_FDC_type_CM_single_s 0.0 250.0 /end CHARACTERISTIC
/begin CHARACTERISTIC KTQD_APSRelDisTqDev_Nm "" VALUE 0x0000 /* @ECU_Address@KTQD_APSRelDisTqDev_Nm@ */ Scalar_FLOAT32_IEEE 0 SWC_FDC_type_CM_single_Nm -10000.0 10000.0 /end CHARACTERISTIC
/begin CHARACTERISTIC KTQD_APSReqDelayTime_s "" VALUE 0x0000 /* @ECU_Address@KTQD_APSReqDelayTime_s@ */ Scalar_FLOAT32_IEEE 0 SWC_FDC_type_CM_single_s 0.0 3600.0 /end CHARACTERISTIC
/begin CHARACTERISTIC KTQD_APSReqDownSpd_kph "" VALUE 0x0000 /* @ECU_Address@KTQD_APSReqDownSpd_kph@ */ Scalar_FLOAT32_IEEE 0 SWC_FDC_type_CM_single_kph -10.0 300.0 /end CHARACTERISTIC
/begin CHARACTERISTIC KTQD_APSReqUpSpd_kph "" VALUE 0x0000 /* @ECU_Address@KTQD_APSReqUpSpd_kph@ */ Scalar_FLOAT32_IEEE 0 SWC_FDC_type_CM_single_kph 0.0 300.0 /end CHARACTERISTIC
/begin CHARACTERISTIC KTQD_APSZeroSpd_kph "" VALUE 0x0000 /* @ECU_Address@KTQD_APSZeroSpd_kph@ */ Scalar_FLOAT32_IEEE 0 SWC_FDC_type_CM_single_kph -10.0 300.0 /end CHARACTERISTIC
/begin CHARACTERISTIC KTQD_AWDFrRatio_rat_ovrdval "" VALUE 0x0000 /* @ECU_Address@KTQD_AWDFrRatio_rat_ovrdval@ */ Scalar_FLOAT32_IEEE 0 SWC_FDC_type_CM_single_gain 0.0 1.0 /end CHARACTERISTIC
/begin CHARACTERISTIC KTQD_AWDRrRatio_rat_ovrdval "" VALUE 0x0000 /* @ECU_Address@KTQD_AWDRrRatio_rat_ovrdval@ */ Scalar_FLOAT32_IEEE 0 SWC_FDC_type_CM_single_gain 0.0 1.0 /end CHARACTERISTIC
/begin CHARACTERISTIC KTQD_AutoHoldEnSpd_kph "" VALUE 0x0000 /* @ECU_Address@KTQD_AutoHoldEnSpd_kph@ */ Scalar_FLOAT32_IEEE 0 SWC_FDC_type_CM_single_kph -10.0 300.0 /end CHARACTERISTIC
/begin CHARACTERISTIC KTQD_BOSEnPedalTq_Nm "" VALUE 0x0000 /* @ECU_Address@KTQD_BOSEnPedalTq_Nm@ */ Scalar_FLOAT32_IEEE 0 SWC_FDC_type_CM_single_Nm -100000.0 100000.0 /end CHARACTERISTIC
/begin CHARACTERISTIC KTQD_ClimbMin_rpm "" VALUE 0x0000 /* @ECU_Address@KTQD_ClimbMin_rpm@ */ Scalar_FLOAT32_IEEE 0 SWC_FDC_type_CM_single_rpm -100000.0 100000.0 /end CHARACTERISTIC
/begin CHARACTERISTIC KTQD_CreepAPSPosn2Launch_pct "" VALUE 0x0000 /* @ECU_Address@KTQD_CreepAPSPosn2Launch_pct@ */ Scalar_FLOAT32_IEEE 0 SWC_FDC_type_CM_single_pct -125.0 125.0 /end CHARACTERISTIC
/begin CHARACTERISTIC KTQD_CreepDisPedTqSpd_kph "" VALUE 0x0000 /* @ECU_Address@KTQD_CreepDisPedTqSpd_kph@ */ Scalar_FLOAT32_IEEE 0 SWC_FDC_type_CM_single_kph -300.0 300.0 /end CHARACTERISTIC
/begin CHARACTERISTIC KTQD_CreepDisVehSpd_kph "" VALUE 0x0000 /* @ECU_Address@KTQD_CreepDisVehSpd_kph@ */ Scalar_FLOAT32_IEEE 0 SWC_FDC_type_CM_single_kph -10.0 300.0 /end CHARACTERISTIC
/begin CHARACTERISTIC KTQD_CreepDisableSpdofstR_kph "" VALUE 0x0000 /* @ECU_Address@KTQD_CreepDisableSpdofstR_kph@ */ Scalar_FLOAT32_IEEE 0 SWC_FDC_type_CM_single_kph 0.0 300.0 /end CHARACTERISTIC
/begin CHARACTERISTIC KTQD_CreepDisableSpdofst_kph "" VALUE 0x0000 /* @ECU_Address@KTQD_CreepDisableSpdofst_kph@ */ Scalar_FLOAT32_IEEE 0 SWC_FDC_type_CM_single_kph 0.0 300.0 /end CHARACTERISTIC
/begin CHARACTERISTIC KTQD_CreepEnVehSpd_kph "" VALUE 0x0000 /* @ECU_Address@KTQD_CreepEnVehSpd_kph@ */ Scalar_FLOAT32_IEEE 0 SWC_FDC_type_CM_single_kph -10.0 300.0 /end CHARACTERISTIC
/begin CHARACTERISTIC KTQD_CreepEnableSpdR_kph "" VALUE 0x0000 /* @ECU_Address@KTQD_CreepEnableSpdR_kph@ */ Scalar_FLOAT32_IEEE 0 SWC_FDC_type_CM_single_kph 0.0 300.0 /end CHARACTERISTIC
/begin CHARACTERISTIC KTQD_CreepEnableSpd_kph "" VALUE 0x0000 /* @ECU_Address@KTQD_CreepEnableSpd_kph@ */ Scalar_FLOAT32_IEEE 0 SWC_FDC_type_CM_single_kph 0.0 300.0 /end CHARACTERISTIC
/begin CHARACTERISTIC KTQD_CreepLowLimitTq_Nm "" VALUE 0x0000 /* @ECU_Address@KTQD_CreepLowLimitTq_Nm@ */ Scalar_FLOAT32_IEEE 0 SWC_FDC_type_CM_single_Nm -100000.0 0.0 /end CHARACTERISTIC
/begin CHARACTERISTIC KTQD_CreepPrLoadEnSpd_kph "" VALUE 0x0000 /* @ECU_Address@KTQD_CreepPrLoadEnSpd_kph@ */ Scalar_FLOAT32_IEEE 0 SWC_FDC_type_CM_single_kph 0.0 300.0 /end CHARACTERISTIC
/begin CHARACTERISTIC KTQD_CreepUpLimitTq_Nm "" VALUE 0x0000 /* @ECU_Address@KTQD_CreepUpLimitTq_Nm@ */ Scalar_FLOAT32_IEEE 0 SWC_FDC_type_CM_single_Nm 0.0 100000.0 /end CHARACTERISTIC
/begin CHARACTERISTIC KTQD_DrivProtEnToNTq_Nm "" VALUE 0x0000 /* @ECU_Address@KTQD_DrivProtEnToNTq_Nm@ */ Scalar_FLOAT32_IEEE 0 SWC_FDC_type_CM_single_Nm -100.0 500.0 /end CHARACTERISTIC
/begin CHARACTERISTIC KTQD_DriveProtDetTime_s "" VALUE 0x0000 /* @ECU_Address@KTQD_DriveProtDetTime_s@ */ Scalar_FLOAT32_IEEE 0 SWC_FDC_type_CM_single_s 0.0 3600.0 /end CHARACTERISTIC
/begin CHARACTERISTIC KTQD_DriverTqDemN_Nm "" VALUE 0x0000 /* @ECU_Address@KTQD_DriverTqDemN_Nm@ */ Scalar_FLOAT32_IEEE 0 SWC_FDC_type_CM_single_Nm -100000.0 100000.0 /end CHARACTERISTIC
/begin CHARACTERISTIC KTQD_EmergBrkLongAccel_Gps "" VALUE 0x0000 /* @ECU_Address@KTQD_EmergBrkLongAccel_Gps@ */ Scalar_FLOAT32_IEEE 0 SWC_FDC_type_CM_single_Gps -10.0 10.0 /end CHARACTERISTIC
/begin CHARACTERISTIC KTQD_EmergBrkSpd_kph "" VALUE 0x0000 /* @ECU_Address@KTQD_EmergBrkSpd_kph@ */ Scalar_FLOAT32_IEEE 0 SWC_FDC_type_CM_single_kph 0.0 300.0 /end CHARACTERISTIC
/begin CHARACTERISTIC KTQD_EscModeTqLimAccCon_Gps "" VALUE 0x0000 /* @ECU_Address@KTQD_EscModeTqLimAccCon_Gps@ */ Scalar_FLOAT32_IEEE 0 SWC_FDC_type_CM_single_Gps -0.1 2.0 /end CHARACTERISTIC
/begin CHARACTERISTIC KTQD_EstDelayEnTime_s "" VALUE 0x0000 /* @ECU_Address@KTQD_EstDelayEnTime_s@ */ Scalar_FLOAT32_IEEE 0 SWC_FDC_type_CM_single_s 0.0 60.0 /end CHARACTERISTIC
/begin CHARACTERISTIC KTQD_EstEndDelayTime_s "" VALUE 0x0000 /* @ECU_Address@KTQD_EstEndDelayTime_s@ */ Scalar_FLOAT32_IEEE 0 SWC_FDC_type_CM_single_s 0.0 60.0 /end CHARACTERISTIC
/begin CHARACTERISTIC KTQD_EstWeighResetTime_s "" VALUE 0x0000 /* @ECU_Address@KTQD_EstWeighResetTime_s@ */ Scalar_FLOAT32_IEEE 0 SWC_FDC_type_CM_single_s 0.0 10000.0 /end CHARACTERISTIC
/begin CHARACTERISTIC KTQD_FrMotorTempHigh_C "" VALUE 0x0000 /* @ECU_Address@KTQD_FrMotorTempHigh_C@ */ Scalar_FLOAT32_IEEE 0 SWC_FDC_type_CM_single_C -100.0 300.0 /end CHARACTERISTIC
/begin CHARACTERISTIC KTQD_FrMotorTempLow_C "" VALUE 0x0000 /* @ECU_Address@KTQD_FrMotorTempLow_C@ */ Scalar_FLOAT32_IEEE 0 SWC_FDC_type_CM_single_C -100.0 300.0 /end CHARACTERISTIC
/begin CHARACTERISTIC KTQD_FrTqDeviation_Nm "" VALUE 0x0000 /* @ECU_Address@KTQD_FrTqDeviation_Nm@ */ Scalar_FLOAT32_IEEE 0 SWC_FDC_type_CM_single_Nm 0.0 500.0 /end CHARACTERISTIC
/begin CHARACTERISTIC KTQD_GRADE_Deg_ovrdval "" VALUE 0x0000 /* @ECU_Address@KTQD_GRADE_Deg_ovrdval@ */ Scalar_FLOAT32_IEEE 0 SWC_FDC_type_CM_single_flg -180.0 180.0 /end CHARACTERISTIC
/begin CHARACTERISTIC KTQD_LoSPdBrkRlsTime_s "" VALUE 0x0000 /* @ECU_Address@KTQD_LoSPdBrkRlsTime_s@ */ Scalar_FLOAT32_IEEE 0 SWC_FDC_type_CM_single_s 0.0 3600.0 /end CHARACTERISTIC
/begin CHARACTERISTIC KTQD_LoSpdBrkRlsSpd_kph "" VALUE 0x0000 /* @ECU_Address@KTQD_LoSpdBrkRlsSpd_kph@ */ Scalar_FLOAT32_IEEE 0 SWC_FDC_type_CM_single_kph 0.0 300.0 /end CHARACTERISTIC
/begin CHARACTERISTIC KTQD_LoSpdCtrlBrkPos_pct "" VALUE 0x0000 /* @ECU_Address@KTQD_LoSpdCtrlBrkPos_pct@ */ Scalar_FLOAT32_IEEE 0 SWC_FDC_type_CM_single_pct 0.0 125.0 /end CHARACTERISTIC
/begin CHARACTERISTIC KTQD_LowSkipDisCreepDelay_s "" VALUE 0x0000 /* @ECU_Address@KTQD_LowSkipDisCreepDelay_s@ */ Scalar_FLOAT32_IEEE 0 SWC_FDC_type_CM_single_s 0.0 3600.0 /end CHARACTERISTIC
/begin CHARACTERISTIC KTQD_OPDCreepDUpLimitTq_Nm "" VALUE 0x0000 /* @ECU_Address@KTQD_OPDCreepDUpLimitTq_Nm@ */ Scalar_FLOAT32_IEEE 0 SWC_FDC_type_CM_single_Nm -100000.0 100000.0 /end CHARACTERISTIC
/begin CHARACTERISTIC KTQD_OPDCreepDisGrade_Deg "" VALUE 0x0000 /* @ECU_Address@KTQD_OPDCreepDisGrade_Deg@ */ Scalar_FLOAT32_IEEE 0 SWC_FDC_type_CM_single_deg -100.0 100.0 /end CHARACTERISTIC
/begin CHARACTERISTIC KTQD_OPDCreepEnGrade_Deg "" VALUE 0x0000 /* @ECU_Address@KTQD_OPDCreepEnGrade_Deg@ */ Scalar_FLOAT32_IEEE 0 SWC_FDC_type_CM_single_deg -100.0 100.0 /end CHARACTERISTIC
/begin CHARACTERISTIC KTQD_OPDCreepTargetSpdD_kph "" VALUE 0x0000 /* @ECU_Address@KTQD_OPDCreepTargetSpdD_kph@ */ Scalar_FLOAT32_IEEE 0 SWC_FDC_type_CM_single_kph -300.0 300.0 /end CHARACTERISTIC
/begin CHARACTERISTIC KTQD_OPDHoldAllowPark_s "" VALUE 0x0000 /* @ECU_Address@KTQD_OPDHoldAllowPark_s@ */ Scalar_FLOAT32_IEEE 0 SWC_FDC_type_CM_single_s 0.0 3600.0 /end CHARACTERISTIC
/begin CHARACTERISTIC KTQD_OPDHoldDetRevSpd_kph "" VALUE 0x0000 /* @ECU_Address@KTQD_OPDHoldDetRevSpd_kph@ */ Scalar_FLOAT32_IEEE 0 SWC_FDC_type_CM_single_kph -300.0 300.0 /end CHARACTERISTIC
/begin CHARACTERISTIC KTQD_OPDHoldDevLowLim_mps2 "" VALUE 0x0000 /* @ECU_Address@KTQD_OPDHoldDevLowLim_mps2@ */ Scalar_FLOAT32_IEEE 0 SWC_FDC_type_CM_single_mps2 -20.0 0.0 /end CHARACTERISTIC
/begin CHARACTERISTIC KTQD_OPDHoldDevUpLim_mps2 "" VALUE 0x0000 /* @ECU_Address@KTQD_OPDHoldDevUpLim_mps2@ */ Scalar_FLOAT32_IEEE 0 SWC_FDC_type_CM_single_mps2 0.0 20.0 /end CHARACTERISTIC
/begin CHARACTERISTIC KTQD_OPDHoldDownEnTime_s "" VALUE 0x0000 /* @ECU_Address@KTQD_OPDHoldDownEnTime_s@ */ Scalar_FLOAT32_IEEE 0 SWC_FDC_type_CM_single_s 0.0 250.0 /end CHARACTERISTIC
/begin CHARACTERISTIC KTQD_OPDHoldGradeDown_Deg "" VALUE 0x0000 /* @ECU_Address@KTQD_OPDHoldGradeDown_Deg@ */ Scalar_FLOAT32_IEEE 0 SWC_FDC_type_CM_single_Deg -180.0 180.0 /end CHARACTERISTIC
/begin CHARACTERISTIC KTQD_OPDHoldGradeUp_Deg "" VALUE 0x0000 /* @ECU_Address@KTQD_OPDHoldGradeUp_Deg@ */ Scalar_FLOAT32_IEEE 0 SWC_FDC_type_CM_single_Deg -180.0 180.0 /end CHARACTERISTIC
/begin CHARACTERISTIC KTQD_OPDHoldLampDelayTime_s "" VALUE 0x0000 /* @ECU_Address@KTQD_OPDHoldLampDelayTime_s@ */ Scalar_FLOAT32_IEEE 0 SWC_FDC_type_CM_single_s 0.0 2.0 /end CHARACTERISTIC
/begin CHARACTERISTIC KTQD_OPDHoldLampDisSpd_kph "" VALUE 0x0000 /* @ECU_Address@KTQD_OPDHoldLampDisSpd_kph@ */ Scalar_FLOAT32_IEEE 0 SWC_FDC_type_CM_single_kph 0.0 300.0 /end CHARACTERISTIC
/begin CHARACTERISTIC KTQD_OPDHoldLampEnSpd_kph "" VALUE 0x0000 /* @ECU_Address@KTQD_OPDHoldLampEnSpd_kph@ */ Scalar_FLOAT32_IEEE 0 SWC_FDC_type_CM_single_kph 0.0 300.0 /end CHARACTERISTIC
/begin CHARACTERISTIC KTQD_OPDHoldLiftRevSpd_kph "" VALUE 0x0000 /* @ECU_Address@KTQD_OPDHoldLiftRevSpd_kph@ */ Scalar_FLOAT32_IEEE 0 SWC_FDC_type_CM_single_kph -300.0 300.0 /end CHARACTERISTIC
/begin CHARACTERISTIC KTQD_OPDHoldPreLoadBound_Nm "" VALUE 0x0000 /* @ECU_Address@KTQD_OPDHoldPreLoadBound_Nm@ */ Scalar_FLOAT32_IEEE 0 SWC_FDC_type_CM_single_Nm -1.0 1000.0 /end CHARACTERISTIC
/begin CHARACTERISTIC KTQD_OPDHoldPreLoadTime_s "" VALUE 0x0000 /* @ECU_Address@KTQD_OPDHoldPreLoadTime_s@ */ Scalar_FLOAT32_IEEE 0 SWC_FDC_type_CM_single_s 0.0 3600.0 /end CHARACTERISTIC
/begin CHARACTERISTIC KTQD_OPDHoldRelDetSpd_kph "" VALUE 0x0000 /* @ECU_Address@KTQD_OPDHoldRelDetSpd_kph@ */ Scalar_FLOAT32_IEEE 0 SWC_FDC_type_CM_single_kph -300.0 300.0 /end CHARACTERISTIC
/begin CHARACTERISTIC KTQD_OPDHoldRelTqGain_Nm "" VALUE 0x0000 /* @ECU_Address@KTQD_OPDHoldRelTqGain_Nm@ */ Scalar_FLOAT32_IEEE 0 SWC_FDC_type_CM_single_Nm -10000.0 100000.0 /end CHARACTERISTIC
/begin CHARACTERISTIC KTQD_OPDHoldSkipDetSpd_kph "" VALUE 0x0000 /* @ECU_Address@KTQD_OPDHoldSkipDetSpd_kph@ */ Scalar_FLOAT32_IEEE 0 SWC_FDC_type_CM_single_kph -255.0 255.0 /end CHARACTERISTIC
/begin CHARACTERISTIC KTQD_PedalMapClimbLowLim_Nm "" VALUE 0x0000 /* @ECU_Address@KTQD_PedalMapClimbLowLim_Nm@ */ Scalar_FLOAT32_IEEE 0 SWC_FDC_type_CM_single_Nm -100000.0 100000.0 /end CHARACTERISTIC
/begin CHARACTERISTIC KTQD_PedalMapRDCLowLim_Nm "" VALUE 0x0000 /* @ECU_Address@KTQD_PedalMapRDCLowLim_Nm@ */ Scalar_FLOAT32_IEEE 0 SWC_FDC_type_CM_single_Nm -100000.0 100000.0 /end CHARACTERISTIC
/begin CHARACTERISTIC KTQD_PedalMapRDCUpLim_Nm "" VALUE 0x0000 /* @ECU_Address@KTQD_PedalMapRDCUpLim_Nm@ */ Scalar_FLOAT32_IEEE 0 SWC_FDC_type_CM_single_Nm -100000.0 100000.0 /end CHARACTERISTIC
/begin CHARACTERISTIC KTQD_PreLoadDisSpd_kph "" VALUE 0x0000 /* @ECU_Address@KTQD_PreLoadDisSpd_kph@ */ Scalar_FLOAT32_IEEE 0 SWC_FDC_type_CM_single_kph -300.0 300.0 /end CHARACTERISTIC
/begin CHARACTERISTIC KTQD_PreLoadTqHold_rpm "" VALUE 0x0000 /* @ECU_Address@KTQD_PreLoadTqHold_rpm@ */ Scalar_FLOAT32_IEEE 0 SWC_FDC_type_CM_single_rpm -3000.0 3000.0 /end CHARACTERISTIC
/begin CHARACTERISTIC KTQD_PreLoadTq_Nm "" VALUE 0x0000 /* @ECU_Address@KTQD_PreLoadTq_Nm@ */ Scalar_FLOAT32_IEEE 0 SWC_FDC_type_CM_single_Nm -100.0 100.0 /end CHARACTERISTIC
/begin CHARACTERISTIC KTQD_PreLoad_Holdtime_s "" VALUE 0x0000 /* @ECU_Address@KTQD_PreLoad_Holdtime_s@ */ Scalar_FLOAT32_IEEE 0 SWC_FDC_type_CM_single_s 0.0 3600.0 /end CHARACTERISTIC
/begin CHARACTERISTIC KTQD_R2DEnOPDHSpdDelayTime_s "" VALUE 0x0000 /* @ECU_Address@KTQD_R2DEnOPDHSpdDelayTime_s@ */ Scalar_FLOAT32_IEEE 0 SWC_FDC_type_CM_single_s 0.0 10.0 /end CHARACTERISTIC
/begin CHARACTERISTIC KTQD_R2DEnOPDHoldSpd_kph "" VALUE 0x0000 /* @ECU_Address@KTQD_R2DEnOPDHoldSpd_kph@ */ Scalar_FLOAT32_IEEE 0 SWC_FDC_type_CM_single_kph -10.0 300.0 /end CHARACTERISTIC
/begin CHARACTERISTIC KTQD_R2DGradeLowLim_Deg "" VALUE 0x0000 /* @ECU_Address@KTQD_R2DGradeLowLim_Deg@ */ Scalar_FLOAT32_IEEE 0 SWC_FDC_type_CM_single_deg -180.0 180.0 /end CHARACTERISTIC
/begin CHARACTERISTIC KTQD_R2DGradeUpLim_Deg "" VALUE 0x0000 /* @ECU_Address@KTQD_R2DGradeUpLim_Deg@ */ Scalar_FLOAT32_IEEE 0 SWC_FDC_type_CM_single_deg -180.0 180.0 /end CHARACTERISTIC
/begin CHARACTERISTIC KTQD_RBCCreepRecTq_Nm "" VALUE 0x0000 /* @ECU_Address@KTQD_RBCCreepRecTq_Nm@ */ Scalar_FLOAT32_IEEE 0 SWC_FDC_type_CM_single_Nm -1000.0 1000.0 /end CHARACTERISTIC
/begin CHARACTERISTIC KTQD_RPM2VehSpdTs_c "" VALUE 0x0000 /* @ECU_Address@KTQD_RPM2VehSpdTs_c@ */ Scalar_FLOAT32_IEEE 0 SWC_FDC_type_CM_single_c 0.0 1.0 /end CHARACTERISTIC
/begin CHARACTERISTIC KTQD_RegLongPLim_s "" VALUE 0x0000 /* @ECU_Address@KTQD_RegLongPLim_s@ */ Scalar_FLOAT32_IEEE 0 SWC_FDC_type_CM_single_s 0.0 10.0 /end CHARACTERISTIC
/begin CHARACTERISTIC KTQD_RegShortPLim_s "" VALUE 0x0000 /* @ECU_Address@KTQD_RegShortPLim_s@ */ Scalar_FLOAT32_IEEE 0 SWC_FDC_type_CM_single_s 0.0 10.0 /end CHARACTERISTIC
/begin CHARACTERISTIC KTQD_RegenOffSpd_kph "" VALUE 0x0000 /* @ECU_Address@KTQD_RegenOffSpd_kph@ */ Scalar_FLOAT32_IEEE 0 SWC_FDC_type_CM_single_kph 0.0 100000.0 /end CHARACTERISTIC
/begin CHARACTERISTIC KTQD_RegenOnSpd_kph "" VALUE 0x0000 /* @ECU_Address@KTQD_RegenOnSpd_kph@ */ Scalar_FLOAT32_IEEE 0 SWC_FDC_type_CM_single_kph 0.0 100000.0 /end CHARACTERISTIC
/begin CHARACTERISTIC KTQD_RgnEnLatchBrkPos_pct "" VALUE 0x0000 /* @ECU_Address@KTQD_RgnEnLatchBrkPos_pct@ */ Scalar_FLOAT32_IEEE 0 SWC_FDC_type_CM_single_pct 0.0 125.0 /end CHARACTERISTIC
/begin CHARACTERISTIC KTQD_RgnEnLatchSlope_Deg "" VALUE 0x0000 /* @ECU_Address@KTQD_RgnEnLatchSlope_Deg@ */ Scalar_FLOAT32_IEEE 0 SWC_FDC_type_CM_single_Deg -180.0 180.0 /end CHARACTERISTIC
/begin CHARACTERISTIC KTQD_RrEDUTqDistrictMax_gain "" VALUE 0x0000 /* @ECU_Address@KTQD_RrEDUTqDistrictMax_gain@ */ Scalar_FLOAT32_IEEE 0 SWC_FDC_type_CM_single_gain 0.0 1.0 /end CHARACTERISTIC
/begin CHARACTERISTIC KTQD_RrEDUTqDistrictMin_gain "" VALUE 0x0000 /* @ECU_Address@KTQD_RrEDUTqDistrictMin_gain@ */ Scalar_FLOAT32_IEEE 0 SWC_FDC_type_CM_single_gain 0.0 1.0 /end CHARACTERISTIC
/begin CHARACTERISTIC KTQD_RrMotorTempHigh_C "" VALUE 0x0000 /* @ECU_Address@KTQD_RrMotorTempHigh_C@ */ Scalar_FLOAT32_IEEE 0 SWC_FDC_type_CM_single_C -100.0 300.0 /end CHARACTERISTIC
/begin CHARACTERISTIC KTQD_RrMotorTempLow_C "" VALUE 0x0000 /* @ECU_Address@KTQD_RrMotorTempLow_C@ */ Scalar_FLOAT32_IEEE 0 SWC_FDC_type_CM_single_C -100.0 300.0 /end CHARACTERISTIC
/begin CHARACTERISTIC KTQD_RrTqDeviation_Nm "" VALUE 0x0000 /* @ECU_Address@KTQD_RrTqDeviation_Nm@ */ Scalar_FLOAT32_IEEE 0 SWC_FDC_type_CM_single_Nm 0.0 500.0 /end CHARACTERISTIC
/begin CHARACTERISTIC KTQD_SkipRecOPDHoldDelay_s "" VALUE 0x0000 /* @ECU_Address@KTQD_SkipRecOPDHoldDelay_s@ */ Scalar_FLOAT32_IEEE 0 SWC_FDC_type_CM_single_s 0.0 3600.0 /end CHARACTERISTIC
/begin CHARACTERISTIC KTQD_SlideRateDevLowLim_pct "" VALUE 0x0000 /* @ECU_Address@KTQD_SlideRateDevLowLim_pct@ */ Scalar_FLOAT32_IEEE 0 SWC_FDC_type_CM_single_pct -125.0 125.0 /end CHARACTERISTIC
/begin CHARACTERISTIC KTQD_SlideRateDevUpLim_pct "" VALUE 0x0000 /* @ECU_Address@KTQD_SlideRateDevUpLim_pct@ */ Scalar_FLOAT32_IEEE 0 SWC_FDC_type_CM_single_pct -125.0 125.0 /end CHARACTERISTIC
/begin CHARACTERISTIC KTQD_SlideRegEnLimitTq_Nm "" VALUE 0x0000 /* @ECU_Address@KTQD_SlideRegEnLimitTq_Nm@ */ Scalar_FLOAT32_IEEE 0 SWC_FDC_type_CM_single_Nm -100000.0 100000.0 /end CHARACTERISTIC
/begin CHARACTERISTIC KTQD_SlideRegenLowLim_Nm "" VALUE 0x0000 /* @ECU_Address@KTQD_SlideRegenLowLim_Nm@ */ Scalar_FLOAT32_IEEE 0 SWC_FDC_type_CM_single_Nm -100000.0 100000.0 /end CHARACTERISTIC
/begin CHARACTERISTIC KTQD_SpdCtrlModeChgHoldTime_s "" VALUE 0x0000 /* @ECU_Address@KTQD_SpdCtrlModeChgHoldTime_s@ */ Scalar_FLOAT32_IEEE 0 SWC_FDC_type_CM_single_s 0.0 10.0 /end CHARACTERISTIC
/begin CHARACTERISTIC KTQD_SpdModeLongPCancelLim_s "" VALUE 0x0000 /* @ECU_Address@KTQD_SpdModeLongPCancelLim_s@ */ Scalar_FLOAT32_IEEE 0 SWC_FDC_type_CM_single_s 0.0 10.0 /end CHARACTERISTIC
/begin CHARACTERISTIC KTQD_SpdModeLongPLim_s "" VALUE 0x0000 /* @ECU_Address@KTQD_SpdModeLongPLim_s@ */ Scalar_FLOAT32_IEEE 0 SWC_FDC_type_CM_single_s 0.0 10.0 /end CHARACTERISTIC
/begin CHARACTERISTIC KTQD_SpdModeShortPLim_s "" VALUE 0x0000 /* @ECU_Address@KTQD_SpdModeShortPLim_s@ */ Scalar_FLOAT32_IEEE 0 SWC_FDC_type_CM_single_s 0.0 10.0 /end CHARACTERISTIC
/begin CHARACTERISTIC KTQD_TargetSlideRate_pct "" VALUE 0x0000 /* @ECU_Address@KTQD_TargetSlideRate_pct@ */ Scalar_FLOAT32_IEEE 0 SWC_FDC_type_CM_single_pct -125.0 125.0 /end CHARACTERISTIC
/begin CHARACTERISTIC KTQD_TireRadius_m "" VALUE 0x0000 /* @ECU_Address@KTQD_TireRadius_m@ */ Scalar_FLOAT32_IEEE 0 SWC_FDC_type_CM_single_m 0.0 100.0 /end CHARACTERISTIC
/begin CHARACTERISTIC KTQD_Veh2MetSpdAdd_kph "" VALUE 0x0000 /* @ECU_Address@KTQD_Veh2MetSpdAdd_kph@ */ Scalar_FLOAT32_IEEE 0 SWC_FDC_type_CM_single_kph 0.0 300.0 /end CHARACTERISTIC
/begin CHARACTERISTIC KTQD_Veh2MetSpdGain_c "" VALUE 0x0000 /* @ECU_Address@KTQD_Veh2MetSpdGain_c@ */ Scalar_FLOAT32_IEEE 0 SWC_FDC_type_CM_single_c 0.0 20.0 /end CHARACTERISTIC
/begin CHARACTERISTIC KTQD_VehActSpdNegGain_gain "" VALUE 0x0000 /* @ECU_Address@KTQD_VehActSpdNegGain_gain@ */ Scalar_FLOAT32_IEEE 0 SWC_FDC_type_CM_single_gain -1.0 0.0 /end CHARACTERISTIC
/begin CHARACTERISTIC KTQD_VehActSpdPosGain_gain "" VALUE 0x0000 /* @ECU_Address@KTQD_VehActSpdPosGain_gain@ */ Scalar_FLOAT32_IEEE 0 SWC_FDC_type_CM_single_gain 0.0 1.0 /end CHARACTERISTIC
/begin CHARACTERISTIC KTQD_VehWeighEstTime_s "" VALUE 0x0000 /* @ECU_Address@KTQD_VehWeighEstTime_s@ */ Scalar_FLOAT32_IEEE 0 SWC_FDC_type_CM_single_s 0.0 60.0 /end CHARACTERISTIC
/begin CHARACTERISTIC KTQD_VehWeightEstGradeEn_Deg "" VALUE 0x0000 /* @ECU_Address@KTQD_VehWeightEstGradeEn_Deg@ */ Scalar_FLOAT32_IEEE 0 SWC_FDC_type_CM_single_Deg 0.0 30.0 /end CHARACTERISTIC
/begin CHARACTERISTIC KTQD_VehWeightEstSpdEnLow_kph "" VALUE 0x0000 /* @ECU_Address@KTQD_VehWeightEstSpdEnLow_kph@ */ Scalar_FLOAT32_IEEE 0 SWC_FDC_type_CM_single_kph 0.0 300.0 /end CHARACTERISTIC
/begin CHARACTERISTIC KTQD_VehWeightEstSpdEnUp_kph "" VALUE 0x0000 /* @ECU_Address@KTQD_VehWeightEstSpdEnUp_kph@ */ Scalar_FLOAT32_IEEE 0 SWC_FDC_type_CM_single_kph 0.0 300.0 /end CHARACTERISTIC
/begin CHARACTERISTIC KTQR_ARegenLatchEnTq_Nm "" VALUE 0x0000 /* @ECU_Address@KTQR_ARegenLatchEnTq_Nm@ */ Scalar_FLOAT32_IEEE 0 SWC_FDC_type_CM_single_Nm -100000.0 100000.0 /end CHARACTERISTIC
/begin CHARACTERISTIC KTQR_DriveModeCMDTqDev_Nm "" VALUE 0x0000 /* @ECU_Address@KTQR_DriveModeCMDTqDev_Nm@ */ Scalar_FLOAT32_IEEE 0 SWC_FDC_type_CM_single_Nm 0.0 1000.0 /end CHARACTERISTIC
/begin CHARACTERISTIC KTQR_DriveModeChangeTq_Nm "" VALUE 0x0000 /* @ECU_Address@KTQR_DriveModeChangeTq_Nm@ */ Scalar_FLOAT32_IEEE 0 SWC_FDC_type_CM_single_Nm 0.0 1000.0 /end CHARACTERISTIC
/begin CHARACTERISTIC KTQR_OPDNoZeroTransSpd_kph "" VALUE 0x0000 /* @ECU_Address@KTQR_OPDNoZeroTransSpd_kph@ */ Scalar_FLOAT32_IEEE 0 SWC_FDC_type_CM_single_kph -10.0 300.0 /end CHARACTERISTIC
/begin CHARACTERISTIC KTQR_OPDNoZeroTransTq_Nm "" VALUE 0x0000 /* @ECU_Address@KTQR_OPDNoZeroTransTq_Nm@ */ Scalar_FLOAT32_IEEE 0 SWC_FDC_type_CM_single_Nm -100000.0 100000.0 /end CHARACTERISTIC
/begin CHARACTERISTIC KTQR_PreLoadPreEnTs_c "" VALUE 0x0000 /* @ECU_Address@KTQR_PreLoadPreEnTs_c@ */ Scalar_FLOAT32_IEEE 0 SWC_FDC_type_CM_single_c 0.0 1.0 /end CHARACTERISTIC
/begin CHARACTERISTIC KTQR_PreLoadTs_c "" VALUE 0x0000 /* @ECU_Address@KTQR_PreLoadTs_c@ */ Scalar_FLOAT32_IEEE 0 SWC_FDC_type_CM_single_c 0.0 1.0 /end CHARACTERISTIC
/begin CHARACTERISTIC KTQR_TIPOutTsAPS_pct "" VALUE 0x0000 /* @ECU_Address@KTQR_TIPOutTsAPS_pct@ */ Scalar_FLOAT32_IEEE 0 SWC_FDC_type_CM_single_pct 0.0 120.0 /end CHARACTERISTIC
/begin CHARACTERISTIC KTQR_TIPOutTsSpd_kph "" VALUE 0x0000 /* @ECU_Address@KTQR_TIPOutTsSpd_kph@ */ Scalar_FLOAT32_IEEE 0 SWC_FDC_type_CM_single_kph 0.0 255.0 /end CHARACTERISTIC
/begin CHARACTERISTIC KVMC_4WhlSlideVehSpdDev_kph "" VALUE 0x0000 /* @ECU_Address@KVMC_4WhlSlideVehSpdDev_kph@ */ Scalar_FLOAT32_IEEE 0 SWC_FDC_type_CM_single_kph 0.0 300.0 /end CHARACTERISTIC
/begin CHARACTERISTIC KVMC_4WhleelSlideDetTime_s "" VALUE 0x0000 /* @ECU_Address@KVMC_4WhleelSlideDetTime_s@ */ Scalar_FLOAT32_IEEE 0 SWC_FDC_type_CM_single_s 0.0 3600.0 /end CHARACTERISTIC
/begin CHARACTERISTIC KVMC_CalWhleelSlideTs_c "" VALUE 0x0000 /* @ECU_Address@KVMC_CalWhleelSlideTs_c@ */ Scalar_FLOAT32_IEEE 0 SWC_FDC_type_CM_single_c 0.0 1.0 /end CHARACTERISTIC
/begin CHARACTERISTIC KVMC_OPDDisSlideRateSpd_kph "" VALUE 0x0000 /* @ECU_Address@KVMC_OPDDisSlideRateSpd_kph@ */ Scalar_FLOAT32_IEEE 0 SWC_FDC_type_CM_single_kph -300.0 300.0 /end CHARACTERISTIC
/begin CHARACTERISTIC KVMC_RawWhlSpeedDeadZone_kph "" VALUE 0x0000 /* @ECU_Address@KVMC_RawWhlSpeedDeadZone_kph@ */ Scalar_FLOAT32_IEEE 0 SWC_FDC_type_CM_single_kph 0.0 300.0 /end CHARACTERISTIC
/begin CHARACTERISTIC KVMC_SafetyCtrlAllowTime_s "" VALUE 0x0000 /* @ECU_Address@KVMC_SafetyCtrlAllowTime_s@ */ Scalar_FLOAT32_IEEE 0 SWC_FDC_type_CM_single_sec 0.0 10.0 /end CHARACTERISTIC
/begin CHARACTERISTIC KVMC_WhlSlideEnDetBrkPedal_pct "" VALUE 0x0000 /* @ECU_Address@KVMC_WhlSlideEnDetBrkPedal_pct@ */ Scalar_FLOAT32_IEEE 0 SWC_FDC_type_CM_single_pct 0.0 125.0 /end CHARACTERISTIC
/begin CHARACTERISTIC KVMC_WhlSlideEnDetTq_Nm "" VALUE 0x0000 /* @ECU_Address@KVMC_WhlSlideEnDetTq_Nm@ */ Scalar_FLOAT32_IEEE 0 SWC_FDC_type_CM_single_Nm -100000.0 100000.0 /end CHARACTERISTIC
/begin CHARACTERISTIC KVMC_WhlSlideEnDetVehSpd_kph "" VALUE 0x0000 /* @ECU_Address@KVMC_WhlSlideEnDetVehSpd_kph@ */ Scalar_FLOAT32_IEEE 0 SWC_FDC_type_CM_single_kph 0.0 300.0 /end CHARACTERISTIC
/begin CHARACTERISTIC KTHC_APTCRiLeMaxDff_W "" VALUE 0x0000 /* @ECU_Address@KTHC_APTCRiLeMaxDff_W@ */ Scalar_SWORD 0 SWC_FDC_type_CM_int16_W 0.0 2200.0 /end CHARACTERISTIC
/begin CHARACTERISTIC KTHC_APTCRiLeMinDff_W "" VALUE 0x0000 /* @ECU_Address@KTHC_APTCRiLeMinDff_W@ */ Scalar_SWORD 0 SWC_FDC_type_CM_int16_W -2200.0 0.0 /end CHARACTERISTIC
/begin CHARACTERISTIC KTHC_APTCOneZoneMax_W "" VALUE 0x0000 /* @ECU_Address@KTHC_APTCOneZoneMax_W@ */ Scalar_UWORD 0 SWC_FDC_type_CM_uint16_W 0.0 6500.0 /end CHARACTERISTIC
/begin CHARACTERISTIC KTHC_APTCPeriod_cnt "" VALUE 0x0000 /* @ECU_Address@KTHC_APTCPeriod_cnt@ */ Scalar_UWORD 0 SWC_FDC_type_CM_uint16_cnt 0.0 65535.0 /end CHARACTERISTIC
/begin CHARACTERISTIC KTHC_EWPErrorT_cnt "" VALUE 0x0000 /* @ECU_Address@KTHC_EWPErrorT_cnt@ */ Scalar_UWORD 0 SWC_FDC_type_CM_uint16_cnt 0.0 65535.0 /end CHARACTERISTIC
/begin CHARACTERISTIC KTHC_EWPRetryWarnT_cnt "" VALUE 0x0000 /* @ECU_Address@KTHC_EWPRetryWarnT_cnt@ */ Scalar_UWORD 0 SWC_FDC_type_CM_uint16_cnt 0.0 65535.0 /end CHARACTERISTIC
/begin CHARACTERISTIC KTHC_EWPTotalRetryT_cnt "" VALUE 0x0000 /* @ECU_Address@KTHC_EWPTotalRetryT_cnt@ */ Scalar_UWORD 0 SWC_FDC_type_CM_uint16_cnt 0.0 65535.0 /end CHARACTERISTIC
/begin CHARACTERISTIC KTHC_EWPpauseT_cnt "" VALUE 0x0000 /* @ECU_Address@KTHC_EWPpauseT_cnt@ */ Scalar_UWORD 0 SWC_FDC_type_CM_uint16_cnt 0.0 65535.0 /end CHARACTERISTIC
/begin CHARACTERISTIC KTHC_EWPretryT_cnt "" VALUE 0x0000 /* @ECU_Address@KTHC_EWPretryT_cnt@ */ Scalar_UWORD 0 SWC_FDC_type_CM_uint16_cnt 0.0 65535.0 /end CHARACTERISTIC
/begin CHARACTERISTIC KTHC_EWPErrHandleEN_flg "" VALUE 0x0000 /* @ECU_Address@KTHC_EWPErrHandleEN_flg@ */ Scalar_BOOLEAN 0 SWC_FDC_type_CM_boolean_flg 0.0 1.0 /end CHARACTERISTIC
/begin CHARACTERISTIC KTQD_ACCOvrdCancelTqCtrl_flg "" VALUE 0x0000 /* @ECU_Address@KTQD_ACCOvrdCancelTqCtrl_flg@ */ Scalar_BOOLEAN 0 SWC_FDC_type_CM_boolean_flg 0.0 1.0 /end CHARACTERISTIC
/begin CHARACTERISTIC KTQD_APSDecReqMaxSW_flg "" VALUE 0x0000 /* @ECU_Address@KTQD_APSDecReqMaxSW_flg@ */ Scalar_BOOLEAN 0 SWC_FDC_type_CM_boolean_flg 0.0 1.0 /end CHARACTERISTIC
/begin CHARACTERISTIC KTQD_APSReqDisCreep_flg "" VALUE 0x0000 /* @ECU_Address@KTQD_APSReqDisCreep_flg@ */ Scalar_BOOLEAN 0 SWC_FDC_type_CM_boolean_flg 0.0 1.0 /end CHARACTERISTIC
/begin CHARACTERISTIC KTQD_AWDFrRatio_rat_ovrdflg "" VALUE 0x0000 /* @ECU_Address@KTQD_AWDFrRatio_rat_ovrdflg@ */ Scalar_BOOLEAN 0 SWC_FDC_type_CM_boolean_flg 0.0 1.0 /end CHARACTERISTIC
/begin CHARACTERISTIC KTQD_AWDRrRatio_rat_ovrdflg "" VALUE 0x0000 /* @ECU_Address@KTQD_AWDRrRatio_rat_ovrdflg@ */ Scalar_BOOLEAN 0 SWC_FDC_type_CM_boolean_flg 0.0 1.0 /end CHARACTERISTIC
/begin CHARACTERISTIC KTQD_CreepVehSpdSW_flg "" VALUE 0x0000 /* @ECU_Address@KTQD_CreepVehSpdSW_flg@ */ Scalar_BOOLEAN 0 SWC_FDC_type_CM_boolean_flg 0.0 1.0 /end CHARACTERISTIC
/begin CHARACTERISTIC KTQD_CreepWhlRatioSW_flg "" VALUE 0x0000 /* @ECU_Address@KTQD_CreepWhlRatioSW_flg@ */ Scalar_BOOLEAN 0 SWC_FDC_type_CM_boolean_flg 0.0 1.0 /end CHARACTERISTIC
/begin CHARACTERISTIC KTQD_DrivProtEnSW_flg "" VALUE 0x0000 /* @ECU_Address@KTQD_DrivProtEnSW_flg@ */ Scalar_BOOLEAN 0 SWC_FDC_type_CM_boolean_flg 0.0 1.0 /end CHARACTERISTIC
/begin CHARACTERISTIC KTQD_GRADE_Deg_ovrdflg "" VALUE 0x0000 /* @ECU_Address@KTQD_GRADE_Deg_ovrdflg@ */ Scalar_BOOLEAN 0 SWC_FDC_type_CM_boolean_flg 0.0 1.0 /end CHARACTERISTIC
/begin CHARACTERISTIC KTQD_OPDHoldAllowPark_flg "" VALUE 0x0000 /* @ECU_Address@KTQD_OPDHoldAllowPark_flg@ */ Scalar_BOOLEAN 0 SWC_FDC_type_CM_boolean_flg 0.0 1.0 /end CHARACTERISTIC
/begin CHARACTERISTIC KTQD_OPDHoldBrkSW_flg "" VALUE 0x0000 /* @ECU_Address@KTQD_OPDHoldBrkSW_flg@ */ Scalar_BOOLEAN 0 SWC_FDC_type_CM_boolean_flg 0.0 1.0 /end CHARACTERISTIC
/begin CHARACTERISTIC KTQD_OrigPedTqLowLimSW_flg "" VALUE 0x0000 /* @ECU_Address@KTQD_OrigPedTqLowLimSW_flg@ */ Scalar_BOOLEAN 0 SWC_FDC_type_CM_boolean_flg 0.0 1.0 /end CHARACTERISTIC
/begin CHARACTERISTIC KTQD_SCPMemSpdTest_flg "" VALUE 0x0000 /* @ECU_Address@KTQD_SCPMemSpdTest_flg@ */ Scalar_BOOLEAN 0 SWC_FDC_type_CM_boolean 0.0 1.0 /end CHARACTERISTIC
/begin CHARACTERISTIC KTQD_SpdLimOffsetOn_flg "" VALUE 0x0000 /* @ECU_Address@KTQD_SpdLimOffsetOn_flg@ */ Scalar_BOOLEAN 0 SWC_FDC_type_CM_boolean_flg 0.0 1.0 /end CHARACTERISTIC
/begin CHARACTERISTIC KTQR_CreepZeroTransSW_flg "" VALUE 0x0000 /* @ECU_Address@KTQR_CreepZeroTransSW_flg@ */ Scalar_BOOLEAN 0 SWC_FDC_type_CM_boolean_flg 0.0 1.0 /end CHARACTERISTIC
/begin CHARACTERISTIC KVMC_4WheelLongAccSW_flg "" VALUE 0x0000 /* @ECU_Address@KVMC_4WheelLongAccSW_flg@ */ Scalar_BOOLEAN 0 SWC_FDC_type_CM_boolean_flg 0.0 1.0 /end CHARACTERISTIC
/begin CHARACTERISTIC KVMC_AltWheelSlideRateSW_flg "" VALUE 0x0000 /* @ECU_Address@KVMC_AltWheelSlideRateSW_flg@ */ Scalar_BOOLEAN 0 SWC_FDC_type_CM_boolean_flg 0.0 1.0 /end CHARACTERISTIC
/begin CHARACTERISTIC KVMC_MSAResponseAGSV_flg "" VALUE 0x0000 /* @ECU_Address@KVMC_MSAResponseAGSV_flg@ */ Scalar_BOOLEAN 0 SWC_FDC_type_CM_boolean_flg 0.0 1.0 /end CHARACTERISTIC
/begin CHARACTERISTIC KTQD_ACCActiveMetSpdLoMPH_mph "" VALUE 0x0000 /* @ECU_Address@KTQD_ACCActiveMetSpdLoMPH_mph@ */ Scalar_UBYTE 0 SWC_FDC_type_CM_uint8_kph 0.0 250.0 /end CHARACTERISTIC
/begin CHARACTERISTIC KTQD_ACCActiveMetSpdLo_kph "" VALUE 0x0000 /* @ECU_Address@KTQD_ACCActiveMetSpdLo_kph@ */ Scalar_UBYTE 0 SWC_FDC_type_CM_uint8_kph 0.0 250.0 /end CHARACTERISTIC
/begin CHARACTERISTIC KTQD_SetSpdDeltaLongFit_kph "" VALUE 0x0000 /* @ECU_Address@KTQD_SetSpdDeltaLongFit_kph@ */ Scalar_UBYTE 0 SWC_FDC_type_CM_uint8_kph 0.0 255.0 /end CHARACTERISTIC
/begin CHARACTERISTIC KTQD_SmartEcoLimitSpd_kph "" VALUE 0x0000 /* @ECU_Address@KTQD_SmartEcoLimitSpd_kph@ */ Scalar_UBYTE 0 SWC_FDC_type_CM_uint8_kph 0.0 255.0 /end CHARACTERISTIC
/begin CHARACTERISTIC KTQD_SmartEcoLimitSpd_mph "" VALUE 0x0000 /* @ECU_Address@KTQD_SmartEcoLimitSpd_mph@ */ Scalar_UBYTE 0 SWC_FDC_type_CM_uint8_mph 0.0 255.0 /end CHARACTERISTIC
/begin CHARACTERISTIC KVMC_LatAccRollAveLevel_enum "" VALUE 0x0000 /* @ECU_Address@KVMC_LatAccRollAveLevel_enum@ */ Scalar_UBYTE 0 SWC_FDC_type_CM_uint8_enum 1.0 100.0 /end CHARACTERISTIC
/begin CHARACTERISTIC KVMC_VehSpdRollAveLevel_enum "" VALUE 0x0000 /* @ECU_Address@KVMC_VehSpdRollAveLevel_enum@ */ Scalar_UBYTE 0 SWC_FDC_type_CM_uint8_enum 1.0 100.0 /end CHARACTERISTIC
/begin CHARACTERISTIC KVMC_WhlSpdRollAveLevel_enum "" VALUE 0x0000 /* @ECU_Address@KVMC_WhlSpdRollAveLevel_enum@ */ Scalar_UBYTE 0 SWC_FDC_type_CM_uint8_enum 1.0 100.0 /end CHARACTERISTIC
/begin MEASUREMENT VTPM_LFWheelTemp_C "" FLOAT32_IEEE SWC_FDC_type_CM_single_C 0 0 -40.0 215.0 ECU_ADDRESS 0x0000 /* @ECU_Address@VTPM_LFWheelTemp_C@ */ /end MEASUREMENT
/begin MEASUREMENT VTPM_RFWheelTemp_C "" FLOAT32_IEEE SWC_FDC_type_CM_single_C 0 0 -40.0 215.0 ECU_ADDRESS 0x0000 /* @ECU_Address@VTPM_RFWheelTemp_C@ */ /end MEASUREMENT
/begin MEASUREMENT VTPM_LRWheelTemp_C "" FLOAT32_IEEE SWC_FDC_type_CM_single_C 0 0 -40.0 215.0 ECU_ADDRESS 0x0000 /* @ECU_Address@VTPM_LRWheelTemp_C@ */ /end MEASUREMENT
/begin MEASUREMENT VTPM_RRWheelTemp_C "" FLOAT32_IEEE SWC_FDC_type_CM_single_C 0 0 -40.0 215.0 ECU_ADDRESS 0x0000 /* @ECU_Address@VTPM_RRWheelTemp_C@ */ /end MEASUREMENT
/begin MEASUREMENT VVMC_SoftJerkPCT_pct "" FLOAT32_IEEE SWC_FDC_type_CM_single_pct 0 0 0.0 100.0 ECU_ADDRESS 0x0000 /* @ECU_Address@VVMC_SoftJerkPCT_pct@ */ /end MEASUREMENT
/begin MEASUREMENT VVMC_AggressJerkPCT_pct "" FLOAT32_IEEE SWC_FDC_type_CM_single_pct 0 0 0.0 100.0 ECU_ADDRESS 0x0000 /* @ECU_Address@VVMC_AggressJerkPCT_pct@ */ /end MEASUREMENT
/begin MEASUREMENT VVMC_SoftLimitPCT_pct "" FLOAT32_IEEE SWC_FDC_type_CM_single_pct 0 0 0.0 100.0 ECU_ADDRESS 0x0000 /* @ECU_Address@VVMC_SoftLimitPCT_pct@ */ /end MEASUREMENT
/begin MEASUREMENT VVMC_AggressLimitPCT_pct "" FLOAT32_IEEE SWC_FDC_type_CM_single_pct 0 0 0.0 100.0 ECU_ADDRESS 0x0000 /* @ECU_Address@VVMC_AggressLimitPCT_pct@ */ /end MEASUREMENT
/begin MEASUREMENT VVMC_MaxRawWhlSpeed_kph "" FLOAT32_IEEE SWC_FDC_type_CM_single_kph 0 0 0.0 300.0 ECU_ADDRESS 0x0000 /* @ECU_Address@VVMC_MaxRawWhlSpeed_kph@ */ /end MEASUREMENT
/begin MEASUREMENT VVMC_MinRawWhlSpeed_kph "" FLOAT32_IEEE SWC_FDC_type_CM_single_kph 0 0 0.0 300.0 ECU_ADDRESS 0x0000 /* @ECU_Address@VVMC_MinRawWhlSpeed_kph@ */ /end MEASUREMENT
/begin MEASUREMENT VVMC_RawCalWhlSpdSlideRate_pct "" FLOAT32_IEEE SWC_FDC_type_CM_single_pct 0 0 0.0 125.0 ECU_ADDRESS 0x0000 /* @ECU_Address@VVMC_RawCalWhlSpdSlideRate_pct@ */ /end MEASUREMENT
/begin MEASUREMENT VVMC_RawWhlSpdSlideRate_pct "" FLOAT32_IEEE SWC_FDC_type_CM_single_pct 0 0 0.0 125.0 ECU_ADDRESS 0x0000 /* @ECU_Address@VVMC_RawWhlSpdSlideRate_pct@ */ /end MEASUREMENT
/begin MEASUREMENT VVMC_LFCalWhlSpdSlideRate_pct "" FLOAT32_IEEE SWC_FDC_type_CM_single_pct 0 0 0.0 125.0 ECU_ADDRESS 0x0000 /* @ECU_Address@VVMC_LFCalWhlSpdSlideRate_pct@ */ /end MEASUREMENT
/begin MEASUREMENT VVMC_LFWhlSpdSlideRate_pct "" FLOAT32_IEEE SWC_FDC_type_CM_single_pct 0 0 0.0 125.0 ECU_ADDRESS 0x0000 /* @ECU_Address@VVMC_LFWhlSpdSlideRate_pct@ */ /end MEASUREMENT
/begin MEASUREMENT VVMC_RFCalWhlSpdSlideRate_pct "" FLOAT32_IEEE SWC_FDC_type_CM_single_pct 0 0 0.0 125.0 ECU_ADDRESS 0x0000 /* @ECU_Address@VVMC_RFCalWhlSpdSlideRate_pct@ */ /end MEASUREMENT
/begin MEASUREMENT VVMC_RFWhlSpdSlideRate_pct "" FLOAT32_IEEE SWC_FDC_type_CM_single_pct 0 0 0.0 125.0 ECU_ADDRESS 0x0000 /* @ECU_Address@VVMC_RFWhlSpdSlideRate_pct@ */ /end MEASUREMENT
/begin MEASUREMENT VVMC_LRCalWhlSpdSlideRate_pct "" FLOAT32_IEEE SWC_FDC_type_CM_single_pct 0 0 0.0 125.0 ECU_ADDRESS 0x0000 /* @ECU_Address@VVMC_LRCalWhlSpdSlideRate_pct@ */ /end MEASUREMENT
/begin MEASUREMENT VVMC_LRWhlSpdSlideRate_pct "" FLOAT32_IEEE SWC_FDC_type_CM_single_pct 0 0 0.0 125.0 ECU_ADDRESS 0x0000 /* @ECU_Address@VVMC_LRWhlSpdSlideRate_pct@ */ /end MEASUREMENT
/begin MEASUREMENT VVMC_RRCalWhlSpdSlideRate_pct "" FLOAT32_IEEE SWC_FDC_type_CM_single_pct 0 0 0.0 125.0 ECU_ADDRESS 0x0000 /* @ECU_Address@VVMC_RRCalWhlSpdSlideRate_pct@ */ /end MEASUREMENT
/begin MEASUREMENT VVMC_RRWhlSpdSlideRate_pct "" FLOAT32_IEEE SWC_FDC_type_CM_single_pct 0 0 0.0 125.0 ECU_ADDRESS 0x0000 /* @ECU_Address@VVMC_RRWhlSpdSlideRate_pct@ */ /end MEASUREMENT
/begin MEASUREMENT VVMC_4WheelLongAcc_Gps "" FLOAT32_IEEE SWC_FDC_type_CM_single_Gps 0 0 -20.0 20.0 ECU_ADDRESS 0x0000 /* @ECU_Address@VVMC_4WheelLongAcc_Gps@ */ /end MEASUREMENT
/begin MEASUREMENT VVMC_CalAltLWhlSlideRate_pct "" FLOAT32_IEEE SWC_FDC_type_CM_single_pct 0 0 0.0 125.0 ECU_ADDRESS 0x0000 /* @ECU_Address@VVMC_CalAltLWhlSlideRate_pct@ */ /end MEASUREMENT
/begin MEASUREMENT VVMC_AltLWhlSlideRate_pct "" FLOAT32_IEEE SWC_FDC_type_CM_single_pct 0 0 0.0 125.0 ECU_ADDRESS 0x0000 /* @ECU_Address@VVMC_AltLWhlSlideRate_pct@ */ /end MEASUREMENT
/begin MEASUREMENT VVMC_CalAltRWhlSlideRate_pct "" FLOAT32_IEEE SWC_FDC_type_CM_single_pct 0 0 0.0 125.0 ECU_ADDRESS 0x0000 /* @ECU_Address@VVMC_CalAltRWhlSlideRate_pct@ */ /end MEASUREMENT
/begin MEASUREMENT VVMC_AltRWhlSlideRate_pct "" FLOAT32_IEEE SWC_FDC_type_CM_single_pct 0 0 0.0 125.0 ECU_ADDRESS 0x0000 /* @ECU_Address@VVMC_AltRWhlSlideRate_pct@ */ /end MEASUREMENT
/begin MEASUREMENT VVMC_AltWhlSlideRate_pct "" FLOAT32_IEEE SWC_FDC_type_CM_single_pct 0 0 0.0 125.0 ECU_ADDRESS 0x0000 /* @ECU_Address@VVMC_AltWhlSlideRate_pct@ */ /end MEASUREMENT
/begin MEASUREMENT VVMC_OPDDisSlideRate_pct "" FLOAT32_IEEE SWC_FDC_type_CM_single_pct 0 0 0.0 125.0 ECU_ADDRESS 0x0000 /* @ECU_Address@VVMC_OPDDisSlideRate_pct@ */ /end MEASUREMENT
/begin MEASUREMENT VVMC_ActMaxSlideRate_pct "" FLOAT32_IEEE SWC_FDC_type_CM_single_pct 0 0 0.0 125.0 ECU_ADDRESS 0x0000 /* @ECU_Address@VVMC_ActMaxSlideRate_pct@ */ /end MEASUREMENT
/begin MEASUREMENT VVMC_MeterSpdRollAve_kph "" FLOAT32_IEEE SWC_FDC_type_CM_single_kph 0 0 0.0 254.0 ECU_ADDRESS 0x0000 /* @ECU_Address@VVMC_MeterSpdRollAve_kph@ */ /end MEASUREMENT
/begin MEASUREMENT VTQR_RDCActiveFEDUTs_c "" FLOAT32_IEEE SWC_FDC_type_CM_single_c 0 0 0.0 1.0 ECU_ADDRESS 0x0000 /* @ECU_Address@VTQR_RDCActiveFEDUTs_c@ */ /end MEASUREMENT
/begin MEASUREMENT VTQR_CreepFEDUTs_c "" FLOAT32_IEEE SWC_FDC_type_CM_single_c 0 0 0.0 1.0 ECU_ADDRESS 0x0000 /* @ECU_Address@VTQR_CreepFEDUTs_c@ */ /end MEASUREMENT
/begin MEASUREMENT VTQR_VMCFEDUTs_c "" FLOAT32_IEEE SWC_FDC_type_CM_single_c 0 0 0.0 1.0 ECU_ADDRESS 0x0000 /* @ECU_Address@VTQR_VMCFEDUTs_c@ */ /end MEASUREMENT
/begin MEASUREMENT VTQR_FEDUTIPOutTs_c "" FLOAT32_IEEE SWC_FDC_type_CM_single_c 0 0 0.0 1.0 ECU_ADDRESS 0x0000 /* @ECU_Address@VTQR_FEDUTIPOutTs_c@ */ /end MEASUREMENT
/begin MEASUREMENT VTQR_FrTqZeroTransUpBound_Nm "" FLOAT32_IEEE SWC_FDC_type_CM_single_Nm 0 0 -100000.0 100000.0 ECU_ADDRESS 0x0000 /* @ECU_Address@VTQR_FrTqZeroTransUpBound_Nm@ */ /end MEASUREMENT
/begin MEASUREMENT VTQR_FrTqZeroTransLowBound_Nm "" FLOAT32_IEEE SWC_FDC_type_CM_single_Nm 0 0 -100000.0 100000.0 ECU_ADDRESS 0x0000 /* @ECU_Address@VTQR_FrTqZeroTransLowBound_Nm@ */ /end MEASUREMENT
/begin MEASUREMENT VTQR_FEDUTs_c "" FLOAT32_IEEE SWC_FDC_type_CM_single_c 0 0 0.0 1.0 ECU_ADDRESS 0x0000 /* @ECU_Address@VTQR_FEDUTs_c@ */ /end MEASUREMENT
/begin MEASUREMENT VTQR_FrFirstOrderInpTs_c "" FLOAT32_IEEE SWC_FDC_type_CM_single_c 0 0 0.0 1.0 ECU_ADDRESS 0x0000 /* @ECU_Address@VTQR_FrFirstOrderInpTs_c@ */ /end MEASUREMENT
/begin MEASUREMENT VTQR_FrFirstOrderOutTq_Nm "" FLOAT32_IEEE SWC_FDC_type_CM_single_Nm 0 0 -100000.0 100000.0 ECU_ADDRESS 0x0000 /* @ECU_Address@VTQR_FrFirstOrderOutTq_Nm@ */ /end MEASUREMENT
/begin MEASUREMENT VTQR_RrFirstOrderOutTq_Nm "" FLOAT32_IEEE SWC_FDC_type_CM_single_Nm 0 0 -100000.0 100000.0 ECU_ADDRESS 0x0000 /* @ECU_Address@VTQR_RrFirstOrderOutTq_Nm@ */ /end MEASUREMENT
/begin MEASUREMENT VTQD_VehActSpdGain_gain "" FLOAT32_IEEE SWC_FDC_type_CM_single_gain 0 0 -1.0 1.0 ECU_ADDRESS 0x0000 /* @ECU_Address@VTQD_VehActSpdGain_gain@ */ /end MEASUREMENT
/begin MEASUREMENT VTQD_VehActSpd_kph "" FLOAT32_IEEE SWC_FDC_type_CM_single_kph 0 0 -150.0 150.0 ECU_ADDRESS 0x0000 /* @ECU_Address@VTQD_VehActSpd_kph@ */ /end MEASUREMENT
/begin MEASUREMENT VTQD_CreepBaseTqR_Nm "" FLOAT32_IEEE SWC_FDC_type_CM_single_Nm 0 0 -100000.0 100000.0 ECU_ADDRESS 0x0000 /* @ECU_Address@VTQD_CreepBaseTqR_Nm@ */ /end MEASUREMENT
/begin MEASUREMENT VTQD_CreepBaseTqD_Nm "" FLOAT32_IEEE SWC_FDC_type_CM_single_Nm 0 0 -100000.0 100000.0 ECU_ADDRESS 0x0000 /* @ECU_Address@VTQD_CreepBaseTqD_Nm@ */ /end MEASUREMENT
/begin MEASUREMENT VTQD_RollingShaftSpd_rpm "" FLOAT32_IEEE SWC_FDC_type_CM_single_rpm 0 0 -100000.0 100000.0 ECU_ADDRESS 0x0000 /* @ECU_Address@VTQD_RollingShaftSpd_rpm@ */ /end MEASUREMENT
/begin MEASUREMENT VTQD_APSReqLowSpd_kph "" FLOAT32_IEEE SWC_FDC_type_CM_single_kph 0 0 -10.0 300.0 ECU_ADDRESS 0x0000 /* @ECU_Address@VTQD_APSReqLowSpd_kph@ */ /end MEASUREMENT
/begin MEASUREMENT VTQD_AutoHoldReleaseAPS_pct "" FLOAT32_IEEE SWC_FDC_type_CM_single_pct 0 0 -125.0 125.0 ECU_ADDRESS 0x0000 /* @ECU_Address@VTQD_AutoHoldReleaseAPS_pct@ */ /end MEASUREMENT
/begin MEASUREMENT VTQD_OPDHoldEnRelTq_flg "" FLOAT32_IEEE SWC_FDC_type_CM_single_flg 0 0 -100000.0 100000.0 ECU_ADDRESS 0x0000 /* @ECU_Address@VTQD_OPDHoldEnRelTq_flg@ */ /end MEASUREMENT
/begin MEASUREMENT VTQD_OPDHoldReleaseTq_Nm "" FLOAT32_IEEE SWC_FDC_type_CM_single_Nm 0 0 -100000.0 100000.0 ECU_ADDRESS 0x0000 /* @ECU_Address@VTQD_OPDHoldReleaseTq_Nm@ */ /end MEASUREMENT
/begin MEASUREMENT VTQD_OPDHoldActRelTq_Nm "" FLOAT32_IEEE SWC_FDC_type_CM_single_Nm 0 0 -100000.0 100000.0 ECU_ADDRESS 0x0000 /* @ECU_Address@VTQD_OPDHoldActRelTq_Nm@ */ /end MEASUREMENT
/begin MEASUREMENT VTQD_OPDHoldDisRelTq_Nm "" FLOAT32_IEEE SWC_FDC_type_CM_single_Nm 0 0 -100000.0 100000.0 ECU_ADDRESS 0x0000 /* @ECU_Address@VTQD_OPDHoldDisRelTq_Nm@ */ /end MEASUREMENT
/begin MEASUREMENT VTQD_OPDHoldRelDetTime_s "" FLOAT32_IEEE SWC_FDC_type_CM_single_s 0 0 0.0 3600.0 ECU_ADDRESS 0x0000 /* @ECU_Address@VTQD_OPDHoldRelDetTime_s@ */ /end MEASUREMENT
/begin MEASUREMENT VTQD_OPDHoldDownRelDelay_s "" FLOAT32_IEEE SWC_FDC_type_CM_single_s 0 0 0.0 3600.0 ECU_ADDRESS 0x0000 /* @ECU_Address@VTQD_OPDHoldDownRelDelay_s@ */ /end MEASUREMENT
/begin MEASUREMENT VTQD_SlideTqLowLim_Nm "" FLOAT32_IEEE SWC_FDC_type_CM_single_Nm 0 0 -100000.0 100000.0 ECU_ADDRESS 0x0000 /* @ECU_Address@VTQD_SlideTqLowLim_Nm@ */ /end MEASUREMENT
/begin MEASUREMENT VTQD_TqLowLimYawDev_degps "" FLOAT32_IEEE SWC_FDC_type_CM_single_degps 0 0 -150.0 150.0 ECU_ADDRESS 0x0000 /* @ECU_Address@VTQD_TqLowLimYawDev_degps@ */ /end MEASUREMENT
/begin MEASUREMENT VTQD_YawTqLowLim_Nm "" FLOAT32_IEEE SWC_FDC_type_CM_single_Nm 0 0 -100000.0 100000.0 ECU_ADDRESS 0x0000 /* @ECU_Address@VTQD_YawTqLowLim_Nm@ */ /end MEASUREMENT
/begin MEASUREMENT VTQD_PreDecTqLowLim_Nm "" FLOAT32_IEEE SWC_FDC_type_CM_single_Nm 0 0 -100000.0 100000.0 ECU_ADDRESS 0x0000 /* @ECU_Address@VTQD_PreDecTqLowLim_Nm@ */ /end MEASUREMENT
/begin MEASUREMENT VTQD_OrigPedalMapWhlTq_Nm "" FLOAT32_IEEE SWC_FDC_type_CM_single_Nm 0 0 -100000.0 100000.0 ECU_ADDRESS 0x0000 /* @ECU_Address@VTQD_OrigPedalMapWhlTq_Nm@ */ /end MEASUREMENT
/begin MEASUREMENT VTQD_GRADE_Deg "" FLOAT32_IEEE SWC_FDC_type_CM_single_Deg 0 0 -360.0 360.0 ECU_ADDRESS 0x0000 /* @ECU_Address@VTQD_GRADE_Deg@ */ /end MEASUREMENT
/begin MEASUREMENT VTQD_PedalMapClimbUpLim_Nm "" FLOAT32_IEEE SWC_FDC_type_CM_single_Nm 0 0 -100000.0 100000.0 ECU_ADDRESS 0x0000 /* @ECU_Address@VTQD_PedalMapClimbUpLim_Nm@ */ /end MEASUREMENT
/begin MEASUREMENT VTQD_SlideRateDev_pct "" FLOAT32_IEEE SWC_FDC_type_CM_single_pct 0 0 -125.0 125.0 ECU_ADDRESS 0x0000 /* @ECU_Address@VTQD_SlideRateDev_pct@ */ /end MEASUREMENT
/begin MEASUREMENT VTQD_SlideRegenLimTqGain_Nm "" FLOAT32_IEEE SWC_FDC_type_CM_single_Nm 0 0 -100000.0 100000.0 ECU_ADDRESS 0x0000 /* @ECU_Address@VTQD_SlideRegenLimTqGain_Nm@ */ /end MEASUREMENT
/begin MEASUREMENT VTQD_LastSlideRegenLimTq_Nm "" FLOAT32_IEEE SWC_FDC_type_CM_single_Nm 0 0 -100000.0 100000.0 ECU_ADDRESS 0x0000 /* @ECU_Address@VTQD_LastSlideRegenLimTq_Nm@ */ /end MEASUREMENT
/begin MEASUREMENT VTQD_SlideRegenLimTq_Nm "" FLOAT32_IEEE SWC_FDC_type_CM_single_Nm 0 0 -100000.0 100000.0 ECU_ADDRESS 0x0000 /* @ECU_Address@VTQD_SlideRegenLimTq_Nm@ */ /end MEASUREMENT
/begin MEASUREMENT VTQD_BrkRgnLatchTqLim_Nm "" FLOAT32_IEEE SWC_FDC_type_CM_single_Nm 0 0 -100000.0 100000.0 ECU_ADDRESS 0x0000 /* @ECU_Address@VTQD_BrkRgnLatchTqLim_Nm@ */ /end MEASUREMENT
/begin MEASUREMENT VTQD_OrigPedTqLowLim_Nm "" FLOAT32_IEEE SWC_FDC_type_CM_single_Nm 0 0 -100000.0 100000.0 ECU_ADDRESS 0x0000 /* @ECU_Address@VTQD_OrigPedTqLowLim_Nm@ */ /end MEASUREMENT
/begin MEASUREMENT VTQD_ActPedalMapWhlTq_Nm "" FLOAT32_IEEE SWC_FDC_type_CM_single_Nm 0 0 -100000.0 100000.0 ECU_ADDRESS 0x0000 /* @ECU_Address@VTQD_ActPedalMapWhlTq_Nm@ */ /end MEASUREMENT
/begin MEASUREMENT VTQD_PedalMapWhlTq_Nm "" FLOAT32_IEEE SWC_FDC_type_CM_single_Nm 0 0 -100000.0 100000.0 ECU_ADDRESS 0x0000 /* @ECU_Address@VTQD_PedalMapWhlTq_Nm@ */ /end MEASUREMENT
/begin MEASUREMENT VTQD_BOSReduction_gain "" FLOAT32_IEEE SWC_FDC_type_CM_single_gain 0 0 0.0 1.0 ECU_ADDRESS 0x0000 /* @ECU_Address@VTQD_BOSReduction_gain@ */ /end MEASUREMENT
/begin MEASUREMENT VTQD_BOSTq_Nm "" FLOAT32_IEEE SWC_FDC_type_CM_single_Nm 0 0 -100000.0 100000.0 ECU_ADDRESS 0x0000 /* @ECU_Address@VTQD_BOSTq_Nm@ */ /end MEASUREMENT
/begin MEASUREMENT VTQD_BOSEnBPSPosn_pct "" FLOAT32_IEEE SWC_FDC_type_CM_single_pct 0 0 -125.0 125.0 ECU_ADDRESS 0x0000 /* @ECU_Address@VTQD_BOSEnBPSPosn_pct@ */ /end MEASUREMENT
/begin MEASUREMENT VTQD_CreepBPSDisPosnR_pct "" FLOAT32_IEEE SWC_FDC_type_CM_single_pct 0 0 0.0 125.0 ECU_ADDRESS 0x0000 /* @ECU_Address@VTQD_CreepBPSDisPosnR_pct@ */ /end MEASUREMENT
/begin MEASUREMENT VTQD_CreepBPSDisPosn_pct "" FLOAT32_IEEE SWC_FDC_type_CM_single_pct 0 0 0.0 125.0 ECU_ADDRESS 0x0000 /* @ECU_Address@VTQD_CreepBPSDisPosn_pct@ */ /end MEASUREMENT
/begin MEASUREMENT VTQD_MaxShaftSpd_rpm "" FLOAT32_IEEE SWC_FDC_type_CM_single_rpm 0 0 -100000.0 100000.0 ECU_ADDRESS 0x0000 /* @ECU_Address@VTQD_MaxShaftSpd_rpm@ */ /end MEASUREMENT
/begin MEASUREMENT VTQD_EscapeModePedTq_Nm "" FLOAT32_IEEE SWC_FDC_type_CM_single_Nm 0 0 -100000.0 100000.0 ECU_ADDRESS 0x0000 /* @ECU_Address@VTQD_EscapeModePedTq_Nm@ */ /end MEASUREMENT
/begin MEASUREMENT VTQD_PreloadTq_Nm "" FLOAT32_IEEE SWC_FDC_type_CM_single_Nm 0 0 0.0 100000.0 ECU_ADDRESS 0x0000 /* @ECU_Address@VTQD_PreloadTq_Nm@ */ /end MEASUREMENT
/begin MEASUREMENT VTQD_CreepProtTq_Nm "" FLOAT32_IEEE SWC_FDC_type_CM_single_Nm 0 0 -100000.0 100000.0 ECU_ADDRESS 0x0000 /* @ECU_Address@VTQD_CreepProtTq_Nm@ */ /end MEASUREMENT
/begin MEASUREMENT VTQD_CreepPreloadSetTime_s "" FLOAT32_IEEE SWC_FDC_type_CM_single_s 0 0 0.0 3600.0 ECU_ADDRESS 0x0000 /* @ECU_Address@VTQD_CreepPreloadSetTime_s@ */ /end MEASUREMENT
/begin MEASUREMENT VTQD_CreepBPSEnPosnR_pct "" FLOAT32_IEEE SWC_FDC_type_CM_single_pct 0 0 0.0 125.0 ECU_ADDRESS 0x0000 /* @ECU_Address@VTQD_CreepBPSEnPosnR_pct@ */ /end MEASUREMENT
/begin MEASUREMENT VTQD_CreepBPSEnPosn_pct "" FLOAT32_IEEE SWC_FDC_type_CM_single_pct 0 0 0.0 125.0 ECU_ADDRESS 0x0000 /* @ECU_Address@VTQD_CreepBPSEnPosn_pct@ */ /end MEASUREMENT
/begin MEASUREMENT VTQD_OPDHoldEnSpd_kph "" FLOAT32_IEEE SWC_FDC_type_CM_single_kph 0 0 0.0 300.0 ECU_ADDRESS 0x0000 /* @ECU_Address@VTQD_OPDHoldEnSpd_kph@ */ /end MEASUREMENT
/begin MEASUREMENT VTQD_CreepEnSpd_kph "" FLOAT32_IEEE SWC_FDC_type_CM_single_kph 0 0 0.0 300.0 ECU_ADDRESS 0x0000 /* @ECU_Address@VTQD_CreepEnSpd_kph@ */ /end MEASUREMENT
/begin MEASUREMENT VTQD_CreepDisSpd_kph "" FLOAT32_IEEE SWC_FDC_type_CM_single_kph 0 0 0.0 300.0 ECU_ADDRESS 0x0000 /* @ECU_Address@VTQD_CreepDisSpd_kph@ */ /end MEASUREMENT
/begin MEASUREMENT VTQD_APSReqUpSpd_kph "" FLOAT32_IEEE SWC_FDC_type_CM_single_kph 0 0 -10.0 300.0 ECU_ADDRESS 0x0000 /* @ECU_Address@VTQD_APSReqUpSpd_kph@ */ /end MEASUREMENT
/begin MEASUREMENT VTQD_CreepPreloadTq_Nm "" FLOAT32_IEEE SWC_FDC_type_CM_single_Nm 0 0 -100.0 500.0 ECU_ADDRESS 0x0000 /* @ECU_Address@VTQD_CreepPreloadTq_Nm@ */ /end MEASUREMENT
/begin MEASUREMENT VTQD_CreepUpLimitTq_Nm "" FLOAT32_IEEE SWC_FDC_type_CM_single_Nm 0 0 -100000.0 100000.0 ECU_ADDRESS 0x0000 /* @ECU_Address@VTQD_CreepUpLimitTq_Nm@ */ /end MEASUREMENT
/begin MEASUREMENT VTQD_ActCreepBaseTq_Nm "" FLOAT32_IEEE SWC_FDC_type_CM_single_Nm 0 0 -100000.0 100000.0 ECU_ADDRESS 0x0000 /* @ECU_Address@VTQD_ActCreepBaseTq_Nm@ */ /end MEASUREMENT
/begin MEASUREMENT VTQD_CreepTargetSpdR_kph "" FLOAT32_IEEE SWC_FDC_type_CM_single_kph 0 0 0.0 300.0 ECU_ADDRESS 0x0000 /* @ECU_Address@VTQD_CreepTargetSpdR_kph@ */ /end MEASUREMENT
/begin MEASUREMENT VTQD_CreepTargetSpdD_kph "" FLOAT32_IEEE SWC_FDC_type_CM_single_kph 0 0 0.0 300.0 ECU_ADDRESS 0x0000 /* @ECU_Address@VTQD_CreepTargetSpdD_kph@ */ /end MEASUREMENT
/begin MEASUREMENT VTQD_CreepFinalSpd_kph "" FLOAT32_IEEE SWC_FDC_type_CM_single_kph 0 0 0.0 300.0 ECU_ADDRESS 0x0000 /* @ECU_Address@VTQD_CreepFinalSpd_kph@ */ /end MEASUREMENT
/begin MEASUREMENT VTQD_CreepErrSpd_kph "" FLOAT32_IEEE SWC_FDC_type_CM_single_kph 0 0 0.0 300.0 ECU_ADDRESS 0x0000 /* @ECU_Address@VTQD_CreepErrSpd_kph@ */ /end MEASUREMENT
/begin MEASUREMENT VTQD_CreepPterm_c "" FLOAT32_IEEE SWC_FDC_type_CM_single_c 0 0 -1000.0 1000.0 ECU_ADDRESS 0x0000 /* @ECU_Address@VTQD_CreepPterm_c@ */ /end MEASUREMENT
/begin MEASUREMENT VTQD_CreepIterm_c "" FLOAT32_IEEE SWC_FDC_type_CM_single_c 0 0 -1000.0 1000.0 ECU_ADDRESS 0x0000 /* @ECU_Address@VTQD_CreepIterm_c@ */ /end MEASUREMENT
/begin MEASUREMENT VTQD_CreepDeltaTq_Nm "" FLOAT32_IEEE SWC_FDC_type_CM_single_Nm 0 0 -100000.0 100000.0 ECU_ADDRESS 0x0000 /* @ECU_Address@VTQD_CreepDeltaTq_Nm@ */ /end MEASUREMENT
/begin MEASUREMENT VTQD_CreepActWhlTqDem_Nm "" FLOAT32_IEEE SWC_FDC_type_CM_single_Nm 0 0 -100000.0 100000.0 ECU_ADDRESS 0x0000 /* @ECU_Address@VTQD_CreepActWhlTqDem_Nm@ */ /end MEASUREMENT
/begin MEASUREMENT VTQD_CreepWhlTqDem_Nm "" FLOAT32_IEEE SWC_FDC_type_CM_single_Nm 0 0 -100000.0 100000.0 ECU_ADDRESS 0x0000 /* @ECU_Address@VTQD_CreepWhlTqDem_Nm@ */ /end MEASUREMENT
/begin MEASUREMENT VTQD_DriverWhlTqDem_Nm "" FLOAT32_IEEE SWC_FDC_type_CM_single_Nm 0 0 -100000.0 100000.0 ECU_ADDRESS 0x0000 /* @ECU_Address@VTQD_DriverWhlTqDem_Nm@ */ /end MEASUREMENT
/begin MEASUREMENT VTQD_RrTqErr_Nm "" FLOAT32_IEEE SWC_FDC_type_CM_single_Nm 0 0 0.0 100000.0 ECU_ADDRESS 0x0000 /* @ECU_Address@VTQD_RrTqErr_Nm@ */ /end MEASUREMENT
/begin MEASUREMENT VTQD_FrTqErr_Nm "" FLOAT32_IEEE SWC_FDC_type_CM_single_Nm 0 0 0.0 100000.0 ECU_ADDRESS 0x0000 /* @ECU_Address@VTQD_FrTqErr_Nm@ */ /end MEASUREMENT
/begin MEASUREMENT VTQD_EstActVehWeight_kg "" FLOAT32_IEEE SWC_FDC_type_CM_single_kg 0 0 0.0 10000.0 ECU_ADDRESS 0x0000 /* @ECU_Address@VTQD_EstActVehWeight_kg@ */ /end MEASUREMENT
/begin MEASUREMENT VTQD_EstInitVehWeight_kg "" FLOAT32_IEEE SWC_FDC_type_CM_single_kg 0 0 0.0 10000.0 ECU_ADDRESS 0x0000 /* @ECU_Address@VTQD_EstInitVehWeight_kg@ */ /end MEASUREMENT
/begin MEASUREMENT VTQD_EstVehWeightResult_kg "" FLOAT32_IEEE SWC_FDC_type_CM_single_kg 0 0 0.0 10000.0 ECU_ADDRESS 0x0000 /* @ECU_Address@VTQD_EstVehWeightResult_kg@ */ /end MEASUREMENT
/begin MEASUREMENT VTQD_FrMotActReduce_Nm "" FLOAT32_IEEE SWC_FDC_type_CM_single_Nm 0 0 0.0 100000.0 ECU_ADDRESS 0x0000 /* @ECU_Address@VTQD_FrMotActReduce_Nm@ */ /end MEASUREMENT
/begin MEASUREMENT VTQD_FrGenActReduce_Nm "" FLOAT32_IEEE SWC_FDC_type_CM_single_Nm 0 0 0.0 100000.0 ECU_ADDRESS 0x0000 /* @ECU_Address@VTQD_FrGenActReduce_Nm@ */ /end MEASUREMENT
/begin MEASUREMENT VTQD_FAfterTqCMDGain_c "" FLOAT32_IEEE SWC_FDC_type_CM_single_c 0 0 0.0 1.0 ECU_ADDRESS 0x0000 /* @ECU_Address@VTQD_FAfterTqCMDGain_c@ */ /end MEASUREMENT
/begin MEASUREMENT VTQD_RrMotActReduce_Nm "" FLOAT32_IEEE SWC_FDC_type_CM_single_Nm 0 0 -100000.0 0.0 ECU_ADDRESS 0x0000 /* @ECU_Address@VTQD_RrMotActReduce_Nm@ */ /end MEASUREMENT
/begin MEASUREMENT VTQD_RrGenActReduce_Nm "" FLOAT32_IEEE SWC_FDC_type_CM_single_Nm 0 0 -100000.0 0.0 ECU_ADDRESS 0x0000 /* @ECU_Address@VTQD_RrGenActReduce_Nm@ */ /end MEASUREMENT
/begin MEASUREMENT VTQD_RAfterTqCMDGain_c "" FLOAT32_IEEE SWC_FDC_type_CM_single_c 0 0 0.0 1.0 ECU_ADDRESS 0x0000 /* @ECU_Address@VTQD_RAfterTqCMDGain_c@ */ /end MEASUREMENT
/begin MEASUREMENT VTQD_DriverWhlTqDemFr_Nm "" FLOAT32_IEEE SWC_FDC_type_CM_single_Nm 0 0 -100000.0 100000.0 ECU_ADDRESS 0x0000 /* @ECU_Address@VTQD_DriverWhlTqDemFr_Nm@ */ /end MEASUREMENT
/begin MEASUREMENT VTQD_DriverWhlTqDemRr_Nm "" FLOAT32_IEEE SWC_FDC_type_CM_single_Nm 0 0 -100000.0 100000.0 ECU_ADDRESS 0x0000 /* @ECU_Address@VTQD_DriverWhlTqDemRr_Nm@ */ /end MEASUREMENT
/begin MEASUREMENT VTQD_APSDecReqCMD_mps2 "" FLOAT32_IEEE SWC_FDC_type_CM_single_mps2 0 0 -20.0 20.0 ECU_ADDRESS 0x0000 /* @ECU_Address@VTQD_APSDecReqCMD_mps2@ */ /end MEASUREMENT
/begin MEASUREMENT VTQD_ActOPDHoldAccDev_mps2 "" FLOAT32_IEEE SWC_FDC_type_CM_single_mps2 0 0 -20.0 20.0 ECU_ADDRESS 0x0000 /* @ECU_Address@VTQD_ActOPDHoldAccDev_mps2@ */ /end MEASUREMENT
/begin MEASUREMENT VTQD_MapAPSDecReq_mps2 "" FLOAT32_IEEE SWC_FDC_type_CM_single_mps2 0 0 -20.0 20.0 ECU_ADDRESS 0x0000 /* @ECU_Address@VTQD_MapAPSDecReq_mps2@ */ /end MEASUREMENT
/begin MEASUREMENT VTQD_APSDecTimeGain_c "" FLOAT32_IEEE SWC_FDC_type_CM_single_c 0 0 0.0 10.0 ECU_ADDRESS 0x0000 /* @ECU_Address@VTQD_APSDecTimeGain_c@ */ /end MEASUREMENT
/begin MEASUREMENT VTQD_APSDecReqTs_c "" FLOAT32_IEEE SWC_FDC_type_CM_single_c 0 0 0.0 1.0 ECU_ADDRESS 0x0000 /* @ECU_Address@VTQD_APSDecReqTs_c@ */ /end MEASUREMENT
/begin MEASUREMENT VTQD_APSDecReq_mps2 "" FLOAT32_IEEE SWC_FDC_type_CM_single_mps2 0 0 -20.0 20.0 ECU_ADDRESS 0x0000 /* @ECU_Address@VTQD_APSDecReq_mps2@ */ /end MEASUREMENT
/begin MEASUREMENT VTQD_SimSouWaveReq_pct "" FLOAT32_IEEE SWC_FDC_type_CM_single_pct 0 0 -125.0 125.0 ECU_ADDRESS 0x0000 /* @ECU_Address@VTQD_SimSouWaveReq_pct@ */ /end MEASUREMENT
/begin MEASUREMENT VTQD_AvailTqNoARgnFr_Nm "" FLOAT32_IEEE SWC_FDC_type_CM_single_Nm 0 0 0.0 100000.0 ECU_ADDRESS 0x0000 /* @ECU_Address@VTQD_AvailTqNoARgnFr_Nm@ */ /end MEASUREMENT
/begin MEASUREMENT VTQD_AvailTqNoARgnRr_Nm "" FLOAT32_IEEE SWC_FDC_type_CM_single_Nm 0 0 0.0 100000.0 ECU_ADDRESS 0x0000 /* @ECU_Address@VTQD_AvailTqNoARgnRr_Nm@ */ /end MEASUREMENT
/begin MEASUREMENT VTQD_AvailTqWithARgnFr_Nm "" FLOAT32_IEEE SWC_FDC_type_CM_single_Nm 0 0 0.0 100000.0 ECU_ADDRESS 0x0000 /* @ECU_Address@VTQD_AvailTqWithARgnFr_Nm@ */ /end MEASUREMENT
/begin MEASUREMENT VTQD_AvailTqWithARgnRr_Nm "" FLOAT32_IEEE SWC_FDC_type_CM_single_Nm 0 0 0.0 100000.0 ECU_ADDRESS 0x0000 /* @ECU_Address@VTQD_AvailTqWithARgnRr_Nm@ */ /end MEASUREMENT
/begin MEASUREMENT VTQD_CalRoadSpdLim_raw32 "" FLOAT32_IEEE SWC_FDC_type_CM_single_raw32 0 0 0.0 254.0 ECU_ADDRESS 0x0000 /* @ECU_Address@VTQD_CalRoadSpdLim_raw32@ */ /end MEASUREMENT
/begin MEASUREMENT VTQD_CalRoadSpdLimOffSet_c "" FLOAT32_IEEE SWC_FDC_type_CM_single_c 0 0 0.0 30.0 ECU_ADDRESS 0x0000 /* @ECU_Address@VTQD_CalRoadSpdLimOffSet_c@ */ /end MEASUREMENT
/begin MEASUREMENT VTQD_RoadSpdLim_raw32 "" FLOAT32_IEEE SWC_FDC_type_CM_single_raw32 0 0 0.0 254.0 ECU_ADDRESS 0x0000 /* @ECU_Address@VTQD_RoadSpdLim_raw32@ */ /end MEASUREMENT
/begin MEASUREMENT VBCM_UserHeightSet_cnt "" UWORD SWC_FDC_type_CM_uint16_cnt 0 0 0.0 65535.0 ECU_ADDRESS 0x0000 /* @ECU_Address@VBCM_UserHeightSet_cnt@ */ /end MEASUREMENT
/begin MEASUREMENT VBCM_PTGUserHeight1_cnt "" UWORD SWC_FDC_type_CM_uint16_cnt 0 0 0.0 65535.0 ECU_ADDRESS 0x0000 /* @ECU_Address@VBCM_PTGUserHeight1_cnt@ */ /end MEASUREMENT
/begin MEASUREMENT VBCM_PTGUserHeight2_cnt "" UWORD SWC_FDC_type_CM_uint16_cnt 0 0 0.0 65535.0 ECU_ADDRESS 0x0000 /* @ECU_Address@VBCM_PTGUserHeight2_cnt@ */ /end MEASUREMENT
/begin MEASUREMENT VBCM_PTGUserHeight3_cnt "" UWORD SWC_FDC_type_CM_uint16_cnt 0 0 0.0 65535.0 ECU_ADDRESS 0x0000 /* @ECU_Address@VBCM_PTGUserHeight3_cnt@ */ /end MEASUREMENT
/begin MEASUREMENT VBCM_PTGUserHeight4_cnt "" UWORD SWC_FDC_type_CM_uint16_cnt 0 0 0.0 65535.0 ECU_ADDRESS 0x0000 /* @ECU_Address@VBCM_PTGUserHeight4_cnt@ */ /end MEASUREMENT
/begin MEASUREMENT VBCM_PTGUserHeight5_cnt "" UWORD SWC_FDC_type_CM_uint16_cnt 0 0 0.0 65535.0 ECU_ADDRESS 0x0000 /* @ECU_Address@VBCM_PTGUserHeight5_cnt@ */ /end MEASUREMENT
/begin MEASUREMENT VBCM_PTGUserHeight7_cnt "" UWORD SWC_FDC_type_CM_uint16_cnt 0 0 0.0 65535.0 ECU_ADDRESS 0x0000 /* @ECU_Address@VBCM_PTGUserHeight7_cnt@ */ /end MEASUREMENT
/begin MEASUREMENT VTPM_LFWheelPress_raw8 "" UBYTE SWC_FDC_type_CM_uint8_raw8 0 0 0.0 255.0 ECU_ADDRESS 0x0000 /* @ECU_Address@VTPM_LFWheelPress_raw8@ */ /end MEASUREMENT
/begin MEASUREMENT VTPM_RFWheelPress_raw8 "" UBYTE SWC_FDC_type_CM_uint8_raw8 0 0 0.0 255.0 ECU_ADDRESS 0x0000 /* @ECU_Address@VTPM_RFWheelPress_raw8@ */ /end MEASUREMENT
/begin MEASUREMENT VTPM_LRWheelPress_raw8 "" UBYTE SWC_FDC_type_CM_uint8_raw8 0 0 0.0 255.0 ECU_ADDRESS 0x0000 /* @ECU_Address@VTPM_LRWheelPress_raw8@ */ /end MEASUREMENT
/begin MEASUREMENT VTPM_RRWheelPress_raw8 "" UBYTE SWC_FDC_type_CM_uint8_raw8 0 0 0.0 255.0 ECU_ADDRESS 0x0000 /* @ECU_Address@VTPM_RRWheelPress_raw8@ */ /end MEASUREMENT
/begin MEASUREMENT VTPM_LFPindi_enum "" UBYTE SWC_FDC_type_CM_uint8_enum 0 0 0.0 3.0 ECU_ADDRESS 0x0000 /* @ECU_Address@VTPM_LFPindi_enum@ */ /end MEASUREMENT
/begin MEASUREMENT VTPM_RFPind_enum "" UBYTE SWC_FDC_type_CM_uint8_enum 0 0 0.0 3.0 ECU_ADDRESS 0x0000 /* @ECU_Address@VTPM_RFPind_enum@ */ /end MEASUREMENT
/begin MEASUREMENT VTPM_LRPindi_enum "" UBYTE SWC_FDC_type_CM_uint8_enum 0 0 0.0 3.0 ECU_ADDRESS 0x0000 /* @ECU_Address@VTPM_LRPindi_enum@ */ /end MEASUREMENT
/begin MEASUREMENT VTPM_RRPindi_enum "" UBYTE SWC_FDC_type_CM_uint8_enum 0 0 0.0 3.0 ECU_ADDRESS 0x0000 /* @ECU_Address@VTPM_RRPindi_enum@ */ /end MEASUREMENT
/begin MEASUREMENT VTPM_LFP20_raw8 "" UBYTE SWC_FDC_type_CM_uint8_raw8 0 0 0.0 255.0 ECU_ADDRESS 0x0000 /* @ECU_Address@VTPM_LFP20_raw8@ */ /end MEASUREMENT
/begin MEASUREMENT VTPM_LRP20_raw8 "" UBYTE SWC_FDC_type_CM_uint8_raw8 0 0 0.0 255.0 ECU_ADDRESS 0x0000 /* @ECU_Address@VTPM_LRP20_raw8@ */ /end MEASUREMENT
/begin MEASUREMENT VTPM_RFP20_raw8 "" UBYTE SWC_FDC_type_CM_uint8_raw8 0 0 0.0 255.0 ECU_ADDRESS 0x0000 /* @ECU_Address@VTPM_RFP20_raw8@ */ /end MEASUREMENT
/begin MEASUREMENT VTPM_RRP20_raw8 "" UBYTE SWC_FDC_type_CM_uint8_raw8 0 0 0.0 255.0 ECU_ADDRESS 0x0000 /* @ECU_Address@VTPM_RRP20_raw8@ */ /end MEASUREMENT
/begin MEASUREMENT VTPM_LFWheelPSW_raw8 "" UBYTE SWC_FDC_type_CM_uint8_raw8 0 0 0.0 200.0 ECU_ADDRESS 0x0000 /* @ECU_Address@VTPM_LFWheelPSW_raw8@ */ /end MEASUREMENT
/begin MEASUREMENT VTPM_RFWheelPSW_raw8 "" UBYTE SWC_FDC_type_CM_uint8_raw8 0 0 0.0 200.0 ECU_ADDRESS 0x0000 /* @ECU_Address@VTPM_RFWheelPSW_raw8@ */ /end MEASUREMENT
/begin MEASUREMENT VTPM_LRWheelPSW_raw8 "" UBYTE SWC_FDC_type_CM_uint8_raw8 0 0 0.0 200.0 ECU_ADDRESS 0x0000 /* @ECU_Address@VTPM_LRWheelPSW_raw8@ */ /end MEASUREMENT
/begin MEASUREMENT VTPM_RRWheelPSW_raw8 "" UBYTE SWC_FDC_type_CM_uint8_raw8 0 0 0.0 200.0 ECU_ADDRESS 0x0000 /* @ECU_Address@VTPM_RRWheelPSW_raw8@ */ /end MEASUREMENT
/begin MEASUREMENT VTPM_Prepresstempvalid_enum "" UBYTE SWC_FDC_type_CM_uint8_enum 0 0 0.0 255.0 ECU_ADDRESS 0x0000 /* @ECU_Address@VTPM_Prepresstempvalid_enum@ */ /end MEASUREMENT
/begin MEASUREMENT VTPM_LFPressIndi_enum "" UBYTE SWC_FDC_type_CM_uint8_enum 0 0 0.0 4.0 ECU_ADDRESS 0x0000 /* @ECU_Address@VTPM_LFPressIndi_enum@ */ /end MEASUREMENT
/begin MEASUREMENT VTPM_RFPressIndi_enum "" UBYTE SWC_FDC_type_CM_uint8_enum 0 0 0.0 4.0 ECU_ADDRESS 0x0000 /* @ECU_Address@VTPM_RFPressIndi_enum@ */ /end MEASUREMENT
/begin MEASUREMENT VTPM_LRPressIndi_enum "" UBYTE SWC_FDC_type_CM_uint8_enum 0 0 0.0 4.0 ECU_ADDRESS 0x0000 /* @ECU_Address@VTPM_LRPressIndi_enum@ */ /end MEASUREMENT
/begin MEASUREMENT VTPM_RRPressIndi_enum "" UBYTE SWC_FDC_type_CM_uint8_enum 0 0 0.0 4.0 ECU_ADDRESS 0x0000 /* @ECU_Address@VTPM_RRPressIndi_enum@ */ /end MEASUREMENT
/begin MEASUREMENT VTPM_TPMSWarnIndi_enum "" UBYTE SWC_FDC_type_CM_uint8_enum 0 0 0.0 3.0 ECU_ADDRESS 0x0000 /* @ECU_Address@VTPM_TPMSWarnIndi_enum@ */ /end MEASUREMENT
/begin MEASUREMENT VTPM_CWheelTips_enum "" UBYTE SWC_FDC_type_CM_uint8_enum 0 0 0.0 3.0 ECU_ADDRESS 0x0000 /* @ECU_Address@VTPM_CWheelTips_enum@ */ /end MEASUREMENT
/begin MEASUREMENT VTPM_AutoLTips_enum "" UBYTE SWC_FDC_type_CM_uint8_enum 0 0 0.0 3.0 ECU_ADDRESS 0x0000 /* @ECU_Address@VTPM_AutoLTips_enum@ */ /end MEASUREMENT
/begin MEASUREMENT VTPM_ManualP4alarm_raw "" UBYTE SWC_FDC_type_CM_uint8_raw 0 0 0.0 200.0 ECU_ADDRESS 0x0000 /* @ECU_Address@VTPM_ManualP4alarm_raw@ */ /end MEASUREMENT
/begin MEASUREMENT VTPM_ManualS4pressindi_enum "" UBYTE SWC_FDC_type_CM_uint8_enum 0 0 0.0 200.0 ECU_ADDRESS 0x0000 /* @ECU_Address@VTPM_ManualS4pressindi_enum@ */ /end MEASUREMENT
/begin MEASUREMENT VTPM_ManualID4P20_raw8 "" UBYTE SWC_FDC_type_CM_uint8_raw8 0 0 0.0 255.0 ECU_ADDRESS 0x0000 /* @ECU_Address@VTPM_ManualID4P20_raw8@ */ /end MEASUREMENT
/begin MEASUREMENT VTPM_ManualP3alarm_raw "" UBYTE SWC_FDC_type_CM_uint8_raw 0 0 0.0 200.0 ECU_ADDRESS 0x0000 /* @ECU_Address@VTPM_ManualP3alarm_raw@ */ /end MEASUREMENT
/begin MEASUREMENT VTPM_ManualS3pressindi_enum "" UBYTE SWC_FDC_type_CM_uint8_enum 0 0 0.0 200.0 ECU_ADDRESS 0x0000 /* @ECU_Address@VTPM_ManualS3pressindi_enum@ */ /end MEASUREMENT
/begin MEASUREMENT VTPM_ManualID3P20_raw8 "" UBYTE SWC_FDC_type_CM_uint8_raw8 0 0 0.0 255.0 ECU_ADDRESS 0x0000 /* @ECU_Address@VTPM_ManualID3P20_raw8@ */ /end MEASUREMENT
/begin MEASUREMENT VTPM_ManualP2alarm_raw "" UBYTE SWC_FDC_type_CM_uint8_raw 0 0 0.0 200.0 ECU_ADDRESS 0x0000 /* @ECU_Address@VTPM_ManualP2alarm_raw@ */ /end MEASUREMENT
/begin MEASUREMENT VTPM_ManualS2pressindi_enum "" UBYTE SWC_FDC_type_CM_uint8_enum 0 0 0.0 200.0 ECU_ADDRESS 0x0000 /* @ECU_Address@VTPM_ManualS2pressindi_enum@ */ /end MEASUREMENT
/begin MEASUREMENT VTPM_ManualID2P20_raw8 "" UBYTE SWC_FDC_type_CM_uint8_raw8 0 0 0.0 255.0 ECU_ADDRESS 0x0000 /* @ECU_Address@VTPM_ManualID2P20_raw8@ */ /end MEASUREMENT
/begin MEASUREMENT VTPM_Spressindi_enum "" UBYTE SWC_FDC_type_CM_uint8_enum 0 0 0.0 255.0 ECU_ADDRESS 0x0000 /* @ECU_Address@VTPM_Spressindi_enum@ */ /end MEASUREMENT
/begin MEASUREMENT VTPM_C_cnt "" UBYTE SWC_FDC_type_CM_uint8_cnt 0 0 0.0 255.0 ECU_ADDRESS 0x0000 /* @ECU_Address@VTPM_C_cnt@ */ /end MEASUREMENT
/begin MEASUREMENT VTPM_ManualP1alarm_raw "" UBYTE SWC_FDC_type_CM_uint8_raw 0 0 0.0 200.0 ECU_ADDRESS 0x0000 /* @ECU_Address@VTPM_ManualP1alarm_raw@ */ /end MEASUREMENT
/begin MEASUREMENT VTPM_ManualS1pressindi_enum "" UBYTE SWC_FDC_type_CM_uint8_enum 0 0 0.0 200.0 ECU_ADDRESS 0x0000 /* @ECU_Address@VTPM_ManualS1pressindi_enum@ */ /end MEASUREMENT
/begin MEASUREMENT VTPM_ManualID1P20_raw8 "" UBYTE SWC_FDC_type_CM_uint8_raw8 0 0 0.0 255.0 ECU_ADDRESS 0x0000 /* @ECU_Address@VTPM_ManualID1P20_raw8@ */ /end MEASUREMENT
/begin MEASUREMENT VTQR_FrTqZeroTrans_enum "" UBYTE SWC_FDC_type_CM_uint8_enum 0 0 0.0 2.0 ECU_ADDRESS 0x0000 /* @ECU_Address@VTQR_FrTqZeroTrans_enum@ */ /end MEASUREMENT
/begin MEASUREMENT VTQD_WhlSkipDisOPDHold_enum "" UBYTE SWC_FDC_type_CM_uint8_enum 0 0 0.0 4.0 ECU_ADDRESS 0x0000 /* @ECU_Address@VTQD_WhlSkipDisOPDHold_enum@ */ /end MEASUREMENT
/begin MEASUREMENT VTQD_APSStaSys_enum "" UBYTE SWC_FDC_type_CM_uint8_enum 0 0 0.0 15.0 ECU_ADDRESS 0x0000 /* @ECU_Address@VTQD_APSStaSys_enum@ */ /end MEASUREMENT
/begin MEASUREMENT VTQD_WhlSkipDisCreep_enum "" UBYTE SWC_FDC_type_CM_uint8_enum 0 0 0.0 5.0 ECU_ADDRESS 0x0000 /* @ECU_Address@VTQD_WhlSkipDisCreep_enum@ */ /end MEASUREMENT
/begin MEASUREMENT VTQD_APSReq_enum "" UBYTE SWC_FDC_type_CM_uint8_enum 0 0 0.0 15.0 ECU_ADDRESS 0x0000 /* @ECU_Address@VTQD_APSReq_enum@ */ /end MEASUREMENT
/begin MEASUREMENT VTQD_EstInitVehWightX_c "" UBYTE SWC_FDC_type_CM_uint8_c 0 0 0.0 255.0 ECU_ADDRESS 0x0000 /* @ECU_Address@VTQD_EstInitVehWightX_c@ */ /end MEASUREMENT
/begin MEASUREMENT VTQD_SetSpdDeltaLongFit_kph "" UBYTE SWC_FDC_type_CM_uint8_kph 0 0 0.0 255.0 ECU_ADDRESS 0x0000 /* @ECU_Address@VTQD_SetSpdDeltaLongFit_kph@ */ /end MEASUREMENT
/begin MEASUREMENT VBCM_TurnSwTSetSta_enum "" UBYTE SWC_FDC_type_CM_uint8_enum 0 0 0.0 255.0 ECU_ADDRESS 0x0000 /* @ECU_Address@VBCM_TurnSwTSetSta_enum@ */ /end MEASUREMENT
/begin MEASUREMENT VBCM_AmbColorSta_enum "" UBYTE SWC_FDC_type_CM_uint8_enum 0 0 0.0 127.0 ECU_ADDRESS 0x0000 /* @ECU_Address@VBCM_AmbColorSta_enum@ */ /end MEASUREMENT
/begin MEASUREMENT VBCM_AmbBrightSta_enum "" UBYTE SWC_FDC_type_CM_uint8_enum 0 0 0.0 127.0 ECU_ADDRESS 0x0000 /* @ECU_Address@VBCM_AmbBrightSta_enum@ */ /end MEASUREMENT
/begin MEASUREMENT VBCM_ACCLevelMem34_enum "" UBYTE SWC_FDC_type_CM_uint8_enum 0 0 0.0 255.0 ECU_ADDRESS 0x0000 /* @ECU_Address@VBCM_ACCLevelMem34_enum@ */ /end MEASUREMENT
/begin MEASUREMENT VBCM_ACCLevelMem12_enum "" UBYTE SWC_FDC_type_CM_uint8_enum 0 0 0.0 255.0 ECU_ADDRESS 0x0000 /* @ECU_Address@VBCM_ACCLevelMem12_enum@ */ /end MEASUREMENT
/begin MEASUREMENT VBCM_ACCLevelMem57_enum "" UBYTE SWC_FDC_type_CM_uint8_enum 0 0 0.0 255.0 ECU_ADDRESS 0x0000 /* @ECU_Address@VBCM_ACCLevelMem57_enum@ */ /end MEASUREMENT
/begin MEASUREMENT VBCM_AmbDimENFlash_enum "" UBYTE SWC_FDC_type_CM_uint8_enum 0 0 0.0 255.0 ECU_ADDRESS 0x0000 /* @ECU_Address@VBCM_AmbDimENFlash_enum@ */ /end MEASUREMENT
/begin MEASUREMENT VBCM_AmbFunENFlash_enum "" UBYTE SWC_FDC_type_CM_uint8_enum 0 0 0.0 255.0 ECU_ADDRESS 0x0000 /* @ECU_Address@VBCM_AmbFunENFlash_enum@ */ /end MEASUREMENT
/begin MEASUREMENT VBCM_AmbLinkDriStaFlash_enum "" UBYTE SWC_FDC_type_CM_uint8_enum 0 0 0.0 255.0 ECU_ADDRESS 0x0000 /* @ECU_Address@VBCM_AmbLinkDriStaFlash_enum@ */ /end MEASUREMENT
/begin MEASUREMENT VBCM_AmbODAENFlash_enum "" UBYTE SWC_FDC_type_CM_uint8_enum 0 0 0.0 255.0 ECU_ADDRESS 0x0000 /* @ECU_Address@VBCM_AmbODAENFlash_enum@ */ /end MEASUREMENT
/begin MEASUREMENT VBCM_AmbPwrWarnENFlash_enum "" UBYTE SWC_FDC_type_CM_uint8_enum 0 0 0.0 255.0 ECU_ADDRESS 0x0000 /* @ECU_Address@VBCM_AmbPwrWarnENFlash_enum@ */ /end MEASUREMENT
/begin MEASUREMENT VBCM_AmbWelENFlash_enum "" UBYTE SWC_FDC_type_CM_uint8_enum 0 0 0.0 255.0 ECU_ADDRESS 0x0000 /* @ECU_Address@VBCM_AmbWelENFlash_enum@ */ /end MEASUREMENT
/begin MEASUREMENT VBCM_AmbBrightnessSta1_enum "" UBYTE SWC_FDC_type_CM_uint8_enum 0 0 0.0 255.0 ECU_ADDRESS 0x0000 /* @ECU_Address@VBCM_AmbBrightnessSta1_enum@ */ /end MEASUREMENT
/begin MEASUREMENT VBCM_AmbBrightnessSta2_enum "" UBYTE SWC_FDC_type_CM_uint8_enum 0 0 0.0 255.0 ECU_ADDRESS 0x0000 /* @ECU_Address@VBCM_AmbBrightnessSta2_enum@ */ /end MEASUREMENT
/begin MEASUREMENT VBCM_AmbBrightnessSta3_enum "" UBYTE SWC_FDC_type_CM_uint8_enum 0 0 0.0 255.0 ECU_ADDRESS 0x0000 /* @ECU_Address@VBCM_AmbBrightnessSta3_enum@ */ /end MEASUREMENT
/begin MEASUREMENT VBCM_AmbBrightnessSta4_enum "" UBYTE SWC_FDC_type_CM_uint8_enum 0 0 0.0 255.0 ECU_ADDRESS 0x0000 /* @ECU_Address@VBCM_AmbBrightnessSta4_enum@ */ /end MEASUREMENT
/begin MEASUREMENT VBCM_AmbBrightnessSta5_enum "" UBYTE SWC_FDC_type_CM_uint8_enum 0 0 0.0 255.0 ECU_ADDRESS 0x0000 /* @ECU_Address@VBCM_AmbBrightnessSta5_enum@ */ /end MEASUREMENT
/begin MEASUREMENT VBCM_AmbBrightnessSta7_enum "" UBYTE SWC_FDC_type_CM_uint8_enum 0 0 0.0 255.0 ECU_ADDRESS 0x0000 /* @ECU_Address@VBCM_AmbBrightnessSta7_enum@ */ /end MEASUREMENT
/begin MEASUREMENT VBCM_AmbColorSta1_enum "" UBYTE SWC_FDC_type_CM_uint8_enum 0 0 0.0 255.0 ECU_ADDRESS 0x0000 /* @ECU_Address@VBCM_AmbColorSta1_enum@ */ /end MEASUREMENT
/begin MEASUREMENT VBCM_AmbColorSta2_enum "" UBYTE SWC_FDC_type_CM_uint8_enum 0 0 0.0 255.0 ECU_ADDRESS 0x0000 /* @ECU_Address@VBCM_AmbColorSta2_enum@ */ /end MEASUREMENT
/begin MEASUREMENT VBCM_AmbColorSta3_enum "" UBYTE SWC_FDC_type_CM_uint8_enum 0 0 0.0 255.0 ECU_ADDRESS 0x0000 /* @ECU_Address@VBCM_AmbColorSta3_enum@ */ /end MEASUREMENT
/begin MEASUREMENT VBCM_AmbColorSta4_enum "" UBYTE SWC_FDC_type_CM_uint8_enum 0 0 0.0 255.0 ECU_ADDRESS 0x0000 /* @ECU_Address@VBCM_AmbColorSta4_enum@ */ /end MEASUREMENT
/begin MEASUREMENT VBCM_AmbColorSta5_enum "" UBYTE SWC_FDC_type_CM_uint8_enum 0 0 0.0 255.0 ECU_ADDRESS 0x0000 /* @ECU_Address@VBCM_AmbColorSta5_enum@ */ /end MEASUREMENT
/begin MEASUREMENT VBCM_AmbColorSta7_enum "" UBYTE SWC_FDC_type_CM_uint8_enum 0 0 0.0 255.0 ECU_ADDRESS 0x0000 /* @ECU_Address@VBCM_AmbColorSta7_enum@ */ /end MEASUREMENT
/begin MEASUREMENT VBCM_AutoUnlockMem_enum "" UBYTE SWC_FDC_type_CM_uint8_enum 0 0 0.0 255.0 ECU_ADDRESS 0x0000 /* @ECU_Address@VBCM_AutoUnlockMem_enum@ */ /end MEASUREMENT
/begin MEASUREMENT VBCM_WalkInUnLkENMem_enum "" UBYTE SWC_FDC_type_CM_uint8_enum 0 0 0.0 255.0 ECU_ADDRESS 0x0000 /* @ECU_Address@VBCM_WalkInUnLkENMem_enum@ */ /end MEASUREMENT
/begin MEASUREMENT VBCM_WalkOutLkENMem_enum "" UBYTE SWC_FDC_type_CM_uint8_enum 0 0 0.0 255.0 ECU_ADDRESS 0x0000 /* @ECU_Address@VBCM_WalkOutLkENMem_enum@ */ /end MEASUREMENT
/begin MEASUREMENT VBCM_TurnSwTimeSetSta457_enum "" UBYTE SWC_FDC_type_CM_uint8_enum 0 0 0.0 255.0 ECU_ADDRESS 0x0000 /* @ECU_Address@VBCM_TurnSwTimeSetSta457_enum@ */ /end MEASUREMENT
/begin MEASUREMENT VBCM_TurnSwTimeSetSta123_enum "" UBYTE SWC_FDC_type_CM_uint8_enum 0 0 0.0 255.0 ECU_ADDRESS 0x0000 /* @ECU_Address@VBCM_TurnSwTimeSetSta123_enum@ */ /end MEASUREMENT
/begin MEASUREMENT VBCM_FollowMeENMem_enum "" UBYTE SWC_FDC_type_CM_uint8_enum 0 0 0.0 255.0 ECU_ADDRESS 0x0000 /* @ECU_Address@VBCM_FollowMeENMem_enum@ */ /end MEASUREMENT
/begin MEASUREMENT VBCM_LockSettingStaMem_enum "" UBYTE SWC_FDC_type_CM_uint8_enum 0 0 0.0 255.0 ECU_ADDRESS 0x0000 /* @ECU_Address@VBCM_LockSettingStaMem_enum@ */ /end MEASUREMENT
/begin MEASUREMENT VBCM_PTGOpenHeightSta_enum "" UBYTE SWC_FDC_type_CM_uint8_enum 0 0 0.0 255.0 ECU_ADDRESS 0x0000 /* @ECU_Address@VBCM_PTGOpenHeightSta_enum@ */ /end MEASUREMENT
/begin MEASUREMENT VBCM_PTGOpenHeight34_enum "" UBYTE SWC_FDC_type_CM_uint8_enum 0 0 0.0 255.0 ECU_ADDRESS 0x0000 /* @ECU_Address@VBCM_PTGOpenHeight34_enum@ */ /end MEASUREMENT
/begin MEASUREMENT VBCM_PTGOpenHeight12_enum "" UBYTE SWC_FDC_type_CM_uint8_enum 0 0 0.0 255.0 ECU_ADDRESS 0x0000 /* @ECU_Address@VBCM_PTGOpenHeight12_enum@ */ /end MEASUREMENT
/begin MEASUREMENT VBCM_PTGOpenHeight57_enum "" UBYTE SWC_FDC_type_CM_uint8_enum 0 0 0.0 255.0 ECU_ADDRESS 0x0000 /* @ECU_Address@VBCM_PTGOpenHeight57_enum@ */ /end MEASUREMENT
/begin MEASUREMENT VBCM_RmLpModeENMem_enum "" UBYTE SWC_FDC_type_CM_uint8_enum 0 0 0.0 255.0 ECU_ADDRESS 0x0000 /* @ECU_Address@VBCM_RmLpModeENMem_enum@ */ /end MEASUREMENT
/begin MEASUREMENT VBCM_SPTGENFunMem_enum "" UBYTE SWC_FDC_type_CM_uint8_enum 0 0 0.0 255.0 ECU_ADDRESS 0x0000 /* @ECU_Address@VBCM_SPTGENFunMem_enum@ */ /end MEASUREMENT
/begin MEASUREMENT VTPM_LFSensorFail_flg "" UBYTE SWC_FDC_type_CM_boolean_flg 0 0 0.0 1.0 ECU_ADDRESS 0x0000 /* @ECU_Address@VTPM_LFSensorFail_flg@ */ /end MEASUREMENT
/begin MEASUREMENT VTPM_RFSensorFail_flg "" UBYTE SWC_FDC_type_CM_boolean_flg 0 0 0.0 1.0 ECU_ADDRESS 0x0000 /* @ECU_Address@VTPM_RFSensorFail_flg@ */ /end MEASUREMENT
/begin MEASUREMENT VTPM_LRSensorFail_flg "" UBYTE SWC_FDC_type_CM_boolean_flg 0 0 0.0 1.0 ECU_ADDRESS 0x0000 /* @ECU_Address@VTPM_LRSensorFail_flg@ */ /end MEASUREMENT
/begin MEASUREMENT VTPM_RRSensorFail_flg "" UBYTE SWC_FDC_type_CM_boolean_flg 0 0 0.0 1.0 ECU_ADDRESS 0x0000 /* @ECU_Address@VTPM_RRSensorFail_flg@ */ /end MEASUREMENT
/begin MEASUREMENT VTPM_TPMSCaliButtAllow_flg "" UBYTE SWC_FDC_type_CM_boolean_flg 0 0 0.0 1.0 ECU_ADDRESS 0x0000 /* @ECU_Address@VTPM_TPMSCaliButtAllow_flg@ */ /end MEASUREMENT
/begin MEASUREMENT VTPM_TPMSResButtAllow_flg "" UBYTE SWC_FDC_type_CM_boolean_flg 0 0 0.0 1.0 ECU_ADDRESS 0x0000 /* @ECU_Address@VTPM_TPMSResButtAllow_flg@ */ /end MEASUREMENT
/begin MEASUREMENT VTPM_RRBatWarn_flg "" UBYTE SWC_FDC_type_CM_boolean_flg 0 0 0.0 1.0 ECU_ADDRESS 0x0000 /* @ECU_Address@VTPM_RRBatWarn_flg@ */ /end MEASUREMENT
/begin MEASUREMENT VTPM_RRWheelDebug_flg "" UBYTE SWC_FDC_type_CM_boolean_flg 0 0 0.0 1.0 ECU_ADDRESS 0x0000 /* @ECU_Address@VTPM_RRWheelDebug_flg@ */ /end MEASUREMENT
/begin MEASUREMENT VTPM_RRSensorMode_flg "" UBYTE SWC_FDC_type_CM_boolean_flg 0 0 0.0 1.0 ECU_ADDRESS 0x0000 /* @ECU_Address@VTPM_RRSensorMode_flg@ */ /end MEASUREMENT
/begin MEASUREMENT VTPM_RFBatWarn_flg "" UBYTE SWC_FDC_type_CM_boolean_flg 0 0 0.0 1.0 ECU_ADDRESS 0x0000 /* @ECU_Address@VTPM_RFBatWarn_flg@ */ /end MEASUREMENT
/begin MEASUREMENT VTPM_RFWheelDebug_flg "" UBYTE SWC_FDC_type_CM_boolean_flg 0 0 0.0 1.0 ECU_ADDRESS 0x0000 /* @ECU_Address@VTPM_RFWheelDebug_flg@ */ /end MEASUREMENT
/begin MEASUREMENT VTPM_RFSensorMode_flg "" UBYTE SWC_FDC_type_CM_boolean_flg 0 0 0.0 1.0 ECU_ADDRESS 0x0000 /* @ECU_Address@VTPM_RFSensorMode_flg@ */ /end MEASUREMENT
/begin MEASUREMENT VTPM_LRBatWarn_flg "" UBYTE SWC_FDC_type_CM_boolean_flg 0 0 0.0 1.0 ECU_ADDRESS 0x0000 /* @ECU_Address@VTPM_LRBatWarn_flg@ */ /end MEASUREMENT
/begin MEASUREMENT VTPM_LRWheelDebug_flg "" UBYTE SWC_FDC_type_CM_boolean_flg 0 0 0.0 1.0 ECU_ADDRESS 0x0000 /* @ECU_Address@VTPM_LRWheelDebug_flg@ */ /end MEASUREMENT
/begin MEASUREMENT VTPM_LRSensorMode_flg "" UBYTE SWC_FDC_type_CM_boolean_flg 0 0 0.0 1.0 ECU_ADDRESS 0x0000 /* @ECU_Address@VTPM_LRSensorMode_flg@ */ /end MEASUREMENT
/begin MEASUREMENT VTPM_LFBatWarn_flg "" UBYTE SWC_FDC_type_CM_boolean_flg 0 0 0.0 1.0 ECU_ADDRESS 0x0000 /* @ECU_Address@VTPM_LFBatWarn_flg@ */ /end MEASUREMENT
/begin MEASUREMENT VTPM_LFWheelDebug_flg "" UBYTE SWC_FDC_type_CM_boolean_flg 0 0 0.0 1.0 ECU_ADDRESS 0x0000 /* @ECU_Address@VTPM_LFWheelDebug_flg@ */ /end MEASUREMENT
/begin MEASUREMENT VTPM_LFSensorMode_flg "" UBYTE SWC_FDC_type_CM_boolean_flg 0 0 0.0 1.0 ECU_ADDRESS 0x0000 /* @ECU_Address@VTPM_LFSensorMode_flg@ */ /end MEASUREMENT
/begin MEASUREMENT VVMC_LDW1stTrigged_flg "" UBYTE SWC_FDC_type_CM_boolean_flg 0 0 0.0 1.0 ECU_ADDRESS 0x0000 /* @ECU_Address@VVMC_LDW1stTrigged_flg@ */ /end MEASUREMENT
/begin MEASUREMENT VVMC_LDWRestTrigged_flg "" UBYTE SWC_FDC_type_CM_boolean_flg 0 0 0.0 1.0 ECU_ADDRESS 0x0000 /* @ECU_Address@VVMC_LDWRestTrigged_flg@ */ /end MEASUREMENT
/begin MEASUREMENT VVMC_LDW2ndTrigged_flg "" UBYTE SWC_FDC_type_CM_boolean_flg 0 0 0.0 1.0 ECU_ADDRESS 0x0000 /* @ECU_Address@VVMC_LDW2ndTrigged_flg@ */ /end MEASUREMENT
/begin MEASUREMENT VVMC_4WheelSlide_flg "" UBYTE SWC_FDC_type_CM_boolean_flg 0 0 0.0 1.0 ECU_ADDRESS 0x0000 /* @ECU_Address@VVMC_4WheelSlide_flg@ */ /end MEASUREMENT
/begin MEASUREMENT VVMC_SlideRateEnCal_flg "" UBYTE SWC_FDC_type_CM_boolean_flg 0 0 0.0 1.0 ECU_ADDRESS 0x0000 /* @ECU_Address@VVMC_SlideRateEnCal_flg@ */ /end MEASUREMENT
/begin MEASUREMENT VVMC_OPDDisSlideRate_flg "" UBYTE SWC_FDC_type_CM_boolean_flg 0 0 0.0 1.0 ECU_ADDRESS 0x0000 /* @ECU_Address@VVMC_OPDDisSlideRate_flg@ */ /end MEASUREMENT
/begin MEASUREMENT VVMC_LDWRest2Trigged_flg "" UBYTE SWC_FDC_type_CM_boolean_flg 0 0 0.0 1.0 ECU_ADDRESS 0x0000 /* @ECU_Address@VVMC_LDWRest2Trigged_flg@ */ /end MEASUREMENT
/begin MEASUREMENT VTQR_ADASCancelBRgnRampF_flg "" UBYTE SWC_FDC_type_CM_boolean_flg 0 0 0.0 1.0 ECU_ADDRESS 0x0000 /* @ECU_Address@VTQR_ADASCancelBRgnRampF_flg@ */ /end MEASUREMENT
/begin MEASUREMENT VTQR_FrGearChange_flg "" UBYTE SWC_FDC_type_CM_boolean_flg 0 0 0.0 1.0 ECU_ADDRESS 0x0000 /* @ECU_Address@VTQR_FrGearChange_flg@ */ /end MEASUREMENT
/begin MEASUREMENT VTQR_ADASCancelBRgnRampR_flg "" UBYTE SWC_FDC_type_CM_boolean_flg 0 0 0.0 1.0 ECU_ADDRESS 0x0000 /* @ECU_Address@VTQR_ADASCancelBRgnRampR_flg@ */ /end MEASUREMENT
/begin MEASUREMENT VTQR_RrGearChange_flg "" UBYTE SWC_FDC_type_CM_boolean_flg 0 0 0.0 1.0 ECU_ADDRESS 0x0000 /* @ECU_Address@VTQR_RrGearChange_flg@ */ /end MEASUREMENT
/begin MEASUREMENT VTQR_FrRDCActiveTs_flg "" UBYTE SWC_FDC_type_CM_boolean_flg 0 0 0.0 1.0 ECU_ADDRESS 0x0000 /* @ECU_Address@VTQR_FrRDCActiveTs_flg@ */ /end MEASUREMENT
/begin MEASUREMENT VTQD_DriveProtEn_flg "" UBYTE SWC_FDC_type_CM_boolean_flg 0 0 0.0 1.0 ECU_ADDRESS 0x0000 /* @ECU_Address@VTQD_DriveProtEn_flg@ */ /end MEASUREMENT
/begin MEASUREMENT VTQD_DriveProtToPsnN_flg "" UBYTE SWC_FDC_type_CM_boolean_flg 0 0 0.0 1.0 ECU_ADDRESS 0x0000 /* @ECU_Address@VTQD_DriveProtToPsnN_flg@ */ /end MEASUREMENT
/begin MEASUREMENT VTQD_RollRegenEnable_flg "" UBYTE SWC_FDC_type_CM_boolean_flg 0 0 0.0 1.0 ECU_ADDRESS 0x0000 /* @ECU_Address@VTQD_RollRegenEnable_flg@ */ /end MEASUREMENT
/begin MEASUREMENT VTQD_OPDHoldEnRelease_flg "" UBYTE SWC_FDC_type_CM_boolean_flg 0 0 0.0 1.0 ECU_ADDRESS 0x0000 /* @ECU_Address@VTQD_OPDHoldEnRelease_flg@ */ /end MEASUREMENT
/begin MEASUREMENT VTQD_OPDHoldDisRelease_flg "" UBYTE SWC_FDC_type_CM_boolean_flg 0 0 0.0 1.0 ECU_ADDRESS 0x0000 /* @ECU_Address@VTQD_OPDHoldDisRelease_flg@ */ /end MEASUREMENT
/begin MEASUREMENT VTQD_AutoHoldRelease_flg "" UBYTE SWC_FDC_type_CM_boolean_flg 0 0 0.0 1.0 ECU_ADDRESS 0x0000 /* @ECU_Address@VTQD_AutoHoldRelease_flg@ */ /end MEASUREMENT
/begin MEASUREMENT VTQD_AntiBlockEnOPDHold_flg "" UBYTE SWC_FDC_type_CM_boolean_flg 0 0 0.0 1.0 ECU_ADDRESS 0x0000 /* @ECU_Address@VTQD_AntiBlockEnOPDHold_flg@ */ /end MEASUREMENT
/begin MEASUREMENT VTQD_OPDHoldDelayForP_flg "" UBYTE SWC_FDC_type_CM_boolean_flg 0 0 0.0 1.0 ECU_ADDRESS 0x0000 /* @ECU_Address@VTQD_OPDHoldDelayForP_flg@ */ /end MEASUREMENT
/begin MEASUREMENT VTQD_LFWhlSkip_flg "" UBYTE SWC_FDC_type_CM_boolean_flg 0 0 0.0 1.0 ECU_ADDRESS 0x0000 /* @ECU_Address@VTQD_LFWhlSkip_flg@ */ /end MEASUREMENT
/begin MEASUREMENT VTQD_RFWhlSkip_flg "" UBYTE SWC_FDC_type_CM_boolean_flg 0 0 0.0 1.0 ECU_ADDRESS 0x0000 /* @ECU_Address@VTQD_RFWhlSkip_flg@ */ /end MEASUREMENT
/begin MEASUREMENT VTQD_LRWhlSkip_flg "" UBYTE SWC_FDC_type_CM_boolean_flg 0 0 0.0 1.0 ECU_ADDRESS 0x0000 /* @ECU_Address@VTQD_LRWhlSkip_flg@ */ /end MEASUREMENT
/begin MEASUREMENT VTQD_RRWhlSkip_flg "" UBYTE SWC_FDC_type_CM_boolean_flg 0 0 0.0 1.0 ECU_ADDRESS 0x0000 /* @ECU_Address@VTQD_RRWhlSkip_flg@ */ /end MEASUREMENT
/begin MEASUREMENT VTQD_PosLeftWhlSkip_flg "" UBYTE SWC_FDC_type_CM_boolean_flg 0 0 0.0 1.0 ECU_ADDRESS 0x0000 /* @ECU_Address@VTQD_PosLeftWhlSkip_flg@ */ /end MEASUREMENT
/begin MEASUREMENT VTQD_NegLeftWhlSkip_flg "" UBYTE SWC_FDC_type_CM_boolean_flg 0 0 0.0 1.0 ECU_ADDRESS 0x0000 /* @ECU_Address@VTQD_NegLeftWhlSkip_flg@ */ /end MEASUREMENT
/begin MEASUREMENT VTQD_NegRightWhlSkip_flg "" UBYTE SWC_FDC_type_CM_boolean_flg 0 0 0.0 1.0 ECU_ADDRESS 0x0000 /* @ECU_Address@VTQD_NegRightWhlSkip_flg@ */ /end MEASUREMENT
/begin MEASUREMENT VTQD_PosFrontWhlSkip_flg "" UBYTE SWC_FDC_type_CM_boolean_flg 0 0 0.0 1.0 ECU_ADDRESS 0x0000 /* @ECU_Address@VTQD_PosFrontWhlSkip_flg@ */ /end MEASUREMENT
/begin MEASUREMENT VTQD_NegFrontWhlSkip_flg "" UBYTE SWC_FDC_type_CM_boolean_flg 0 0 0.0 1.0 ECU_ADDRESS 0x0000 /* @ECU_Address@VTQD_NegFrontWhlSkip_flg@ */ /end MEASUREMENT
/begin MEASUREMENT VTQD_PosRearWhlSkip_flg "" UBYTE SWC_FDC_type_CM_boolean_flg 0 0 0.0 1.0 ECU_ADDRESS 0x0000 /* @ECU_Address@VTQD_PosRearWhlSkip_flg@ */ /end MEASUREMENT
/begin MEASUREMENT VTQD_NegRearWhlSkip_flg "" UBYTE SWC_FDC_type_CM_boolean_flg 0 0 0.0 1.0 ECU_ADDRESS 0x0000 /* @ECU_Address@VTQD_NegRearWhlSkip_flg@ */ /end MEASUREMENT
/begin MEASUREMENT VTQD_PosLFRRWhlSkip_flg "" UBYTE SWC_FDC_type_CM_boolean_flg 0 0 0.0 1.0 ECU_ADDRESS 0x0000 /* @ECU_Address@VTQD_PosLFRRWhlSkip_flg@ */ /end MEASUREMENT
/begin MEASUREMENT VTQD_NegLFRRWhlSkip_flg "" UBYTE SWC_FDC_type_CM_boolean_flg 0 0 0.0 1.0 ECU_ADDRESS 0x0000 /* @ECU_Address@VTQD_NegLFRRWhlSkip_flg@ */ /end MEASUREMENT
/begin MEASUREMENT VTQD_PosRFLRWhlSkip_flg "" UBYTE SWC_FDC_type_CM_boolean_flg 0 0 0.0 1.0 ECU_ADDRESS 0x0000 /* @ECU_Address@VTQD_PosRFLRWhlSkip_flg@ */ /end MEASUREMENT
/begin MEASUREMENT VTQD_NegRFLRWhlSkip_flg "" UBYTE SWC_FDC_type_CM_boolean_flg 0 0 0.0 1.0 ECU_ADDRESS 0x0000 /* @ECU_Address@VTQD_NegRFLRWhlSkip_flg@ */ /end MEASUREMENT
/begin MEASUREMENT VTQD_FrontLRWhlSkip_flg "" UBYTE SWC_FDC_type_CM_boolean_flg 0 0 0.0 1.0 ECU_ADDRESS 0x0000 /* @ECU_Address@VTQD_FrontLRWhlSkip_flg@ */ /end MEASUREMENT
/begin MEASUREMENT VTQD_FrontRRWhlSkip_flg "" UBYTE SWC_FDC_type_CM_boolean_flg 0 0 0.0 1.0 ECU_ADDRESS 0x0000 /* @ECU_Address@VTQD_FrontRRWhlSkip_flg@ */ /end MEASUREMENT
/begin MEASUREMENT VTQD_RearLFWhlSkip_flg "" UBYTE SWC_FDC_type_CM_boolean_flg 0 0 0.0 1.0 ECU_ADDRESS 0x0000 /* @ECU_Address@VTQD_RearLFWhlSkip_flg@ */ /end MEASUREMENT
/begin MEASUREMENT VTQD_RearRFWhlSkip_flg "" UBYTE SWC_FDC_type_CM_boolean_flg 0 0 0.0 1.0 ECU_ADDRESS 0x0000 /* @ECU_Address@VTQD_RearRFWhlSkip_flg@ */ /end MEASUREMENT
/begin MEASUREMENT VTQD_AllWhlSkip_flg "" UBYTE SWC_FDC_type_CM_boolean_flg 0 0 0.0 1.0 ECU_ADDRESS 0x0000 /* @ECU_Address@VTQD_AllWhlSkip_flg@ */ /end MEASUREMENT
/begin MEASUREMENT VTQD_TripleWhlSkip_flg "" UBYTE SWC_FDC_type_CM_boolean_flg 0 0 0.0 1.0 ECU_ADDRESS 0x0000 /* @ECU_Address@VTQD_TripleWhlSkip_flg@ */ /end MEASUREMENT
/begin MEASUREMENT VTQD_DoubleWhlSkip_flg "" UBYTE SWC_FDC_type_CM_boolean_flg 0 0 0.0 1.0 ECU_ADDRESS 0x0000 /* @ECU_Address@VTQD_DoubleWhlSkip_flg@ */ /end MEASUREMENT
/begin MEASUREMENT VTQD_SingleWhlSkip_flg "" UBYTE SWC_FDC_type_CM_boolean_flg 0 0 0.0 1.0 ECU_ADDRESS 0x0000 /* @ECU_Address@VTQD_SingleWhlSkip_flg@ */ /end MEASUREMENT
/begin MEASUREMENT VTQD_APSStasysLow_flg "" UBYTE SWC_FDC_type_CM_boolean_flg 0 0 0.0 1.0 ECU_ADDRESS 0x0000 /* @ECU_Address@VTQD_APSStasysLow_flg@ */ /end MEASUREMENT
/begin MEASUREMENT VTQD_SlopeUp_flg "" UBYTE SWC_FDC_type_CM_boolean_flg 0 0 0.0 1.0 ECU_ADDRESS 0x0000 /* @ECU_Address@VTQD_SlopeUp_flg@ */ /end MEASUREMENT
/begin MEASUREMENT VTQD_ActHSAActive_flg "" UBYTE SWC_FDC_type_CM_boolean_flg 0 0 0.0 1.0 ECU_ADDRESS 0x0000 /* @ECU_Address@VTQD_ActHSAActive_flg@ */ /end MEASUREMENT
/begin MEASUREMENT VTQD_HighBPSPosn_flg "" UBYTE SWC_FDC_type_CM_boolean_flg 0 0 0.0 1.0 ECU_ADDRESS 0x0000 /* @ECU_Address@VTQD_HighBPSPosn_flg@ */ /end MEASUREMENT
/begin MEASUREMENT VTQD_TestLoSpdBrkCtrl_flg "" UBYTE SWC_FDC_type_CM_boolean_flg 0 0 0.0 1.0 ECU_ADDRESS 0x0000 /* @ECU_Address@VTQD_TestLoSpdBrkCtrl_flg@ */ /end MEASUREMENT
/begin MEASUREMENT VTQD_LoBrkCtrlReset_flg "" UBYTE SWC_FDC_type_CM_boolean_flg 0 0 0.0 1.0 ECU_ADDRESS 0x0000 /* @ECU_Address@VTQD_LoBrkCtrlReset_flg@ */ /end MEASUREMENT
/begin MEASUREMENT VTQD_WhlQuickSkip_flg "" UBYTE SWC_FDC_type_CM_boolean_flg 0 0 0.0 1.0 ECU_ADDRESS 0x0000 /* @ECU_Address@VTQD_WhlQuickSkip_flg@ */ /end MEASUREMENT
/begin MEASUREMENT VTQD_WhlSpdQuickSkip_flg "" UBYTE SWC_FDC_type_CM_boolean_flg 0 0 0.0 1.0 ECU_ADDRESS 0x0000 /* @ECU_Address@VTQD_WhlSpdQuickSkip_flg@ */ /end MEASUREMENT
/begin MEASUREMENT VTQD_OPDHoldPreLoadEn_flg "" UBYTE SWC_FDC_type_CM_boolean_flg 0 0 0.0 1.0 ECU_ADDRESS 0x0000 /* @ECU_Address@VTQD_OPDHoldPreLoadEn_flg@ */ /end MEASUREMENT
/begin MEASUREMENT VTQD_ShiftPreload_flg "" UBYTE SWC_FDC_type_CM_boolean_flg 0 0 0.0 1.0 ECU_ADDRESS 0x0000 /* @ECU_Address@VTQD_ShiftPreload_flg@ */ /end MEASUREMENT
/begin MEASUREMENT VTQD_ADASPreLoadHold_flg "" UBYTE SWC_FDC_type_CM_boolean_flg 0 0 0.0 1.0 ECU_ADDRESS 0x0000 /* @ECU_Address@VTQD_ADASPreLoadHold_flg@ */ /end MEASUREMENT
/begin MEASUREMENT VTQD_ADASPreLoadEn_flg "" UBYTE SWC_FDC_type_CM_boolean_flg 0 0 0.0 1.0 ECU_ADDRESS 0x0000 /* @ECU_Address@VTQD_ADASPreLoadEn_flg@ */ /end MEASUREMENT
/begin MEASUREMENT VTQD_PreLoadPreEn_flg "" UBYTE SWC_FDC_type_CM_boolean_flg 0 0 0.0 1.0 ECU_ADDRESS 0x0000 /* @ECU_Address@VTQD_PreLoadPreEn_flg@ */ /end MEASUREMENT
/begin MEASUREMENT VTQD_LowBPSPosn_flg "" UBYTE SWC_FDC_type_CM_boolean_flg 0 0 0.0 1.0 ECU_ADDRESS 0x0000 /* @ECU_Address@VTQD_LowBPSPosn_flg@ */ /end MEASUREMENT
/begin MEASUREMENT VTQD_RBCActiveRec_flg "" UBYTE SWC_FDC_type_CM_boolean_flg 0 0 0.0 1.0 ECU_ADDRESS 0x0000 /* @ECU_Address@VTQD_RBCActiveRec_flg@ */ /end MEASUREMENT
/begin MEASUREMENT VTQD_OPDCreepGrade_flg "" UBYTE SWC_FDC_type_CM_boolean_flg 0 0 0.0 1.0 ECU_ADDRESS 0x0000 /* @ECU_Address@VTQD_OPDCreepGrade_flg@ */ /end MEASUREMENT
/begin MEASUREMENT VTQD_MediumSkipDisRset_flg "" UBYTE SWC_FDC_type_CM_boolean_flg 0 0 0.0 1.0 ECU_ADDRESS 0x0000 /* @ECU_Address@VTQD_MediumSkipDisRset_flg@ */ /end MEASUREMENT
/begin MEASUREMENT VTQD_HighSkipDisRset_flg "" UBYTE SWC_FDC_type_CM_boolean_flg 0 0 0.0 1.0 ECU_ADDRESS 0x0000 /* @ECU_Address@VTQD_HighSkipDisRset_flg@ */ /end MEASUREMENT
/begin MEASUREMENT VTQD_OPDHoldUpDown_flg "" UBYTE SWC_FDC_type_CM_boolean_flg 0 0 0.0 1.0 ECU_ADDRESS 0x0000 /* @ECU_Address@VTQD_OPDHoldUpDown_flg@ */ /end MEASUREMENT
/begin MEASUREMENT VTQD_APSStasysUp_flg "" UBYTE SWC_FDC_type_CM_boolean_flg 0 0 0.0 1.0 ECU_ADDRESS 0x0000 /* @ECU_Address@VTQD_APSStasysUp_flg@ */ /end MEASUREMENT
/begin MEASUREMENT VTQD_CreepDisable_flg "" UBYTE SWC_FDC_type_CM_boolean_flg 0 0 0.0 1.0 ECU_ADDRESS 0x0000 /* @ECU_Address@VTQD_CreepDisable_flg@ */ /end MEASUREMENT
/begin MEASUREMENT VTQD_CreepEnable_flg "" UBYTE SWC_FDC_type_CM_boolean_flg 0 0 0.0 1.0 ECU_ADDRESS 0x0000 /* @ECU_Address@VTQD_CreepEnable_flg@ */ /end MEASUREMENT
/begin MEASUREMENT VTQD_ActBPSPosnInRange_flg "" UBYTE SWC_FDC_type_CM_boolean_flg 0 0 0.0 1.0 ECU_ADDRESS 0x0000 /* @ECU_Address@VTQD_ActBPSPosnInRange_flg@ */ /end MEASUREMENT
/begin MEASUREMENT VTQD_LowSkipDisRset_flg "" UBYTE SWC_FDC_type_CM_boolean_flg 0 0 0.0 1.0 ECU_ADDRESS 0x0000 /* @ECU_Address@VTQD_LowSkipDisRset_flg@ */ /end MEASUREMENT
/begin MEASUREMENT VTQD_CreepProtTqEn_flg "" UBYTE SWC_FDC_type_CM_boolean_flg 0 0 0.0 1.0 ECU_ADDRESS 0x0000 /* @ECU_Address@VTQD_CreepProtTqEn_flg@ */ /end MEASUREMENT
/begin MEASUREMENT VTQD_VehWeightEstEnCon1_flg "" UBYTE SWC_FDC_type_CM_boolean_flg 0 0 0.0 1.0 ECU_ADDRESS 0x0000 /* @ECU_Address@VTQD_VehWeightEstEnCon1_flg@ */ /end MEASUREMENT
/begin MEASUREMENT VTQD_VehWeightEstEnCon2_flg "" UBYTE SWC_FDC_type_CM_boolean_flg 0 0 0.0 1.0 ECU_ADDRESS 0x0000 /* @ECU_Address@VTQD_VehWeightEstEnCon2_flg@ */ /end MEASUREMENT
/begin MEASUREMENT VTQD_VehWeightEstEnCon3_flg "" UBYTE SWC_FDC_type_CM_boolean_flg 0 0 0.0 1.0 ECU_ADDRESS 0x0000 /* @ECU_Address@VTQD_VehWeightEstEnCon3_flg@ */ /end MEASUREMENT
/begin MEASUREMENT VTQD_VehWeightEstEnCon4_flg "" UBYTE SWC_FDC_type_CM_boolean_flg 0 0 0.0 1.0 ECU_ADDRESS 0x0000 /* @ECU_Address@VTQD_VehWeightEstEnCon4_flg@ */ /end MEASUREMENT
/begin MEASUREMENT VTQD_VehWeightEstEnCon5_flg "" UBYTE SWC_FDC_type_CM_boolean_flg 0 0 0.0 1.0 ECU_ADDRESS 0x0000 /* @ECU_Address@VTQD_VehWeightEstEnCon5_flg@ */ /end MEASUREMENT
/begin MEASUREMENT VTQD_VehWeightEstEnCon6_flg "" UBYTE SWC_FDC_type_CM_boolean_flg 0 0 0.0 1.0 ECU_ADDRESS 0x0000 /* @ECU_Address@VTQD_VehWeightEstEnCon6_flg@ */ /end MEASUREMENT
/begin MEASUREMENT VTQD_VehWeightEstEnCon7_flg "" UBYTE SWC_FDC_type_CM_boolean_flg 0 0 0.0 1.0 ECU_ADDRESS 0x0000 /* @ECU_Address@VTQD_VehWeightEstEnCon7_flg@ */ /end MEASUREMENT
/begin MEASUREMENT VTQD_VehWeightEstEnCon8_flg "" UBYTE SWC_FDC_type_CM_boolean_flg 0 0 0.0 1.0 ECU_ADDRESS 0x0000 /* @ECU_Address@VTQD_VehWeightEstEnCon8_flg@ */ /end MEASUREMENT
/begin MEASUREMENT VTQD_VehWeightEstEnCon9_flg "" UBYTE SWC_FDC_type_CM_boolean_flg 0 0 0.0 1.0 ECU_ADDRESS 0x0000 /* @ECU_Address@VTQD_VehWeightEstEnCon9_flg@ */ /end MEASUREMENT
/begin MEASUREMENT VTQD_VehWeightEstEnCon10_flg "" UBYTE SWC_FDC_type_CM_boolean_flg 0 0 0.0 1.0 ECU_ADDRESS 0x0000 /* @ECU_Address@VTQD_VehWeightEstEnCon10_flg@ */ /end MEASUREMENT
/begin MEASUREMENT VTQD_VehWeightEstEnCon11_flg "" UBYTE SWC_FDC_type_CM_boolean_flg 0 0 0.0 1.0 ECU_ADDRESS 0x0000 /* @ECU_Address@VTQD_VehWeightEstEnCon11_flg@ */ /end MEASUREMENT
/begin MEASUREMENT VTQD_VehWeightEstEnCon12_flg "" UBYTE SWC_FDC_type_CM_boolean_flg 0 0 0.0 1.0 ECU_ADDRESS 0x0000 /* @ECU_Address@VTQD_VehWeightEstEnCon12_flg@ */ /end MEASUREMENT
/begin MEASUREMENT VTQD_VehWeightEstDis_flg "" UBYTE SWC_FDC_type_CM_boolean_flg 0 0 0.0 1.0 ECU_ADDRESS 0x0000 /* @ECU_Address@VTQD_VehWeightEstDis_flg@ */ /end MEASUREMENT
/begin MEASUREMENT VTQD_VehWeightEstEnter_flg "" UBYTE SWC_FDC_type_CM_boolean_flg 0 0 0.0 1.0 ECU_ADDRESS 0x0000 /* @ECU_Address@VTQD_VehWeightEstEnter_flg@ */ /end MEASUREMENT
/begin MEASUREMENT VTQD_FrMotorTempHigh_flg "" UBYTE SWC_FDC_type_CM_boolean_flg 0 0 0.0 1.0 ECU_ADDRESS 0x0000 /* @ECU_Address@VTQD_FrMotorTempHigh_flg@ */ /end MEASUREMENT
/begin MEASUREMENT VTQD_RrMotorTempHigh_flg "" UBYTE SWC_FDC_type_CM_boolean_flg 0 0 0.0 1.0 ECU_ADDRESS 0x0000 /* @ECU_Address@VTQD_RrMotorTempHigh_flg@ */ /end MEASUREMENT
/begin MEASUREMENT VTQD_APSDecReqA_flg "" UBYTE SWC_FDC_type_CM_boolean_flg 0 0 0.0 1.0 ECU_ADDRESS 0x0000 /* @ECU_Address@VTQD_APSDecReqA_flg@ */ /end MEASUREMENT
/begin MEASUREMENT VTQD_APSDecReqMax_flg "" UBYTE SWC_FDC_type_CM_boolean_flg 0 0 0.0 1.0 ECU_ADDRESS 0x0000 /* @ECU_Address@VTQD_APSDecReqMax_flg@ */ /end MEASUREMENT
/begin MEASUREMENT VTQD_ActParkRequest_flg "" UBYTE SWC_FDC_type_CM_boolean_flg 0 0 0.0 1.0 ECU_ADDRESS 0x0000 /* @ECU_Address@VTQD_ActParkRequest_flg@ */ /end MEASUREMENT
/begin MEASUREMENT VTQD_OPDHoldLamp_flg "" UBYTE SWC_FDC_type_CM_boolean_flg 0 0 0.0 1.0 ECU_ADDRESS 0x0000 /* @ECU_Address@VTQD_OPDHoldLamp_flg@ */ /end MEASUREMENT
/begin MEASUREMENT VTQD_EstVehWeitResetFinish_flg "" UBYTE SWC_FDC_type_CM_boolean_flg 0 0 0.0 1.0 ECU_ADDRESS 0x0000 /* @ECU_Address@VTQD_EstVehWeitResetFinish_flg@ */ /end MEASUREMENT
/begin MEASUREMENT VTQD_HoldtimeEnd_flg "" UBYTE SWC_FDC_type_CM_boolean_flg 0 0 0.0 1.0 ECU_ADDRESS 0x0000 /* @ECU_Address@VTQD_HoldtimeEnd_flg@ */ /end MEASUREMENT
/begin MEASUREMENT VTQD_SpdCtrlShortP_flg "" UBYTE SWC_FDC_type_CM_boolean_flg 0 0 0.0 1.0 ECU_ADDRESS 0x0000 /* @ECU_Address@VTQD_SpdCtrlShortP_flg@ */ /end MEASUREMENT
/begin MEASUREMENT VTQD_SpdCtrlLongP_flg "" UBYTE SWC_FDC_type_CM_boolean_flg 0 0 0.0 1.0 ECU_ADDRESS 0x0000 /* @ECU_Address@VTQD_SpdCtrlLongP_flg@ */ /end MEASUREMENT
/begin MEASUREMENT VTQD_LScrollPressLong_flg "" UBYTE SWC_FDC_type_CM_boolean_flg 0 0 0.0 1.0 ECU_ADDRESS 0x0000 /* @ECU_Address@VTQD_LScrollPressLong_flg@ */ /end MEASUREMENT
/begin MEASUREMENT VTQD_LScrollPressShort_flg "" UBYTE SWC_FDC_type_CM_boolean_flg 0 0 0.0 1.0 ECU_ADDRESS 0x0000 /* @ECU_Address@VTQD_LScrollPressShort_flg@ */ /end MEASUREMENT
/begin MEASUREMENT VDHP_EAPS1Learned_flg "" UBYTE SWC_FDC_type_CM_boolean_flg 0 0 0.0 1.0 ECU_ADDRESS 0x0000 /* @ECU_Address@VDHP_EAPS1Learned_flg@ */ /end MEASUREMENT
/begin MEASUREMENT VDHP_EAPS2Learned_flg "" UBYTE SWC_FDC_type_CM_boolean_flg 0 0 0.0 1.0 ECU_ADDRESS 0x0000 /* @ECU_Address@VDHP_EAPS2Learned_flg@ */ /end MEASUREMENT
/begin MEASUREMENT VBCM_SPTGENFun_flg "" UBYTE SWC_FDC_type_CM_boolean_flg 0 0 0.0 1.0 ECU_ADDRESS 0x0000 /* @ECU_Address@VBCM_SPTGENFun_flg@ */ /end MEASUREMENT
/begin MEASUREMENT VBCM_WalkInUnLkENFunSta_flg "" UBYTE SWC_FDC_type_CM_boolean_flg 0 0 0.0 1.0 ECU_ADDRESS 0x0000 /* @ECU_Address@VBCM_WalkInUnLkENFunSta_flg@ */ /end MEASUREMENT
/begin MEASUREMENT VBCM_FollowMeENFunSta_flg "" UBYTE SWC_FDC_type_CM_boolean_flg 0 0 0.0 1.0 ECU_ADDRESS 0x0000 /* @ECU_Address@VBCM_FollowMeENFunSta_flg@ */ /end MEASUREMENT
/begin MEASUREMENT VBCM_AmbFunEN_flg "" UBYTE SWC_FDC_type_CM_boolean_flg 0 0 0.0 1.0 ECU_ADDRESS 0x0000 /* @ECU_Address@VBCM_AmbFunEN_flg@ */ /end MEASUREMENT
/begin MEASUREMENT VBCM_AmbWelEN_flg "" UBYTE SWC_FDC_type_CM_boolean_flg 0 0 0.0 1.0 ECU_ADDRESS 0x0000 /* @ECU_Address@VBCM_AmbWelEN_flg@ */ /end MEASUREMENT
/begin MEASUREMENT VBCM_AmbDimEN_flg "" UBYTE SWC_FDC_type_CM_boolean_flg 0 0 0.0 1.0 ECU_ADDRESS 0x0000 /* @ECU_Address@VBCM_AmbDimEN_flg@ */ /end MEASUREMENT
/begin MEASUREMENT VBCM_AmbODAEN_flg "" UBYTE SWC_FDC_type_CM_boolean_flg 0 0 0.0 1.0 ECU_ADDRESS 0x0000 /* @ECU_Address@VBCM_AmbODAEN_flg@ */ /end MEASUREMENT
/begin MEASUREMENT VBCM_AmbPwrWarnEN_flg "" UBYTE SWC_FDC_type_CM_boolean_flg 0 0 0.0 1.0 ECU_ADDRESS 0x0000 /* @ECU_Address@VBCM_AmbPwrWarnEN_flg@ */ /end MEASUREMENT
/begin MEASUREMENT VBCM_AmbLinkDriSta_flg "" UBYTE SWC_FDC_type_CM_boolean_flg 0 0 0.0 1.0 ECU_ADDRESS 0x0000 /* @ECU_Address@VBCM_AmbLinkDriSta_flg@ */ /end MEASUREMENT
/begin MEASUREMENT VBCM_LockSetting_flg "" UBYTE SWC_FDC_type_CM_boolean_flg 0 0 0.0 1.0 ECU_ADDRESS 0x0000 /* @ECU_Address@VBCM_LockSetting_flg@ */ /end MEASUREMENT
/begin MEASUREMENT VBCM_RmLpModeENFunSta_flg "" UBYTE SWC_FDC_type_CM_boolean_flg 0 0 0.0 1.0 ECU_ADDRESS 0x0000 /* @ECU_Address@VBCM_RmLpModeENFunSta_flg@ */ /end MEASUREMENT
/begin MEASUREMENT VVMC_RRWhlSpeedRollAveRaw_kph "" FLOAT32_IEEE SWC_FDC_type_CM_single_kph 0 0 0.0 255.0 ECU_ADDRESS 0x0000 /* @ECU_Address@VVMC_RRWhlSpeedRollAveRaw_kph@ */ /end MEASUREMENT
/begin MEASUREMENT VVMC_LRWhlSpeedRollAveRaw_kph "" FLOAT32_IEEE SWC_FDC_type_CM_single_kph 0 0 0.0 255.0 ECU_ADDRESS 0x0000 /* @ECU_Address@VVMC_LRWhlSpeedRollAveRaw_kph@ */ /end MEASUREMENT
/begin MEASUREMENT VVMC_RFWhlSpeedRollAveRaw_kph "" FLOAT32_IEEE SWC_FDC_type_CM_single_kph 0 0 0.0 255.0 ECU_ADDRESS 0x0000 /* @ECU_Address@VVMC_RFWhlSpeedRollAveRaw_kph@ */ /end MEASUREMENT
/begin MEASUREMENT VVMC_LFWhlSpeedRollAveRaw_kph "" FLOAT32_IEEE SWC_FDC_type_CM_single_kph 0 0 0.0 255.0 ECU_ADDRESS 0x0000 /* @ECU_Address@VVMC_LFWhlSpeedRollAveRaw_kph@ */ /end MEASUREMENT
/begin MEASUREMENT VVMC_VehSpdRollAveRaw_kph "" FLOAT32_IEEE SWC_FDC_type_CM_single_kph 0 0 0.0 255.0 ECU_ADDRESS 0x0000 /* @ECU_Address@VVMC_VehSpdRollAveRaw_kph@ */ /end MEASUREMENT
/begin MEASUREMENT VVMC_LatAccRollAveRaw_Gps "" FLOAT32_IEEE SWC_FDC_type_CM_single_Gps 0 0 -1.27 1.27 ECU_ADDRESS 0x0000 /* @ECU_Address@VVMC_LatAccRollAveRaw_Gps@ */ /end MEASUREMENT
/begin MEASUREMENT VVMC_CalEstPitchAngle_deg "" FLOAT32_IEEE SWC_FDC_type_CM_single_deg 0 0 -90.0 90.0 ECU_ADDRESS 0x0000 /* @ECU_Address@VVMC_CalEstPitchAngle_deg@ */ /end MEASUREMENT
/begin MEASUREMENT VVMC_VehSpdRollAve_kph "" FLOAT32_IEEE SWC_FDC_type_CM_single_kph 0 0 0.0 255.0 ECU_ADDRESS 0x0000 /* @ECU_Address@VVMC_VehSpdRollAve_kph@ */ /end MEASUREMENT
/begin MEASUREMENT VVMC_LatAccRollAve_Gps "" FLOAT32_IEEE SWC_FDC_type_CM_single_Gps 0 0 -1.27 1.27 ECU_ADDRESS 0x0000 /* @ECU_Address@VVMC_LatAccRollAve_Gps@ */ /end MEASUREMENT
/begin MEASUREMENT VVMC_FrontRearSlipRatioCtrl_flg "" UBYTE SWC_FDC_type_CM_boolean_flg 0 0 0.0 1.0 ECU_ADDRESS 0x0000 /* @ECU_Address@VVMC_FrontRearSlipRatioCtrl_flg@ */ /end MEASUREMENT
/begin MEASUREMENT VVMC_RearWhlSlipRatioCtrl_flg "" UBYTE SWC_FDC_type_CM_boolean_flg 0 0 0.0 1.0 ECU_ADDRESS 0x0000 /* @ECU_Address@VVMC_RearWhlSlipRatioCtrl_flg@ */ /end MEASUREMENT
/begin MEASUREMENT VVMC_SingleWhlSlipRatioCtrl_flg "" UBYTE SWC_FDC_type_CM_boolean_flg 0 0 0.0 1.0 ECU_ADDRESS 0x0000 /* @ECU_Address@VVMC_SingleWhlSlipRatioCtrl_flg@ */ /end MEASUREMENT
/begin MEASUREMENT VVMC_LatAccCtrl_flg "" UBYTE SWC_FDC_type_CM_boolean_flg 0 0 0.0 1.0 ECU_ADDRESS 0x0000 /* @ECU_Address@VVMC_LatAccCtrl_flg@ */ /end MEASUREMENT
/begin MEASUREMENT VVMC_VehPitchAngleUpdCond_flg "" UBYTE SWC_FDC_type_CM_boolean_flg 0 0 0.0 1.0 ECU_ADDRESS 0x0000 /* @ECU_Address@VVMC_VehPitchAngleUpdCond_flg@ */ /end MEASUREMENT
/begin COMPU_METHOD SWC_FDC_type_CM_single_C "Q = V" RAT_FUNC "%8.6" "C" COEFFS 0 1 0 0 0 1 /end COMPU_METHOD
/begin COMPU_METHOD SWC_FDC_type_CM_uint8_enum "Q = V" RAT_FUNC "%3.0" "enum" COEFFS 0 1 0 0 0 1 /end COMPU_METHOD
/begin COMPU_METHOD SWC_FDC_type_CM_single_kph "Q = V" RAT_FUNC "%8.6" "kph" COEFFS 0 1 0 0 0 1 /end COMPU_METHOD
/begin COMPU_METHOD SWC_FDC_type_CM_single_Gps "Q = V" RAT_FUNC "%8.6" "Gps" COEFFS 0 1 0 0 0 1 /end COMPU_METHOD
/begin COMPU_METHOD SWC_FDC_type_CM_single_c "Q = V" RAT_FUNC "%8.6" "c" COEFFS 0 1 0 0 0 1 /end COMPU_METHOD
/begin COMPU_METHOD SWC_FDC_type_CM_single_deg "Q = V" RAT_FUNC "%8.6" "deg" COEFFS 0 1 0 0 0 1 /end COMPU_METHOD
/begin COMPU_METHOD SWC_FDC_type_CM_single_pct "Q = V" RAT_FUNC "%8.6" "pct" COEFFS 0 1 0 0 0 1 /end COMPU_METHOD
/begin COMPU_METHOD SWC_FDC_type_CM_single_s "Q = V" RAT_FUNC "%8.6" "s" COEFFS 0 1 0 0 0 1 /end COMPU_METHOD
/begin COMPU_METHOD SWC_FDC_type_CM_single_enum "Q = V" RAT_FUNC "%8.6" "enum" COEFFS 0 1 0 0 0 1 /end COMPU_METHOD
/begin COMPU_METHOD SWC_FDC_type_CM_single_W "Q = V" RAT_FUNC "%8.6" "W" COEFFS 0 1 0 0 0 1 /end COMPU_METHOD
/begin COMPU_METHOD SWC_FDC_type_CM_single_Deg "Q = V" RAT_FUNC "%8.6" "Deg" COEFFS 0 1 0 0 0 1 /end COMPU_METHOD
/begin COMPU_METHOD SWC_FDC_type_CM_single_rpm "Q = V" RAT_FUNC "%8.6" "rpm" COEFFS 0 1 0 0 0 1 /end COMPU_METHOD
/begin COMPU_METHOD SWC_FDC_type_CM_single_kg "Q = V" RAT_FUNC "%8.6" "kg" COEFFS 0 1 0 0 0 1 /end COMPU_METHOD
/begin COMPU_METHOD SWC_FDC_type_CM_single_Nm "Q = V" RAT_FUNC "%8.6" "Nm" COEFFS 0 1 0 0 0 1 /end COMPU_METHOD
/begin COMPU_METHOD SWC_FDC_type_CM_single_gain "Q = V" RAT_FUNC "%8.6" "gain" COEFFS 0 1 0 0 0 1 /end COMPU_METHOD
/begin COMPU_METHOD SWC_FDC_type_CM_single_mps2 "Q = V" RAT_FUNC "%8.6" "mps2" COEFFS 0 1 0 0 0 1 /end COMPU_METHOD
/begin COMPU_METHOD SWC_FDC_type_CM_single_K "Q = V" RAT_FUNC "%8.6" "K" COEFFS 0 1 0 0 0 1 /end COMPU_METHOD
/begin COMPU_METHOD SWC_FDC_type_CM_single_kmh "Q = V" RAT_FUNC "%8.6" "kmh" COEFFS 0 1 0 0 0 1 /end COMPU_METHOD
/begin COMPU_METHOD SWC_FDC_type_CM_single_degps "Q = V" RAT_FUNC "%8.6" "degps" COEFFS 0 1 0 0 0 1 /end COMPU_METHOD
/begin COMPU_METHOD SWC_FDC_type_CM_single_sec "Q = V" RAT_FUNC "%8.6" "sec" COEFFS 0 1 0 0 0 1 /end COMPU_METHOD
/begin COMPU_METHOD SWC_FDC_type_CM_single_m "Q = V" RAT_FUNC "%8.6" "m" COEFFS 0 1 0 0 0 1 /end COMPU_METHOD
/begin COMPU_METHOD SWC_FDC_type_CM_single_flg "Q = V" RAT_FUNC "%8.6" "flg" COEFFS 0 1 0 0 0 1 /end COMPU_METHOD
/begin COMPU_METHOD SWC_FDC_type_CM_single_raw32 "Q = V" RAT_FUNC "%8.6" "raw32" COEFFS 0 1 0 0 0 1 /end COMPU_METHOD
/begin COMPU_METHOD SWC_FDC_type_CM_int16_W "Q = V" RAT_FUNC "%5.0" "W" COEFFS 0 1 0 0 0 1 /end COMPU_METHOD
/begin COMPU_METHOD SWC_FDC_type_CM_uint16_cnt "Q = V" RAT_FUNC "%5.0" "cnt" COEFFS 0 1 0 0 0 1 /end COMPU_METHOD
/begin COMPU_METHOD SWC_FDC_type_CM_uint16_W "Q = V" RAT_FUNC "%5.0" "W" COEFFS 0 1 0 0 0 1 /end COMPU_METHOD
/begin COMPU_METHOD SWC_FDC_type_CM_boolean_flg "Q = V" RAT_FUNC "%1.0" "flg" COEFFS 0 1 0 0 0 1 /end COMPU_METHOD
/begin COMPU_METHOD SWC_FDC_type_CM_boolean "Q = V" RAT_FUNC "%1.0" "" COEFFS 0 1 0 0 0 1 /end COMPU_METHOD
/begin COMPU_METHOD SWC_FDC_type_CM_uint8_cnt "Q = V" RAT_FUNC "%3.0" "cnt" COEFFS 0 1 0 0 0 1 /end COMPU_METHOD
/begin COMPU_METHOD SWC_FDC_type_CM_uint8_kph "Q = V" RAT_FUNC "%3.0" "kph" COEFFS 0 1 0 0 0 1 /end COMPU_METHOD
/begin COMPU_METHOD SWC_FDC_type_CM_uint8_raw8 "Q = V" RAT_FUNC "%3.0" "raw8" COEFFS 0 1 0 0 0 1 /end COMPU_METHOD
/begin COMPU_METHOD SWC_FDC_type_CM_uint8_mph "Q = V" RAT_FUNC "%3.0" "mph" COEFFS 0 1 0 0 0 1 /end COMPU_METHOD
/begin COMPU_METHOD SWC_FDC_type_CM_uint8_raw "Q = V" RAT_FUNC "%3.0" "raw" COEFFS 0 1 0 0 0 1 /end COMPU_METHOD
/begin COMPU_METHOD SWC_FDC_type_CM_uint8_c "Q = V" RAT_FUNC "%3.0" "c" COEFFS 0 1 0 0 0 1 /end COMPU_METHOD
/begin GROUP S1923_FirstOrderFilter4 "SWC_FDC_type/run_SWC_FDC_RxTx_5ms_sys/APP/VMC/VMC/SafetyControl/FirstOrderFilter4" /begin REF_MEASUREMENT VVMC_LatAccRollAve_Gps /end REF_MEASUREMENT /end GROUP
/begin GROUP S1923_FirstOrderFilter6 "SWC_FDC_type/run_SWC_FDC_RxTx_5ms_sys/APP/VMC/VMC/SafetyControl/FirstOrderFilter6" /begin REF_MEASUREMENT VVMC_VehSpdRollAve_kph /end REF_MEASUREMENT /end GROUP
/begin GROUP S1923_FirstOrderFilter7 "SWC_FDC_type/run_SWC_FDC_RxTx_5ms_sys/APP/VMC/VMC/SafetyControl/FirstOrderFilter7" /begin REF_MEASUREMENT VVMC_CalEstPitchAngle_deg /end REF_MEASUREMENT /end GROUP
/begin GROUP S1923_LatAccRollingAverage "SWC_FDC_type/run_SWC_FDC_RxTx_5ms_sys/APP/VMC/VMC/SafetyControl/LatAccRollingAverage" /begin REF_CHARACTERISTIC KVMC_LatAccRollAveLevel_enum /end REF_CHARACTERISTIC /begin REF_MEASUREMENT VVMC_LatAccRollAveRaw_Gps /end REF_MEASUREMENT /end GROUP
/begin GROUP S1923_SR_Latch4 "SWC_FDC_type/run_SWC_FDC_RxTx_5ms_sys/APP/VMC/VMC/SafetyControl/SR_Latch4" /begin REF_MEASUREMENT VVMC_VehPitchAngleUpdCond_flg /end REF_MEASUREMENT /end GROUP
/begin GROUP S1923_SafetyControlJudgement "SWC_FDC_type/run_SWC_FDC_RxTx_5ms_sys/APP/VMC/VMC/SafetyControl/SafetyControlJudgement"
 /begin SUB_GROUP S2124_FrontRearSlipRatio S2124_LateralAccelerationControl S2124_RearWheelSlipRatio S2124_SafetyControlJudgement S2124_SingleWheelSlipRatio /end SUB_GROUP
 /begin REF_CHARACTERISTIC KVMC_SafetyCtrlAllowTime_s /end REF_CHARACTERISTIC
 /begin REF_MEASUREMENT VVMC_FrontRearSlipRatioCtrl_flg VVMC_LatAccCtrl_flg VVMC_RearWhlSlipRatioCtrl_flg VVMC_SingleWhlSlipRatioCtrl_flg /end REF_MEASUREMENT
/end GROUP
/begin GROUP S1923_VehSpdRollingAverage "SWC_FDC_type/run_SWC_FDC_RxTx_5ms_sys/APP/VMC/VMC/SafetyControl/VehSpdRollingAverage" /begin REF_CHARACTERISTIC KVMC_VehSpdRollAveLevel_enum /end REF_CHARACTERISTIC /begin REF_MEASUREMENT VVMC_VehSpdRollAveRaw_kph /end REF_MEASUREMENT /end GROUP
/begin GROUP S1923_WheelSpeedRollingAverage "SWC_FDC_type/run_SWC_FDC_RxTx_5ms_sys/APP/VMC/VMC/SafetyControl/WheelSpeedRollingAverage" /begin REF_CHARACTERISTIC KVMC_WhlSpdRollAveLevel_enum /end REF_CHARACTERISTIC
 /begin REF_MEASUREMENT VVMC_LFWhlSpeedRollAveRaw_kph VVMC_LRWhlSpeedRollAveRaw_kph VVMC_RFWhlSpeedRollAveRaw_kph VVMC_RRWhlSpeedRollAveRaw_kph /end REF_MEASUREMENT
/end GROUP
/begin GROUP S1925_4Wheel_Calculation "SWC_FDC_type/run_SWC_FDC_RxTx_5ms_sys/APP/VMC/VMC/Slide Rate  Calculation/4Wheel Calculation"
 /begin SUB_GROUP S2147_Determination S2147_LF_Wheel S2147_LR_Wheel S2147_RF_Wheel S2147_RR_Wheel /end SUB_GROUP
 /begin REF_CHARACTERISTIC KVMC_4WheelLongAccSW_flg /end REF_CHARACTERISTIC
 /begin REF_MEASUREMENT VVMC_4WheelLongAcc_Gps /end REF_MEASUREMENT
/end GROUP
/begin GROUP S1925_Alternative_Wheel_Slide_Calculation "SWC_FDC_type/run_SWC_FDC_RxTx_5ms_sys/APP/VMC/VMC/Slide Rate  Calculation/Alternative Wheel Slide Calculation" /begin REF_CHARACTERISTIC KVMC_RawWhlSpeedDeadZone_kph /end REF_CHARACTERISTIC
 /begin REF_MEASUREMENT VVMC_AltLWhlSlideRate_pct VVMC_AltRWhlSlideRate_pct VVMC_AltWhlSlideRate_pct VVMC_CalAltLWhlSlideRate_pct VVMC_CalAltRWhlSlideRate_pct /end REF_MEASUREMENT
/end GROUP
/begin GROUP S1925_Coordination "SWC_FDC_type/run_SWC_FDC_RxTx_5ms_sys/APP/VMC/VMC/Slide Rate  Calculation/Coordination"
 /begin SUB_GROUP S2149_DelayEnable S2149_FirstOrderFilter S2149_FirstOrderFilter1 S2149_FirstOrderFilter2 S2149_FirstOrderFilter3 S2149_FirstOrderFilter4 /end SUB_GROUP
 /begin REF_CHARACTERISTIC KTQD_OPDHoldGradeDown_Deg KTQD_OPDHoldGradeUp_Deg KVMC_4WhlSlideVehSpdDev_kph KVMC_4WhleelSlideDetTime_s KVMC_AltWheelSlideRateSW_flg KVMC_CalWhleelSlideTs_c KVMC_OPDDisSlideRateSpd_kph KVMC_WhlSlideEnDetBrkPedal_pct KVMC_WhlSlideEnDetTq_Nm KVMC_WhlSlideEnDetVehSpd_kph MVMC_OPDDisSlideRate_Y_pct /end REF_CHARACTERISTIC
 /begin REF_MEASUREMENT VVMC_4WheelSlide_flg VVMC_ActMaxSlideRate_pct VVMC_OPDDisSlideRate_flg VVMC_OPDDisSlideRate_pct VVMC_SlideRateEnCal_flg /end REF_MEASUREMENT
/end GROUP
/begin GROUP S1925_Partial_Wheel_Calculation "SWC_FDC_type/run_SWC_FDC_RxTx_5ms_sys/APP/VMC/VMC/Slide Rate  Calculation/Partial Wheel Calculation" /begin REF_CHARACTERISTIC KVMC_RawWhlSpeedDeadZone_kph /end REF_CHARACTERISTIC
 /begin REF_MEASUREMENT VVMC_LFCalWhlSpdSlideRate_pct VVMC_LFWhlSpdSlideRate_pct VVMC_LRCalWhlSpdSlideRate_pct VVMC_LRWhlSpdSlideRate_pct VVMC_MaxRawWhlSpeed_kph VVMC_MinRawWhlSpeed_kph VVMC_RFCalWhlSpdSlideRate_pct VVMC_RFWhlSpdSlideRate_pct VVMC_RRCalWhlSpdSlideRate_pct VVMC_RRWhlSpdSlideRate_pct VVMC_RawCalWhlSpdSlideRate_pct VVMC_RawWhlSpdSlideRate_pct /end REF_MEASUREMENT
/end GROUP
/begin GROUP S1926_Response_Gain "SWC_FDC_type/run_SWC_FDC_RxTx_5ms_sys/APP/VMC/VMC/SpeedArbitration/Response Gain"
 /begin REF_CHARACTERISTIC KVMC_MSAResponseAGSV_flg MVMC_AggressJerkPCT4AT_Y_pct MVMC_AggressJerkPCT_Y_pct MVMC_AggressLimitPCT4AT_Y_pct MVMC_AggressLimitPCT_Y_pct MVMC_SoftJerkPCT_Y_pct MVMC_SoftLimitPCT_Y_pct /end REF_CHARACTERISTIC
 /begin REF_MEASUREMENT VVMC_AggressJerkPCT_pct VVMC_AggressLimitPCT_pct VVMC_SoftJerkPCT_pct VVMC_SoftLimitPCT_pct /end REF_MEASUREMENT
/end GROUP
/begin GROUP S1927_FirstOrderFilter6 "SWC_FDC_type/run_SWC_FDC_RxTx_5ms_sys/APP/VMC/VMC/SpeedCalculation/FirstOrderFilter6" /begin REF_MEASUREMENT VVMC_MeterSpdRollAve_kph /end REF_MEASUREMENT /end GROUP
/begin GROUP S1928_SR_Latch3 "SWC_FDC_type/run_SWC_FDC_RxTx_5ms_sys/APP/VMC/VMC/VMC_FCM1/SR_Latch3" /begin REF_MEASUREMENT VVMC_LDW1stTrigged_flg /end REF_MEASUREMENT /end GROUP
/begin GROUP S1928_SR_Latch4 "SWC_FDC_type/run_SWC_FDC_RxTx_5ms_sys/APP/VMC/VMC/VMC_FCM1/SR_Latch4" /begin REF_MEASUREMENT VVMC_LDWRestTrigged_flg /end REF_MEASUREMENT /end GROUP
/begin GROUP S1928_SR_Latch5 "SWC_FDC_type/run_SWC_FDC_RxTx_5ms_sys/APP/VMC/VMC/VMC_FCM1/SR_Latch5" /begin REF_MEASUREMENT VVMC_LDW2ndTrigged_flg /end REF_MEASUREMENT /end GROUP
/begin GROUP S1928_SR_Latch6 "SWC_FDC_type/run_SWC_FDC_RxTx_5ms_sys/APP/VMC/VMC/VMC_FCM1/SR_Latch6" /begin REF_MEASUREMENT VVMC_LDWRest2Trigged_flg /end REF_MEASUREMENT /end GROUP
/begin GROUP S152_VALUE_TYPE_ACC "SWC_FDC_type/run_SWC_FDC_RxTx_5ms_sys/APP/BCM/BCM/Personal_Setting/ACC/VALUE_TYPE_ACC"
 /begin REF_MEASUREMENT VBCM_ACCLevelMem12_enum VBCM_ACCLevelMem34_enum VBCM_ACCLevelMem57_enum /end REF_MEASUREMENT
/end GROUP
/begin GROUP S153_TOGGLE_TYPE_AmbDimEN "SWC_FDC_type/run_SWC_FDC_RxTx_5ms_sys/APP/BCM/BCM/Personal_Setting/AmbLight/TOGGLE_TYPE_AmbDimEN" /begin REF_MEASUREMENT VBCM_AmbDimENFlash_enum VBCM_AmbDimEN_flg /end REF_MEASUREMENT /end GROUP
/begin GROUP S153_TOGGLE_TYPE_AmbFunEN "SWC_FDC_type/run_SWC_FDC_RxTx_5ms_sys/APP/BCM/BCM/Personal_Setting/AmbLight/TOGGLE_TYPE_AmbFunEN" /begin REF_MEASUREMENT VBCM_AmbFunENFlash_enum VBCM_AmbFunEN_flg /end REF_MEASUREMENT /end GROUP
/begin GROUP S153_TOGGLE_TYPE_AmbLinkDriSta "SWC_FDC_type/run_SWC_FDC_RxTx_5ms_sys/APP/BCM/BCM/Personal_Setting/AmbLight/TOGGLE_TYPE_AmbLinkDriSta" /begin REF_MEASUREMENT VBCM_AmbLinkDriStaFlash_enum VBCM_AmbLinkDriSta_flg /end REF_MEASUREMENT /end GROUP
/begin GROUP S153_TOGGLE_TYPE_AmbODAEN "SWC_FDC_type/run_SWC_FDC_RxTx_5ms_sys/APP/BCM/BCM/Personal_Setting/AmbLight/TOGGLE_TYPE_AmbODAEN" /begin REF_MEASUREMENT VBCM_AmbODAENFlash_enum VBCM_AmbODAEN_flg /end REF_MEASUREMENT /end GROUP
/begin GROUP S153_TOGGLE_TYPE_AmbPwrWarnEN "SWC_FDC_type/run_SWC_FDC_RxTx_5ms_sys/APP/BCM/BCM/Personal_Setting/AmbLight/TOGGLE_TYPE_AmbPwrWarnEN" /begin REF_MEASUREMENT VBCM_AmbPwrWarnENFlash_enum VBCM_AmbPwrWarnEN_flg /end REF_MEASUREMENT /end GROUP
/begin GROUP S153_TOGGLE_TYPE_AmbWelEN "SWC_FDC_type/run_SWC_FDC_RxTx_5ms_sys/APP/BCM/BCM/Personal_Setting/AmbLight/TOGGLE_TYPE_AmbWelEN" /begin REF_MEASUREMENT VBCM_AmbWelENFlash_enum VBCM_AmbWelEN_flg /end REF_MEASUREMENT /end GROUP
/begin GROUP S153_VALUE_TYPE_AmbBrightnessSta "SWC_FDC_type/run_SWC_FDC_RxTx_5ms_sys/APP/BCM/BCM/Personal_Setting/AmbLight/VALUE_TYPE_AmbBrightnessSta"
 /begin REF_MEASUREMENT VBCM_AmbBrightSta_enum VBCM_AmbBrightnessSta1_enum VBCM_AmbBrightnessSta2_enum VBCM_AmbBrightnessSta3_enum VBCM_AmbBrightnessSta4_enum VBCM_AmbBrightnessSta5_enum VBCM_AmbBrightnessSta7_enum /end REF_MEASUREMENT
/end GROUP
/begin GROUP S153_VALUE_TYPE_AmbColorSta "SWC_FDC_type/run_SWC_FDC_RxTx_5ms_sys/APP/BCM/BCM/Personal_Setting/AmbLight/VALUE_TYPE_AmbColorSta"
 /begin REF_MEASUREMENT VBCM_AmbColorSta1_enum VBCM_AmbColorSta2_enum VBCM_AmbColorSta3_enum VBCM_AmbColorSta4_enum VBCM_AmbColorSta5_enum VBCM_AmbColorSta7_enum VBCM_AmbColorSta_enum /end REF_MEASUREMENT
/end GROUP
/begin GROUP S154_TOGGLE_TYPE_AutoUnlock "SWC_FDC_type/run_SWC_FDC_RxTx_5ms_sys/APP/BCM/BCM/Personal_Setting/Autolock/TOGGLE_TYPE_AutoUnlock" /begin REF_MEASUREMENT VBCM_AutoUnlockMem_enum /end REF_MEASUREMENT /end GROUP
/begin GROUP S155_TOGGLE_TYPE_WalkInUnlock "SWC_FDC_type/run_SWC_FDC_RxTx_5ms_sys/APP/BCM/BCM/Personal_Setting/DKC_Lock_Setting/TOGGLE_TYPE_WalkInUnlock" /begin REF_MEASUREMENT VBCM_WalkInUnLkENFunSta_flg VBCM_WalkInUnLkENMem_enum /end REF_MEASUREMENT /end GROUP
/begin GROUP S155_TOGGLE_TYPE_WalkOutLock "SWC_FDC_type/run_SWC_FDC_RxTx_5ms_sys/APP/BCM/BCM/Personal_Setting/DKC_Lock_Setting/TOGGLE_TYPE_WalkOutLock" /begin REF_MEASUREMENT VBCM_WalkOutLkENMem_enum /end REF_MEASUREMENT /end GROUP
/begin GROUP S156_VALUE_TYPE_FlasherSignal "SWC_FDC_type/run_SWC_FDC_RxTx_5ms_sys/APP/BCM/BCM/Personal_Setting/FlasherSignal/VALUE_TYPE_FlasherSignal"
 /begin REF_MEASUREMENT VBCM_TurnSwTSetSta_enum VBCM_TurnSwTimeSetSta123_enum VBCM_TurnSwTimeSetSta457_enum /end REF_MEASUREMENT
/end GROUP
/begin GROUP S157_LockSetting "SWC_FDC_type/run_SWC_FDC_RxTx_5ms_sys/APP/BCM/BCM/Personal_Setting/FollowMeHome/LockSetting" /begin REF_MEASUREMENT VBCM_FollowMeENFunSta_flg VBCM_FollowMeENMem_enum /end REF_MEASUREMENT /end GROUP
/begin GROUP S158_LockSetting "SWC_FDC_type/run_SWC_FDC_RxTx_5ms_sys/APP/BCM/BCM/Personal_Setting/LockSetting/LockSetting" /begin REF_MEASUREMENT VBCM_LockSettingStaMem_enum VBCM_LockSetting_flg /end REF_MEASUREMENT /end GROUP
/begin GROUP S159_VALUE_TYPE_FlasherSignal "SWC_FDC_type/run_SWC_FDC_RxTx_5ms_sys/APP/BCM/BCM/Personal_Setting/PTG/VALUE_TYPE_FlasherSignal"
 /begin REF_MEASUREMENT VBCM_PTGOpenHeight12_enum VBCM_PTGOpenHeight34_enum VBCM_PTGOpenHeight57_enum VBCM_PTGOpenHeightSta_enum /end REF_MEASUREMENT
/end GROUP
/begin GROUP S159_VALUE_TYPE_PTGUserSetMaxHeight "SWC_FDC_type/run_SWC_FDC_RxTx_5ms_sys/APP/BCM/BCM/Personal_Setting/PTG/VALUE_TYPE_PTGUserSetMaxHeight"
 /begin REF_MEASUREMENT VBCM_PTGUserHeight1_cnt VBCM_PTGUserHeight2_cnt VBCM_PTGUserHeight3_cnt VBCM_PTGUserHeight4_cnt VBCM_PTGUserHeight5_cnt VBCM_PTGUserHeight7_cnt VBCM_UserHeightSet_cnt /end REF_MEASUREMENT
/end GROUP
/begin GROUP S160_TOGGLE_TYPE_RoomLampMode "SWC_FDC_type/run_SWC_FDC_RxTx_5ms_sys/APP/BCM/BCM/Personal_Setting/RoomLamp/TOGGLE_TYPE_RoomLampMode" /begin REF_MEASUREMENT VBCM_RmLpModeENFunSta_flg VBCM_RmLpModeENMem_enum /end REF_MEASUREMENT /end GROUP
/begin GROUP S161_TOGGLE_TYPE_AmbFunEN "SWC_FDC_type/run_SWC_FDC_RxTx_5ms_sys/APP/BCM/BCM/Personal_Setting/SPTG/TOGGLE_TYPE_AmbFunEN" /begin REF_MEASUREMENT VBCM_SPTGENFunMem_enum VBCM_SPTGENFun_flg /end REF_MEASUREMENT /end GROUP
/begin GROUP S321_Latch1 "SWC_FDC_type/run_SWC_FDC_RxTx_5ms_sys/APP/DHP/DHP/APS_calaulation/ZPLearn/Latch1" /begin REF_MEASUREMENT VDHP_EAPS2Learned_flg /end REF_MEASUREMENT /end GROUP
/begin GROUP S321_Latch2 "SWC_FDC_type/run_SWC_FDC_RxTx_5ms_sys/APP/DHP/DHP/APS_calaulation/ZPLearn/Latch2" /begin REF_MEASUREMENT VDHP_EAPS1Learned_flg /end REF_MEASUREMENT /end GROUP
/begin GROUP S881_APTCPWMControl "SWC_FDC_type/run_SWC_FDC_RxTx_5ms_sys/APP/THC/ThermalControl/THCM_Conctrl/APTC/APTCPWMControl" /begin REF_CHARACTERISTIC KTHC_APTCPeriod_cnt /end REF_CHARACTERISTIC /end GROUP
/begin GROUP S881_APTCPWMControl1 "SWC_FDC_type/run_SWC_FDC_RxTx_5ms_sys/APP/THC/ThermalControl/THCM_Conctrl/APTC/APTCPWMControl1" /begin REF_CHARACTERISTIC KTHC_APTCPeriod_cnt /end REF_CHARACTERISTIC /end GROUP
/begin GROUP S881_APTCPWMControl2 "SWC_FDC_type/run_SWC_FDC_RxTx_5ms_sys/APP/THC/ThermalControl/THCM_Conctrl/APTC/APTCPWMControl2" /begin REF_CHARACTERISTIC KTHC_APTCPeriod_cnt /end REF_CHARACTERISTIC /end GROUP
/begin GROUP S881_Subsystem "SWC_FDC_type/run_SWC_FDC_RxTx_5ms_sys/APP/THC/ThermalControl/THCM_Conctrl/APTC/Subsystem"
 /begin REF_CHARACTERISTIC KTHC_APTCOneZoneMax_W KTHC_APTCRiLeMaxDff_W KTHC_APTCRiLeMinDff_W MTHC_Qeq_Y_K /end REF_CHARACTERISTIC
/end GROUP
/begin GROUP S882_Enabled_Subsystem1 "SWC_FDC_type/run_SWC_FDC_RxTx_5ms_sys/APP/THC/ThermalControl/THCM_Conctrl/BlowerCtrl/Enabled Subsystem1"
 /begin REF_CHARACTERISTIC KTHC_VBlowerMid_K KTHC_VBlowerSetLow_K KTHC_VBlowerdfog_K MTHC_VbaseC_Z_K MTHC_VbaseD_Y_K MTHC_VbaseH_Y_K /end REF_CHARACTERISTIC
/end GROUP
/begin GROUP S886_Enabled_Subsystem "SWC_FDC_type/run_SWC_FDC_RxTx_5ms_sys/APP/THC/ThermalControl/THCM_Conctrl/CompCtrl/Enabled Subsystem"
 /begin REF_CHARACTERISTIC KTHC_DTymin1_K KTHC_DTymin2_K KTHC_DTymin3_K KTHC_DTymin4_K KTHC_DTymin5_K KTHC_T1Maxamb_C KTHC_T2Maxamb_C KTHC_T2Minamb_C KTHC_T3Maxamb_C KTHC_T3Minamb_C KTHC_T4Maxamb_C KTHC_T4Minamb_C KTHC_T5Minamb_C KTHC_Tambmin_C /end REF_CHARACTERISTIC
/end GROUP
/begin GROUP S886_Enabled_Subsystem1 "SWC_FDC_type/run_SWC_FDC_RxTx_5ms_sys/APP/THC/ThermalControl/THCM_Conctrl/CompCtrl/Enabled Subsystem1"
 /begin REF_CHARACTERISTIC KTHC_T1winSetpointBC_C KTHC_T2winSetpointBC_C KTHC_T4winSetpointBC_C KTHC_T5winSetpointBC_C /end REF_CHARACTERISTIC
/end GROUP
/begin GROUP S930_Subsystem1 "SWC_FDC_type/run_SWC_FDC_RxTx_5ms_sys/APP/THC/ThermalControl/THCM_Conctrl/Subsystem3/Subsystem1"
 /begin REF_CHARACTERISTIC KTHC_EWPErrHandleEN_flg KTHC_EWPErrorT_cnt KTHC_EWPRetryWarnT_cnt KTHC_EWPTotalRetryT_cnt KTHC_EWPpauseT_cnt KTHC_EWPretryT_cnt /end REF_CHARACTERISTIC
/end GROUP
/begin GROUP S930_Subsystem2 "SWC_FDC_type/run_SWC_FDC_RxTx_5ms_sys/APP/THC/ThermalControl/THCM_Conctrl/Subsystem3/Subsystem2"
 /begin REF_CHARACTERISTIC KTHC_EWPErrHandleEN_flg KTHC_EWPErrorT_cnt KTHC_EWPRetryWarnT_cnt KTHC_EWPTotalRetryT_cnt KTHC_EWPpauseT_cnt KTHC_EWPretryT_cnt /end REF_CHARACTERISTIC
/end GROUP
/begin GROUP S930_Subsystem3 "SWC_FDC_type/run_SWC_FDC_RxTx_5ms_sys/APP/THC/ThermalControl/THCM_Conctrl/Subsystem3/Subsystem3"
 /begin REF_CHARACTERISTIC KTHC_EWPErrHandleEN_flg KTHC_EWPErrorT_cnt KTHC_EWPRetryWarnT_cnt KTHC_EWPTotalRetryT_cnt KTHC_EWPpauseT_cnt KTHC_EWPretryT_cnt /end REF_CHARACTERISTIC
/end GROUP
/begin GROUP S1053_AutoLocation "SWC_FDC_type/run_SWC_FDC_RxTx_5ms_sys/APP/TPM/TPMS/TPMS/Learn/AutoLocation"
 /begin SUB_GROUP S1057_Doublecheck S1057_IDIdentify S1057_IDtrans S1057_Subsystem S1057_Subsystem1 S1057_WheelPosition /end SUB_GROUP
/end GROUP
/begin GROUP S1053_LowerTirePressureCalibration "SWC_FDC_type/run_SWC_FDC_RxTx_5ms_sys/APP/TPM/TPMS/TPMS/Learn/LowerTirePressureCalibration"
 /begin REF_MEASUREMENT VTPM_C_cnt VTPM_LFPindi_enum VTPM_LFWheelPSW_raw8 VTPM_LRPindi_enum VTPM_LRWheelPSW_raw8 VTPM_ManualID1P20_raw8 VTPM_ManualID2P20_raw8 VTPM_ManualID3P20_raw8 VTPM_ManualID4P20_raw8 VTPM_ManualP1alarm_raw VTPM_ManualP2alarm_raw VTPM_ManualP3alarm_raw VTPM_ManualP4alarm_raw VTPM_ManualS1pressindi_enum VTPM_ManualS2pressindi_enum VTPM_ManualS3pressindi_enum VTPM_ManualS4pressindi_enum VTPM_RFPind_enum VTPM_RFWheelPSW_raw8 VTPM_RRPindi_enum VTPM_RRWheelPSW_raw8 VTPM_Spressindi_enum /end REF_MEASUREMENT
/end GROUP
/begin GROUP S1054_Alarm "SWC_FDC_type/run_SWC_FDC_RxTx_5ms_sys/APP/TPM/TPMS/TPMS/Send/Alarm"
 /begin SUB_GROUP S1204_LFTHighWarn S1204_LRTHighWarn S1204_RFTHighWarn S1204_RRTHighWarn /end SUB_GROUP
 /begin REF_MEASUREMENT VTPM_AutoLTips_enum VTPM_CWheelTips_enum VTPM_LFPressIndi_enum VTPM_LRPressIndi_enum VTPM_RFPressIndi_enum VTPM_RRPressIndi_enum VTPM_TPMSWarnIndi_enum /end REF_MEASUREMENT
/end GROUP
/begin GROUP S1054_DATA "SWC_FDC_type/run_SWC_FDC_RxTx_5ms_sys/APP/TPM/TPMS/TPMS/Send/DATA"
 /begin REF_MEASUREMENT VTPM_LFBatWarn_flg VTPM_LFP20_raw8 VTPM_LFSensorFail_flg VTPM_LFSensorMode_flg VTPM_LFWheelDebug_flg VTPM_LFWheelPress_raw8 VTPM_LFWheelTemp_C VTPM_LRBatWarn_flg VTPM_LRP20_raw8 VTPM_LRSensorFail_flg VTPM_LRSensorMode_flg VTPM_LRWheelDebug_flg VTPM_LRWheelPress_raw8 VTPM_LRWheelTemp_C VTPM_Prepresstempvalid_enum VTPM_RFBatWarn_flg VTPM_RFP20_raw8 VTPM_RFSensorFail_flg VTPM_RFSensorMode_flg VTPM_RFWheelDebug_flg VTPM_RFWheelPress_raw8 VTPM_RFWheelTemp_C VTPM_RRBatWarn_flg VTPM_RRP20_raw8 VTPM_RRSensorFail_flg VTPM_RRSensorMode_flg VTPM_RRWheelDebug_flg VTPM_RRWheelPress_raw8 VTPM_RRWheelTemp_C /end REF_MEASUREMENT
/end GROUP
/begin GROUP S1054_ResetAllow_CalibrateAllow "SWC_FDC_type/run_SWC_FDC_RxTx_5ms_sys/APP/TPM/TPMS/TPMS/Send/ResetAllow&CalibrateAllow" /begin REF_CHARACTERISTIC KTPM_DataInVehSpdThreshold_kph /end REF_CHARACTERISTIC /begin REF_MEASUREMENT VTPM_TPMSCaliButtAllow_flg VTPM_TPMSResButtAllow_flg /end REF_MEASUREMENT /end GROUP
/begin GROUP S1284_Drive_Protection "SWC_FDC_type/run_SWC_FDC_RxTx_5ms_sys/APP/TQD/TorqueDemand/ShiftModule/GearShiftPosn/Drive Protection" /begin SUB_GROUP S1298_DelayEnable /end SUB_GROUP
 /begin REF_CHARACTERISTIC KTQD_DrivProtEnSW_flg KTQD_DrivProtEnToNTq_Nm KTQD_DriveProtDetTime_s /end REF_CHARACTERISTIC
 /begin REF_MEASUREMENT VTQD_DriveProtEn_flg VTQD_DriveProtToPsnN_flg /end REF_MEASUREMENT
/end GROUP
/begin GROUP S1317_RegenDOWN "SWC_FDC_type/run_SWC_FDC_RxTx_5ms_sys/APP/TQD/TorqueDemand/Signal_convert/Regen Level Switch Botton/RegenDOWN" /begin REF_CHARACTERISTIC KTQD_RegLongPLim_s KTQD_RegShortPLim_s /end REF_CHARACTERISTIC /end GROUP
/begin GROUP S1317_RegenUP "SWC_FDC_type/run_SWC_FDC_RxTx_5ms_sys/APP/TQD/TorqueDemand/Signal_convert/Regen Level Switch Botton/RegenUP" /begin REF_CHARACTERISTIC KTQD_RegLongPLim_s KTQD_RegShortPLim_s /end REF_CHARACTERISTIC /end GROUP
/begin GROUP S1324_L_ScrollPress_Behavior "SWC_FDC_type/run_SWC_FDC_RxTx_5ms_sys/APP/TQD/TorqueDemand/Signal_convert/SWC2_Subsystem/L_ScrollPress Behavior"
 /begin REF_CHARACTERISTIC KTQD_SpdModeLongPCancelLim_s KTQD_SpdModeLongPLim_s KTQD_SpdModeShortPLim_s /end REF_CHARACTERISTIC
 /begin REF_MEASUREMENT VTQD_LScrollPressLong_flg VTQD_LScrollPressShort_flg /end REF_MEASUREMENT
/end GROUP
/begin GROUP S1324_Road_Speed_Limit_Convert "SWC_FDC_type/run_SWC_FDC_RxTx_5ms_sys/APP/TQD/TorqueDemand/Signal_convert/SWC2_Subsystem/Road Speed Limit Convert"
 /begin REF_CHARACTERISTIC KTQD_ACCActiveMetSpdLoMPH_mph KTQD_ACCActiveMetSpdLo_kph KTQD_SpdLimOffsetOn_flg /end REF_CHARACTERISTIC
 /begin REF_MEASUREMENT VTQD_CalRoadSpdLimOffSet_c VTQD_CalRoadSpdLim_raw32 VTQD_RoadSpdLim_raw32 /end REF_MEASUREMENT
/end GROUP
/begin GROUP S1324_Speed_Setting_Mode "SWC_FDC_type/run_SWC_FDC_RxTx_5ms_sys/APP/TQD/TorqueDemand/Signal_convert/SWC2_Subsystem/Speed Setting Mode"
 /begin SUB_GROUP S1355_ACC_Speed_Setting_ON S1355_CC_Speed_Setting_ON S1355_ISA_Speed_Setting_ON S1355_MSA_Speed_Setting_ON S1355_SWC2ScrollDownSta S1355_SWC2ScrollUpSta /end SUB_GROUP
 /begin REF_CHARACTERISTIC KTQD_SCPMemSpdTest_flg KTQD_SetSpdDeltaLongFit_kph KTQD_SmartEcoLimitSpd_kph KTQD_SmartEcoLimitSpd_mph KTQD_SpdCtrlModeChgHoldTime_s /end REF_CHARACTERISTIC
/end GROUP
/begin GROUP S1325_SpdCtrlBotton_Behavior "SWC_FDC_type/run_SWC_FDC_RxTx_5ms_sys/APP/TQD/TorqueDemand/Signal_convert/SWC_Subsystem/SpdCtrlBotton Behavior" /begin REF_CHARACTERISTIC KTQD_SpdModeLongPLim_s KTQD_SpdModeShortPLim_s /end REF_CHARACTERISTIC /begin REF_MEASUREMENT VTQD_SpdCtrlLongP_flg VTQD_SpdCtrlShortP_flg /end REF_MEASUREMENT /end GROUP
/begin GROUP S1325_Speed_Setting_Mode "SWC_FDC_type/run_SWC_FDC_RxTx_5ms_sys/APP/TQD/TorqueDemand/Signal_convert/SWC_Subsystem/Speed Setting Mode"
 /begin SUB_GROUP S1394_ACC_Speed_Setting_ON S1394_CC_Speed_Setting_ON S1394_ISA_Speed_Setting_ON S1394_MSA_Speed_Setting_ON S1394_VTQD_SWCCancelP_flg S1394_VTQD_SWCResUpPress_enum S1394_VTQD_SWCSetDownPress_enum /end SUB_GROUP
 /begin REF_CHARACTERISTIC KTQD_SetSpdDeltaLongFit_kph KTQD_SmartEcoLimitSpd_kph KTQD_SmartEcoLimitSpd_mph /end REF_CHARACTERISTIC
 /begin REF_MEASUREMENT VTQD_SetSpdDeltaLongFit_kph /end REF_MEASUREMENT
/end GROUP
/begin GROUP S1325_Vehicle_to_Meter_Speed "SWC_FDC_type/run_SWC_FDC_RxTx_5ms_sys/APP/TQD/TorqueDemand/Signal_convert/SWC_Subsystem/Vehicle to Meter Speed" /begin REF_CHARACTERISTIC KTQD_Veh2MetSpdAdd_kph KTQD_Veh2MetSpdGain_c /end REF_CHARACTERISTIC /end GROUP
/begin GROUP S1326_RateLimit "SWC_FDC_type/run_SWC_FDC_RxTx_5ms_sys/APP/TQD/TorqueDemand/Signal_convert/Simulation Sound Wave /RateLimit" /begin REF_MEASUREMENT VTQD_SimSouWaveReq_pct /end REF_MEASUREMENT /end GROUP
/begin GROUP S1327_Calaulation "SWC_FDC_type/run_SWC_FDC_RxTx_5ms_sys/APP/TQD/TorqueDemand/Signal_convert/VehWeightEst/Calaulation"
 /begin SUB_GROUP S1427_Front_Wheel_Torque S1427_Long_Acc S1427_Rear_Wheel_Torque S1427_Vehicle_Weight /end SUB_GROUP
/end GROUP
/begin GROUP S1327_Condition "SWC_FDC_type/run_SWC_FDC_RxTx_5ms_sys/APP/TQD/TorqueDemand/Signal_convert/VehWeightEst/Condition" /begin SUB_GROUP S1428_DelayEnable S1428_Timer1 /end SUB_GROUP
 /begin REF_CHARACTERISTIC KTQD_EstDelayEnTime_s KTQD_EstWeighResetTime_s KTQD_FrTqDeviation_Nm KTQD_RrTqDeviation_Nm KTQD_VehWeighEstTime_s KTQD_VehWeightEstGradeEn_Deg KTQD_VehWeightEstSpdEnLow_kph KTQD_VehWeightEstSpdEnUp_kph /end REF_CHARACTERISTIC
 /begin REF_MEASUREMENT VTQD_EstVehWeitResetFinish_flg VTQD_FrTqErr_Nm VTQD_RrTqErr_Nm VTQD_VehWeightEstDis_flg VTQD_VehWeightEstEnCon10_flg VTQD_VehWeightEstEnCon11_flg VTQD_VehWeightEstEnCon12_flg VTQD_VehWeightEstEnCon1_flg VTQD_VehWeightEstEnCon2_flg VTQD_VehWeightEstEnCon3_flg VTQD_VehWeightEstEnCon4_flg VTQD_VehWeightEstEnCon5_flg VTQD_VehWeightEstEnCon6_flg VTQD_VehWeightEstEnCon7_flg VTQD_VehWeightEstEnCon8_flg VTQD_VehWeightEstEnCon9_flg /end REF_MEASUREMENT
/end GROUP
/begin GROUP S1327_Desicion "SWC_FDC_type/run_SWC_FDC_RxTx_5ms_sys/APP/TQD/TorqueDemand/Signal_convert/VehWeightEst/Desicion" /begin SUB_GROUP S1429_DelayEnable /end SUB_GROUP /begin REF_CHARACTERISTIC KTQD_EstEndDelayTime_s MTQD_EstInitVehWeight_Y_kg /end REF_CHARACTERISTIC
 /begin REF_MEASUREMENT VTQD_EstActVehWeight_kg VTQD_EstInitVehWeight_kg VTQD_EstInitVehWightX_c VTQD_EstVehWeightResult_kg VTQD_VehWeightEstEnter_flg /end REF_MEASUREMENT
/end GROUP
/begin GROUP S1328_SR_Latch "SWC_FDC_type/run_SWC_FDC_RxTx_5ms_sys/APP/TQD/TorqueDemand/Signal_convert/Wheel Status Judgment/SR_Latch" /begin REF_MEASUREMENT VTQD_LFWhlSkip_flg /end REF_MEASUREMENT /end GROUP
/begin GROUP S1328_SR_Latch1 "SWC_FDC_type/run_SWC_FDC_RxTx_5ms_sys/APP/TQD/TorqueDemand/Signal_convert/Wheel Status Judgment/SR_Latch1" /begin REF_MEASUREMENT VTQD_RFWhlSkip_flg /end REF_MEASUREMENT /end GROUP
/begin GROUP S1328_SR_Latch10 "SWC_FDC_type/run_SWC_FDC_RxTx_5ms_sys/APP/TQD/TorqueDemand/Signal_convert/Wheel Status Judgment/SR_Latch10" /begin REF_MEASUREMENT VTQD_NegRightWhlSkip_flg /end REF_MEASUREMENT /end GROUP
/begin GROUP S1328_SR_Latch11 "SWC_FDC_type/run_SWC_FDC_RxTx_5ms_sys/APP/TQD/TorqueDemand/Signal_convert/Wheel Status Judgment/SR_Latch11" /begin REF_MEASUREMENT VTQD_PosFrontWhlSkip_flg /end REF_MEASUREMENT /end GROUP
/begin GROUP S1328_SR_Latch12 "SWC_FDC_type/run_SWC_FDC_RxTx_5ms_sys/APP/TQD/TorqueDemand/Signal_convert/Wheel Status Judgment/SR_Latch12" /begin REF_MEASUREMENT VTQD_NegFrontWhlSkip_flg /end REF_MEASUREMENT /end GROUP
/begin GROUP S1328_SR_Latch13 "SWC_FDC_type/run_SWC_FDC_RxTx_5ms_sys/APP/TQD/TorqueDemand/Signal_convert/Wheel Status Judgment/SR_Latch13" /begin REF_MEASUREMENT VTQD_PosRearWhlSkip_flg /end REF_MEASUREMENT /end GROUP
/begin GROUP S1328_SR_Latch14 "SWC_FDC_type/run_SWC_FDC_RxTx_5ms_sys/APP/TQD/TorqueDemand/Signal_convert/Wheel Status Judgment/SR_Latch14" /begin REF_MEASUREMENT VTQD_NegRearWhlSkip_flg /end REF_MEASUREMENT /end GROUP
/begin GROUP S1328_SR_Latch15 "SWC_FDC_type/run_SWC_FDC_RxTx_5ms_sys/APP/TQD/TorqueDemand/Signal_convert/Wheel Status Judgment/SR_Latch15" /begin REF_MEASUREMENT VTQD_DoubleWhlSkip_flg /end REF_MEASUREMENT /end GROUP
/begin GROUP S1328_SR_Latch16 "SWC_FDC_type/run_SWC_FDC_RxTx_5ms_sys/APP/TQD/TorqueDemand/Signal_convert/Wheel Status Judgment/SR_Latch16" /begin REF_MEASUREMENT VTQD_PosLFRRWhlSkip_flg /end REF_MEASUREMENT /end GROUP
/begin GROUP S1328_SR_Latch17 "SWC_FDC_type/run_SWC_FDC_RxTx_5ms_sys/APP/TQD/TorqueDemand/Signal_convert/Wheel Status Judgment/SR_Latch17" /begin REF_MEASUREMENT VTQD_NegLFRRWhlSkip_flg /end REF_MEASUREMENT /end GROUP
/begin GROUP S1328_SR_Latch18 "SWC_FDC_type/run_SWC_FDC_RxTx_5ms_sys/APP/TQD/TorqueDemand/Signal_convert/Wheel Status Judgment/SR_Latch18" /begin REF_MEASUREMENT VTQD_PosRFLRWhlSkip_flg /end REF_MEASUREMENT /end GROUP
/begin GROUP S1328_SR_Latch19 "SWC_FDC_type/run_SWC_FDC_RxTx_5ms_sys/APP/TQD/TorqueDemand/Signal_convert/Wheel Status Judgment/SR_Latch19" /begin REF_MEASUREMENT VTQD_NegRFLRWhlSkip_flg /end REF_MEASUREMENT /end GROUP
/begin GROUP S1328_SR_Latch2 "SWC_FDC_type/run_SWC_FDC_RxTx_5ms_sys/APP/TQD/TorqueDemand/Signal_convert/Wheel Status Judgment/SR_Latch2" /begin REF_MEASUREMENT VTQD_LRWhlSkip_flg /end REF_MEASUREMENT /end GROUP
/begin GROUP S1328_SR_Latch20 "SWC_FDC_type/run_SWC_FDC_RxTx_5ms_sys/APP/TQD/TorqueDemand/Signal_convert/Wheel Status Judgment/SR_Latch20" /begin REF_MEASUREMENT VTQD_FrontLRWhlSkip_flg /end REF_MEASUREMENT /end GROUP
/begin GROUP S1328_SR_Latch21 "SWC_FDC_type/run_SWC_FDC_RxTx_5ms_sys/APP/TQD/TorqueDemand/Signal_convert/Wheel Status Judgment/SR_Latch21" /begin REF_MEASUREMENT VTQD_FrontRRWhlSkip_flg /end REF_MEASUREMENT /end GROUP
/begin GROUP S1328_SR_Latch22 "SWC_FDC_type/run_SWC_FDC_RxTx_5ms_sys/APP/TQD/TorqueDemand/Signal_convert/Wheel Status Judgment/SR_Latch22" /begin REF_MEASUREMENT VTQD_RearLFWhlSkip_flg /end REF_MEASUREMENT /end GROUP
/begin GROUP S1328_SR_Latch23 "SWC_FDC_type/run_SWC_FDC_RxTx_5ms_sys/APP/TQD/TorqueDemand/Signal_convert/Wheel Status Judgment/SR_Latch23" /begin REF_MEASUREMENT VTQD_RearRFWhlSkip_flg /end REF_MEASUREMENT /end GROUP
/begin GROUP S1328_SR_Latch24 "SWC_FDC_type/run_SWC_FDC_RxTx_5ms_sys/APP/TQD/TorqueDemand/Signal_convert/Wheel Status Judgment/SR_Latch24" /begin REF_MEASUREMENT VTQD_TripleWhlSkip_flg /end REF_MEASUREMENT /end GROUP
/begin GROUP S1328_SR_Latch25 "SWC_FDC_type/run_SWC_FDC_RxTx_5ms_sys/APP/TQD/TorqueDemand/Signal_convert/Wheel Status Judgment/SR_Latch25" /begin REF_MEASUREMENT VTQD_AllWhlSkip_flg /end REF_MEASUREMENT /end GROUP
/begin GROUP S1328_SR_Latch3 "SWC_FDC_type/run_SWC_FDC_RxTx_5ms_sys/APP/TQD/TorqueDemand/Signal_convert/Wheel Status Judgment/SR_Latch3" /begin REF_MEASUREMENT VTQD_RRWhlSkip_flg /end REF_MEASUREMENT /end GROUP
/begin GROUP S1328_SR_Latch4 "SWC_FDC_type/run_SWC_FDC_RxTx_5ms_sys/APP/TQD/TorqueDemand/Signal_convert/Wheel Status Judgment/SR_Latch4" /begin REF_MEASUREMENT VTQD_SingleWhlSkip_flg /end REF_MEASUREMENT /end GROUP
/begin GROUP S1328_SR_Latch5 "SWC_FDC_type/run_SWC_FDC_RxTx_5ms_sys/APP/TQD/TorqueDemand/Signal_convert/Wheel Status Judgment/SR_Latch5" /begin REF_MEASUREMENT VTQD_PosLeftWhlSkip_flg /end REF_MEASUREMENT /end GROUP
/begin GROUP S1328_SR_Latch6 "SWC_FDC_type/run_SWC_FDC_RxTx_5ms_sys/APP/TQD/TorqueDemand/Signal_convert/Wheel Status Judgment/SR_Latch6" /begin REF_MEASUREMENT VTQD_NegLeftWhlSkip_flg /end REF_MEASUREMENT /end GROUP
/begin GROUP S1482_If_Action_Subsystem1 "SWC_FDC_type/run_SWC_FDC_RxTx_5ms_sys/APP/TQD/TorqueDemand/TorqueModule/AvaliableTqLimit/If Action Subsystem1" /begin REF_MEASUREMENT VTQD_AvailTqWithARgnFr_Nm VTQD_AvailTqWithARgnRr_Nm /end REF_MEASUREMENT /end GROUP
/begin GROUP S1482_If_Action_Subsystem2 "SWC_FDC_type/run_SWC_FDC_RxTx_5ms_sys/APP/TQD/TorqueDemand/TorqueModule/AvaliableTqLimit/If Action Subsystem2" /begin REF_MEASUREMENT VTQD_AvailTqNoARgnFr_Nm VTQD_AvailTqNoARgnRr_Nm /end REF_MEASUREMENT /end GROUP
/begin GROUP S1482_RateLimit "SWC_FDC_type/run_SWC_FDC_RxTx_5ms_sys/APP/TQD/TorqueDemand/TorqueModule/AvaliableTqLimit/RateLimit" /begin REF_MEASUREMENT VTQD_FAfterTqCMDGain_c /end REF_MEASUREMENT /end GROUP
/begin GROUP S1482_RateLimit1 "SWC_FDC_type/run_SWC_FDC_RxTx_5ms_sys/APP/TQD/TorqueDemand/TorqueModule/AvaliableTqLimit/RateLimit1" /begin REF_MEASUREMENT VTQD_RAfterTqCMDGain_c /end REF_MEASUREMENT /end GROUP
/begin GROUP S1482_TorqueCapacityCalcalation "SWC_FDC_type/run_SWC_FDC_RxTx_5ms_sys/APP/TQD/TorqueDemand/TorqueModule/AvaliableTqLimit/TorqueCapacityCalcalation"
 /begin SUB_GROUP S1499_CapacityDistribution S1499_Generation S1499_MOTOR_Loss_MAP_ S1499_Motoring S1499_TMAvailablePwr_Calculation /end SUB_GROUP
 /begin REF_CHARACTERISTIC KTQD_FrMotorTempHigh_C KTQD_FrMotorTempLow_C KTQD_RrMotorTempHigh_C KTQD_RrMotorTempLow_C MTQD_FrGenActReduce_Z_Nm MTQD_FrMotActReduce_Z_Nm MTQD_RrGenActReduce_Z_Nm MTQD_RrMotActReduce_Z_Nm /end REF_CHARACTERISTIC
 /begin REF_MEASUREMENT VTQD_FrGenActReduce_Nm VTQD_FrMotActReduce_Nm VTQD_FrMotorTempHigh_flg VTQD_RrGenActReduce_Nm VTQD_RrMotActReduce_Nm VTQD_RrMotorTempHigh_flg /end REF_MEASUREMENT
/end GROUP
/begin GROUP S1483_BOS "SWC_FDC_type/run_SWC_FDC_RxTx_5ms_sys/APP/TQD/TorqueDemand/TorqueModule/DriverWhlTqDem/BOS" /begin SUB_GROUP S1505_SR_Latch /end SUB_GROUP
 /begin REF_CHARACTERISTIC KTQD_BOSEnPedalTq_Nm MTQD_BOSEnBPSPosn_Y_pct MTQD_BOSMap_Z_pct /end REF_CHARACTERISTIC
 /begin REF_MEASUREMENT VTQD_BOSEnBPSPosn_pct VTQD_BOSReduction_gain VTQD_BOSTq_Nm /end REF_MEASUREMENT
/end GROUP
/begin GROUP S1483_Creep "SWC_FDC_type/run_SWC_FDC_RxTx_5ms_sys/APP/TQD/TorqueDemand/TorqueModule/DriverWhlTqDem/Creep"
 /begin SUB_GROUP S1506_FirstOrderFilter S1506_If_Action_Subsystem1 S1506_SR_Latch S1506_SR_Latch1 S1506_SR_Latch2 S1506_SR_Latch5 S1506_SR_Latch6 S1506_Timer /end SUB_GROUP
 /begin REF_CHARACTERISTIC KTQD_APSCMDEnCreepSpd_kph KTQD_APSReqDelayTime_s KTQD_APSReqDisCreep_flg KTQD_CreepAPSPosn2Launch_pct KTQD_CreepDisPedTqSpd_kph KTQD_CreepDisVehSpd_kph KTQD_CreepDisableSpdofstR_kph KTQD_CreepDisableSpdofst_kph KTQD_CreepEnVehSpd_kph KTQD_CreepEnableSpdR_kph KTQD_CreepEnableSpd_kph KTQD_CreepLowLimitTq_Nm KTQD_CreepPrLoadEnSpd_kph KTQD_CreepUpLimitTq_Nm KTQD_CreepVehSpdSW_flg KTQD_LowSkipDisCreepDelay_s KTQD_OPDCreepDUpLimitTq_Nm KTQD_OPDCreepDisGrade_Deg KTQD_OPDCreepEnGrade_Deg KTQD_OPDCreepTargetSpdD_kph KTQD_RBCCreepRecTq_Nm KTQD_RPM2VehSpdTs_c KTQD_TireRadius_m KTQD_VehActSpdNegGain_gain KTQD_VehActSpdPosGain_gain MTQD_CreepBPSDisPosnR_Y_pct MTQD_CreepBPSDisPosn_Y_pct MTQD_CreepBPSEnPosnR_Y_pct MTQD_CreepBPSEnPosn_Y_pct MTQD_CreepBaseTqD_Z_Nm MTQD_CreepBaseTqR_Z_Nm MTQD_CreepDeltaTq_Y_Nm MTQD_CreepIterm_Z_Nm MTQD_CreepPreloadTime_Y_s MTQD_CreepPreloadTq_Z_Nm MTQD_CreepProtTq_Y_Nm MTQD_CreepPterm_Z_Nm MTQD_CreepTargetSpdD_Y_kph MTQD_CreepTargetSpdR_Y_kph MTQD_OPDHoldEnSpd_Y_kph MTQD_WhlSkipDisCreep_Y_enum /end REF_CHARACTERISTIC
 /begin REF_MEASUREMENT VTQD_ActBPSPosnInRange_flg VTQD_ActCreepBaseTq_Nm VTQD_CreepActWhlTqDem_Nm VTQD_CreepBPSDisPosnR_pct VTQD_CreepBPSDisPosn_pct VTQD_CreepBPSEnPosnR_pct VTQD_CreepBPSEnPosn_pct VTQD_CreepBaseTqD_Nm VTQD_CreepBaseTqR_Nm VTQD_CreepDeltaTq_Nm VTQD_CreepDisSpd_kph VTQD_CreepDisable_flg VTQD_CreepEnSpd_kph VTQD_CreepEnable_flg VTQD_CreepErrSpd_kph VTQD_CreepFinalSpd_kph VTQD_CreepIterm_c VTQD_CreepPreloadSetTime_s VTQD_CreepPreloadTq_Nm VTQD_CreepProtTqEn_flg VTQD_CreepProtTq_Nm VTQD_CreepPterm_c VTQD_CreepTargetSpdD_kph VTQD_CreepTargetSpdR_kph VTQD_CreepUpLimitTq_Nm VTQD_CreepWhlTqDem_Nm VTQD_HighBPSPosn_flg VTQD_HighSkipDisRset_flg VTQD_LowBPSPosn_flg VTQD_LowSkipDisRset_flg VTQD_MediumSkipDisRset_flg VTQD_OPDCreepGrade_flg VTQD_OPDHoldEnSpd_kph VTQD_RBCActiveRec_flg VTQD_VehActSpdGain_gain VTQD_VehActSpd_kph VTQD_WhlSkipDisCreep_enum /end REF_MEASUREMENT
/end GROUP
/begin GROUP S1483_DriverTqCoordination "SWC_FDC_type/run_SWC_FDC_RxTx_5ms_sys/APP/TQD/TorqueDemand/TorqueModule/DriverWhlTqDem/DriverTqCoordination"
 /begin SUB_GROUP S1507_SR_Latch S1507_SR_Latch2 S1507_SR_Latch6 S1507_SR_Latch7 S1507_Timer1 /end SUB_GROUP
 /begin REF_CHARACTERISTIC KTQD_ADASHoldDelayEnTime_s KTQD_ADASHoldPreLoadspd_kph KTQD_AEBEmergBrkSpd_kph KTQD_APSZeroSpd_kph KTQD_EmergBrkLongAccel_Gps KTQD_EmergBrkSpd_kph KTQD_EscModeTqLimAccCon_Gps KTQD_LoSPdBrkRlsTime_s KTQD_LoSpdBrkRlsSpd_kph KTQD_LoSpdCtrlBrkPos_pct KTQD_OPDHoldPreLoadBound_Nm KTQD_OPDHoldPreLoadTime_s KTQD_PreLoadDisSpd_kph KTQD_PreLoadTqHold_rpm KTQD_PreLoadTq_Nm KTQD_PreLoad_Holdtime_s MTQD_EscapeModePedTq_Z_Nm MTQD_PreLoadTq_Y_Nm /end REF_CHARACTERISTIC
 /begin REF_MEASUREMENT VTQD_ADASPreLoadEn_flg VTQD_ADASPreLoadHold_flg VTQD_DriverWhlTqDem_Nm VTQD_EscapeModePedTq_Nm VTQD_HoldtimeEnd_flg VTQD_LoBrkCtrlReset_flg VTQD_MaxShaftSpd_rpm VTQD_OPDHoldPreLoadEn_flg VTQD_PreLoadPreEn_flg VTQD_PreloadTq_Nm VTQD_ShiftPreload_flg VTQD_TestLoSpdBrkCtrl_flg VTQD_WhlQuickSkip_flg VTQD_WhlSpdQuickSkip_flg /end REF_MEASUREMENT
/end GROUP
/begin GROUP S1483_PedalMapWhlTq "SWC_FDC_type/run_SWC_FDC_RxTx_5ms_sys/APP/TQD/TorqueDemand/TorqueModule/DriverWhlTqDem/PedalMapWhlTq"
 /begin SUB_GROUP S1508_LHM S1508_NoLHM S1508_SR_Latch1 S1508_SR_Latch2 S1508_SR_Latch3 S1508_SR_Latch4 S1508_Triggered_Subsystem /end SUB_GROUP
 /begin REF_CHARACTERISTIC KTQD_ACCOvrdCancelPedTqRat_Nm KTQD_ACCOvrdCancelResPedTq_pct KTQD_ACCOvrdCancelTqCtrl_flg KTQD_ClimbMin_rpm KTQD_GRADE_Deg_ovrdflg KTQD_GRADE_Deg_ovrdval KTQD_OPDHoldGradeDown_Deg KTQD_OPDHoldGradeUp_Deg KTQD_OrigPedTqLowLimSW_flg KTQD_PedalMapClimbLowLim_Nm KTQD_PedalMapRDCLowLim_Nm KTQD_PedalMapRDCUpLim_Nm KTQD_RgnEnLatchBrkPos_pct KTQD_RgnEnLatchSlope_Deg KTQD_SlideRateDevLowLim_pct KTQD_SlideRateDevUpLim_pct KTQD_SlideRegEnLimitTq_Nm KTQD_SlideRegenLowLim_Nm KTQD_TargetSlideRate_pct MTQD_OrigPedTqLowLim_Z_Nm MTQD_PedalMapClimbUpLim_Z_Nm MTQD_SlideRegenTqGain_Z_Nm MTQD_YawTqLowLim_Y_Nm /end REF_CHARACTERISTIC
 /begin REF_MEASUREMENT VTQD_ActHSAActive_flg VTQD_ActPedalMapWhlTq_Nm VTQD_BrkRgnLatchTqLim_Nm VTQD_GRADE_Deg VTQD_LastSlideRegenLimTq_Nm VTQD_OrigPedTqLowLim_Nm VTQD_OrigPedalMapWhlTq_Nm VTQD_PedalMapClimbUpLim_Nm VTQD_PedalMapWhlTq_Nm VTQD_PreDecTqLowLim_Nm VTQD_SlideRateDev_pct VTQD_SlideRegenLimTqGain_Nm VTQD_SlideRegenLimTq_Nm VTQD_SlideTqLowLim_Nm VTQD_SlopeUp_flg VTQD_TqLowLimYawDev_degps VTQD_YawTqLowLim_Nm /end REF_MEASUREMENT
/end GROUP
/begin GROUP S1483_RollingRegenJudge "SWC_FDC_type/run_SWC_FDC_RxTx_5ms_sys/APP/TQD/TorqueDemand/TorqueModule/DriverWhlTqDem/RollingRegenJudge" /begin REF_CHARACTERISTIC KTQD_RegenOffSpd_kph KTQD_RegenOnSpd_kph /end REF_CHARACTERISTIC /begin REF_MEASUREMENT VTQD_RollRegenEnable_flg VTQD_RollingShaftSpd_rpm /end REF_MEASUREMENT /end GROUP
/begin GROUP S1485_Deceleration_Calculation "SWC_FDC_type/run_SWC_FDC_RxTx_5ms_sys/APP/TQD/TorqueDemand/TorqueModule/OPD Hold/Deceleration Calculation"
 /begin REF_CHARACTERISTIC KTQD_APSDecReqMaxSW_flg KTQD_APSDecReqMaxTime_s KTQD_OPDHoldBrkSW_flg KTQD_OPDHoldDevLowLim_mps2 KTQD_OPDHoldDevUpLim_mps2 MTQD_APSDecReqCMD_Y_mps2 MTQD_APSDecReqTs_Y_c MTQD_APSDecReq_Z_mps2 MTQD_APSDecTimeGain_Z_c /end REF_CHARACTERISTIC
 /begin REF_MEASUREMENT VTQD_APSDecReqCMD_mps2 VTQD_APSDecReqMax_flg VTQD_APSDecReqTs_c VTQD_APSDecReq_mps2 VTQD_APSDecTimeGain_c VTQD_ActOPDHoldAccDev_mps2 VTQD_MapAPSDecReq_mps2 /end REF_MEASUREMENT
/end GROUP
/begin GROUP S1485_OPDHold_Request_ "SWC_FDC_type/run_SWC_FDC_RxTx_5ms_sys/APP/TQD/TorqueDemand/TorqueModule/OPD Hold/OPDHold Request " /begin SUB_GROUP S1600_SR_Latch1 S1600_Timer /end SUB_GROUP
 /begin REF_CHARACTERISTIC KTQD_APSReqDelayTime_s KTQD_APSReqDownSpd_kph KTQD_APSReqUpSpd_kph KTQD_OPDHoldGradeDown_Deg KTQD_OPDHoldGradeUp_Deg KTQD_OPDHoldLampDelayTime_s KTQD_OPDHoldLampDisSpd_kph KTQD_OPDHoldLampEnSpd_kph MTQD_APSReqLowSpd_Y_kph /end REF_CHARACTERISTIC
 /begin REF_MEASUREMENT VTQD_APSDecReqA_flg VTQD_APSReqLowSpd_kph VTQD_APSReqUpSpd_kph VTQD_APSReq_enum VTQD_APSStasysLow_flg VTQD_APSStasysUp_flg VTQD_OPDHoldLamp_flg VTQD_OPDHoldUpDown_flg /end REF_MEASUREMENT
/end GROUP
/begin GROUP S1485_Parking_Requeest_Backup "SWC_FDC_type/run_SWC_FDC_RxTx_5ms_sys/APP/TQD/TorqueDemand/TorqueModule/OPD Hold/Parking Requeest Backup" /begin SUB_GROUP S1601_SR_Latch /end SUB_GROUP
 /begin REF_CHARACTERISTIC KTQD_APSReqDelayTime_s KTQD_OPDHoldAllowPark_flg KTQD_OPDHoldAllowPark_s KTQD_OPDHoldBrkSW_flg /end REF_CHARACTERISTIC
 /begin REF_MEASUREMENT VTQD_ActParkRequest_flg /end REF_MEASUREMENT
/end GROUP
/begin GROUP S1485_Release_Condition "SWC_FDC_type/run_SWC_FDC_RxTx_5ms_sys/APP/TQD/TorqueDemand/TorqueModule/OPD Hold/Release Condition" /begin SUB_GROUP S1602_DelayEnable S1602_SR_Latch S1602_SR_Latch1 /end SUB_GROUP
 /begin REF_CHARACTERISTIC KTQD_APSDecReqMaxTime_s KTQD_APSRelDisTqDev_Nm KTQD_OPDHoldDetRevSpd_kph KTQD_OPDHoldDownEnTime_s KTQD_OPDHoldGradeDown_Deg KTQD_OPDHoldGradeUp_Deg KTQD_OPDHoldLiftRevSpd_kph KTQD_OPDHoldRelDetSpd_kph KTQD_OPDHoldRelTqGain_Nm MTQD_AutoHoldReleaseBPS_Y_pct MTQD_OPDHoldDownRelDelay_Y_s MTQD_OPDHoldRelDetTime_Y_s MTQD_OPDHoldReleaseTq_Y_Nm /end REF_CHARACTERISTIC
 /begin REF_MEASUREMENT VTQD_AutoHoldReleaseAPS_pct VTQD_AutoHoldRelease_flg VTQD_OPDHoldActRelTq_Nm VTQD_OPDHoldDisRelTq_Nm VTQD_OPDHoldDisRelease_flg VTQD_OPDHoldDownRelDelay_s VTQD_OPDHoldEnRelTq_flg VTQD_OPDHoldEnRelease_flg VTQD_OPDHoldRelDetTime_s VTQD_OPDHoldReleaseTq_Nm /end REF_MEASUREMENT
/end GROUP
/begin GROUP S1485_System_Status "SWC_FDC_type/run_SWC_FDC_RxTx_5ms_sys/APP/TQD/TorqueDemand/TorqueModule/OPD Hold/System Status"
 /begin SUB_GROUP S1603_DelayEnable S1603_DelayEnable1 S1603_SR_Latch S1603_SR_Latch3 S1603_SR_Latch4 /end SUB_GROUP
 /begin REF_CHARACTERISTIC KTQD_AutoHoldEnSpd_kph KTQD_OPDHoldSkipDetSpd_kph KTQD_R2DEnOPDHSpdDelayTime_s KTQD_R2DEnOPDHoldSpd_kph KTQD_R2DGradeLowLim_Deg KTQD_R2DGradeUpLim_Deg KTQD_SkipRecOPDHoldDelay_s MTQD_WhlSkipDisOPDHold_Y_enum /end REF_CHARACTERISTIC
 /begin REF_MEASUREMENT VTQD_APSStaSys_enum VTQD_AntiBlockEnOPDHold_flg VTQD_OPDHoldDelayForP_flg VTQD_WhlSkipDisOPDHold_enum /end REF_MEASUREMENT
/end GROUP
/begin GROUP S1489_Coordinate_NoSuitbleGear_flg "SWC_FDC_type/run_SWC_FDC_RxTx_5ms_sys/APP/TQD/TorqueDemand/TorqueModule/TqCoordination/Coordinate_NoSuitbleGear_flg" /begin REF_CHARACTERISTIC KTQD_DriverTqDemN_Nm /end REF_CHARACTERISTIC /end GROUP
/begin GROUP S1490_AWD_Ratio "SWC_FDC_type/run_SWC_FDC_RxTx_5ms_sys/APP/TQD/TorqueDemand/TorqueModule/TqDistribution/AWD_Ratio"
 /begin REF_CHARACTERISTIC KTQD_AWDFrRatio_rat_ovrdflg KTQD_AWDFrRatio_rat_ovrdval KTQD_AWDRrRatio_rat_ovrdflg KTQD_AWDRrRatio_rat_ovrdval KTQD_CreepWhlRatioSW_flg KTQD_RrEDUTqDistrictMax_gain KTQD_RrEDUTqDistrictMin_gain /end REF_CHARACTERISTIC
/end GROUP
/begin GROUP S1490_RateLimit1 "SWC_FDC_type/run_SWC_FDC_RxTx_5ms_sys/APP/TQD/TorqueDemand/TorqueModule/TqDistribution/RateLimit1" /begin REF_MEASUREMENT VTQD_DriverWhlTqDemRr_Nm /end REF_MEASUREMENT /end GROUP
/begin GROUP S1490_RateLimit2 "SWC_FDC_type/run_SWC_FDC_RxTx_5ms_sys/APP/TQD/TorqueDemand/TorqueModule/TqDistribution/RateLimit2" /begin REF_MEASUREMENT VTQD_DriverWhlTqDemFr_Nm /end REF_MEASUREMENT /end GROUP
/begin GROUP S1645_SR_Latch "SWC_FDC_type/run_SWC_FDC_RxTx_5ms_sys/APP/TQR/Determine Torque Request/TorqueArbitrament/InverseAndTurnToMotorToq/SR_Latch" /begin REF_MEASUREMENT VTQR_FrGearChange_flg /end REF_MEASUREMENT /end GROUP
/begin GROUP S1645_SR_Latch1 "SWC_FDC_type/run_SWC_FDC_RxTx_5ms_sys/APP/TQR/Determine Torque Request/TorqueArbitrament/InverseAndTurnToMotorToq/SR_Latch1" /begin REF_MEASUREMENT VTQR_RrGearChange_flg /end REF_MEASUREMENT /end GROUP
/begin GROUP S1646_SR_Latch3 "SWC_FDC_type/run_SWC_FDC_RxTx_5ms_sys/APP/TQR/Determine Torque Request/TorqueArbitrament/RampEnableJudge/SR_Latch3" /begin REF_MEASUREMENT VTQR_ADASCancelBRgnRampF_flg /end REF_MEASUREMENT /end GROUP
/begin GROUP S1646_SR_Latch4 "SWC_FDC_type/run_SWC_FDC_RxTx_5ms_sys/APP/TQR/Determine Torque Request/TorqueArbitrament/RampEnableJudge/SR_Latch4" /begin REF_MEASUREMENT VTQR_ADASCancelBRgnRampR_flg /end REF_MEASUREMENT /end GROUP
/begin GROUP S1647_FirstOrderFilter "SWC_FDC_type/run_SWC_FDC_RxTx_5ms_sys/APP/TQR/Determine Torque Request/TorqueArbitrament/TorqueSmooth/FirstOrderFilter" /begin REF_MEASUREMENT VTQR_FrFirstOrderOutTq_Nm /end REF_MEASUREMENT /end GROUP
/begin GROUP S1647_FirstOrderFilter1 "SWC_FDC_type/run_SWC_FDC_RxTx_5ms_sys/APP/TQR/Determine Torque Request/TorqueArbitrament/TorqueSmooth/FirstOrderFilter1" /begin REF_MEASUREMENT VTQR_RrFirstOrderOutTq_Nm /end REF_MEASUREMENT /end GROUP
/begin GROUP S1647_Front_First_order_filter_input_tau_map_and_determination "SWC_FDC_type/run_SWC_FDC_RxTx_5ms_sys/APP/TQR/Determine Torque Request/TorqueArbitrament/TorqueSmooth/Front First order filter input tau map and determination"
 /begin SUB_GROUP S1664_SR_Latch1 S1664_VTQR_ECOFEDUTs_c S1664_VTQR_ESCAPEFEDUTs_c S1664_VTQR_LHMFEDUTs_c S1664_VTQR_NORMALFEDUTs_c S1664_VTQR_SNOWFEDUTs_c S1664_VTQR_SPORTFEDUTs_c S1664_VTQR_TCSFEDUTs_c /end SUB_GROUP
 /begin REF_CHARACTERISTIC KTQR_ARegenLatchEnTq_Nm KTQR_DriveModeCMDTqDev_Nm KTQR_DriveModeChangeTq_Nm KTQR_PreLoadPreEnTs_c KTQR_PreLoadTs_c KTQR_TIPOutTsAPS_pct KTQR_TIPOutTsSpd_kph MTQR_AltRDCActiveFEDUTs_Z_c MTQR_CreepFEDUTs_Z_c MTQR_FEDUTIPOutTs_Y_c MTQR_VMCFEDUTs_Z_c /end REF_CHARACTERISTIC
 /begin REF_MEASUREMENT VTQR_CreepFEDUTs_c VTQR_FEDUTIPOutTs_c VTQR_FEDUTs_c VTQR_FrFirstOrderInpTs_c VTQR_FrRDCActiveTs_flg VTQR_RDCActiveFEDUTs_c VTQR_VMCFEDUTs_c /end REF_MEASUREMENT
/end GROUP
/begin GROUP S1647_Front_Torque_zero_point_transfer_boundary_map "SWC_FDC_type/run_SWC_FDC_RxTx_5ms_sys/APP/TQR/Determine Torque Request/TorqueArbitrament/TorqueSmooth/Front Torque zero point transfer boundary map"
 /begin SUB_GROUP S1665_EcoLow S1665_EcoUP S1665_NormalLow S1665_NormalUP S1665_SportLow S1665_SportUP /end SUB_GROUP
 /begin REF_MEASUREMENT VTQR_FrTqZeroTransLowBound_Nm VTQR_FrTqZeroTransUpBound_Nm /end REF_MEASUREMENT
/end GROUP
/begin GROUP S1647_Front_Torque_zero_point_transfer_status_determination_ "SWC_FDC_type/run_SWC_FDC_RxTx_5ms_sys/APP/TQR/Determine Torque Request/TorqueArbitrament/TorqueSmooth/Front Torque zero point transfer status determination "
 /begin REF_CHARACTERISTIC KTQD_OPDHoldGradeDown_Deg KTQD_OPDHoldGradeUp_Deg KTQR_CreepZeroTransSW_flg KTQR_OPDNoZeroTransSpd_kph KTQR_OPDNoZeroTransTq_Nm /end REF_CHARACTERISTIC
 /begin REF_MEASUREMENT VTQR_FrTqZeroTrans_enum /end REF_MEASUREMENT
/end GROUP
/begin GROUP S1647_Front_torque_ramp_limtation_and_determination "SWC_FDC_type/run_SWC_FDC_RxTx_5ms_sys/APP/TQR/Determine Torque Request/TorqueArbitrament/TorqueSmooth/Front torque ramp limtation and determination" /begin REF_CHARACTERISTIC KTQD_TireRadius_m /end REF_CHARACTERISTIC /end GROUP
/begin GROUP S1647_Front_wheel_rate_limit_determination "SWC_FDC_type/run_SWC_FDC_RxTx_5ms_sys/APP/TQR/Determine Torque Request/TorqueArbitrament/TorqueSmooth/Front wheel rate limit determination"
 /begin REF_CHARACTERISTIC KTQR_ARegenLatchEnTq_Nm KTQR_DriveModeCMDTqDev_Nm KTQR_DriveModeChangeTq_Nm /end REF_CHARACTERISTIC
/end GROUP
/begin GROUP S1647_Rear_First_order_filter_input_tau_map_and_determination "SWC_FDC_type/run_SWC_FDC_RxTx_5ms_sys/APP/TQR/Determine Torque Request/TorqueArbitrament/TorqueSmooth/Rear First order filter input tau map and determination"
 /begin REF_CHARACTERISTIC KTQR_ARegenLatchEnTq_Nm KTQR_DriveModeCMDTqDev_Nm KTQR_DriveModeChangeTq_Nm KTQR_PreLoadPreEnTs_c KTQR_PreLoadTs_c KTQR_TIPOutTsAPS_pct KTQR_TIPOutTsSpd_kph /end REF_CHARACTERISTIC
/end GROUP
/begin GROUP S1647_Rear_Torque_zero_point_transfer_status_determination_ "SWC_FDC_type/run_SWC_FDC_RxTx_5ms_sys/APP/TQR/Determine Torque Request/TorqueArbitrament/TorqueSmooth/Rear Torque zero point transfer status determination "
 /begin REF_CHARACTERISTIC KTQD_OPDHoldGradeDown_Deg KTQD_OPDHoldGradeUp_Deg KTQR_CreepZeroTransSW_flg KTQR_OPDNoZeroTransSpd_kph KTQR_OPDNoZeroTransTq_Nm /end REF_CHARACTERISTIC
/end GROUP
/begin GROUP S1647_Rear_torque_ramp_limtation_and_determination "SWC_FDC_type/run_SWC_FDC_RxTx_5ms_sys/APP/TQR/Determine Torque Request/TorqueArbitrament/TorqueSmooth/Rear torque ramp limtation and determination" /begin REF_CHARACTERISTIC KTQD_TireRadius_m /end REF_CHARACTERISTIC /end GROUP
/begin GROUP S1647_Rear_wheel_rate_limit_determination "SWC_FDC_type/run_SWC_FDC_RxTx_5ms_sys/APP/TQR/Determine Torque Request/TorqueArbitrament/TorqueSmooth/Rear wheel rate limit determination"
 /begin REF_CHARACTERISTIC KTQR_ARegenLatchEnTq_Nm KTQR_DriveModeCMDTqDev_Nm KTQR_DriveModeChangeTq_Nm /end REF_CHARACTERISTIC
/end GROUP
/begin GROUP S2147_LF_Wheel "SWC_FDC_type/run_SWC_FDC_RxTx_5ms_sys/APP/VMC/VMC/Slide Rate  Calculation/4Wheel Calculation/LF Wheel" /begin REF_CHARACTERISTIC KVMC_RawWhlSpeedDeadZone_kph /end REF_CHARACTERISTIC /end GROUP
/begin GROUP S2147_LR_Wheel "SWC_FDC_type/run_SWC_FDC_RxTx_5ms_sys/APP/VMC/VMC/Slide Rate  Calculation/4Wheel Calculation/LR Wheel" /begin REF_CHARACTERISTIC KVMC_RawWhlSpeedDeadZone_kph /end REF_CHARACTERISTIC /end GROUP
/begin GROUP S2147_RF_Wheel "SWC_FDC_type/run_SWC_FDC_RxTx_5ms_sys/APP/VMC/VMC/Slide Rate  Calculation/4Wheel Calculation/RF Wheel" /begin REF_CHARACTERISTIC KVMC_RawWhlSpeedDeadZone_kph /end REF_CHARACTERISTIC /end GROUP
/begin GROUP S2147_RR_Wheel "SWC_FDC_type/run_SWC_FDC_RxTx_5ms_sys/APP/VMC/VMC/Slide Rate  Calculation/4Wheel Calculation/RR Wheel" /begin REF_CHARACTERISTIC KVMC_RawWhlSpeedDeadZone_kph /end REF_CHARACTERISTIC /end GROUP
/begin GROUP S1057_IDIdentify "SWC_FDC_type/run_SWC_FDC_RxTx_5ms_sys/APP/TPM/TPMS/TPMS/Learn/AutoLocation/IDIdentify" /begin REF_CHARACTERISTIC KTPM_DataInVehSpdThreshold_kph /end REF_CHARACTERISTIC /end GROUP
/begin GROUP S1355_ACC_Speed_Setting_ON "SWC_FDC_type/run_SWC_FDC_RxTx_5ms_sys/APP/TQD/TorqueDemand/Signal_convert/SWC2_Subsystem/Speed Setting Mode/ACC Speed Setting ON"
 /begin REF_CHARACTERISTIC KTQD_ACCActiveMetSpdLoMPH_mph KTQD_ACCActiveMetSpdLo_kph KTQD_SmartEcoLimitSpd_kph KTQD_SmartEcoLimitSpd_mph /end REF_CHARACTERISTIC
/end GROUP
/begin GROUP S1355_CC_Speed_Setting_ON "SWC_FDC_type/run_SWC_FDC_RxTx_5ms_sys/APP/TQD/TorqueDemand/Signal_convert/SWC2_Subsystem/Speed Setting Mode/CC Speed Setting ON"
 /begin REF_CHARACTERISTIC KTQD_SetSpdDeltaLongFit_kph KTQD_SmartEcoLimitSpd_kph KTQD_SmartEcoLimitSpd_mph /end REF_CHARACTERISTIC
/end GROUP
/begin GROUP S1355_ISA_Speed_Setting_ON "SWC_FDC_type/run_SWC_FDC_RxTx_5ms_sys/APP/TQD/TorqueDemand/Signal_convert/SWC2_Subsystem/Speed Setting Mode/ISA Speed Setting ON" /begin REF_CHARACTERISTIC KTQD_SmartEcoLimitSpd_kph /end REF_CHARACTERISTIC /end GROUP
/begin GROUP S1355_MSA_Speed_Setting_ON "SWC_FDC_type/run_SWC_FDC_RxTx_5ms_sys/APP/TQD/TorqueDemand/Signal_convert/SWC2_Subsystem/Speed Setting Mode/MSA Speed Setting ON"
 /begin REF_CHARACTERISTIC KTQD_SetSpdDeltaLongFit_kph KTQD_SmartEcoLimitSpd_kph KTQD_SmartEcoLimitSpd_mph /end REF_CHARACTERISTIC
/end GROUP
/begin GROUP S1394_ACC_Speed_Setting_ON "SWC_FDC_type/run_SWC_FDC_RxTx_5ms_sys/APP/TQD/TorqueDemand/Signal_convert/SWC_Subsystem/Speed Setting Mode/ACC Speed Setting ON"
 /begin REF_CHARACTERISTIC KTQD_ACCActiveMetSpdLoMPH_mph KTQD_ACCActiveMetSpdLo_kph KTQD_SmartEcoLimitSpd_kph /end REF_CHARACTERISTIC
/end GROUP
/begin GROUP S1394_CC_Speed_Setting_ON "SWC_FDC_type/run_SWC_FDC_RxTx_5ms_sys/APP/TQD/TorqueDemand/Signal_convert/SWC_Subsystem/Speed Setting Mode/CC Speed Setting ON" /begin REF_CHARACTERISTIC KTQD_SetSpdDeltaLongFit_kph KTQD_SmartEcoLimitSpd_kph /end REF_CHARACTERISTIC /end GROUP
/begin GROUP S1394_ISA_Speed_Setting_ON "SWC_FDC_type/run_SWC_FDC_RxTx_5ms_sys/APP/TQD/TorqueDemand/Signal_convert/SWC_Subsystem/Speed Setting Mode/ISA Speed Setting ON" /begin REF_CHARACTERISTIC KTQD_SmartEcoLimitSpd_kph /end REF_CHARACTERISTIC /end GROUP
/begin GROUP S1394_MSA_Speed_Setting_ON "SWC_FDC_type/run_SWC_FDC_RxTx_5ms_sys/APP/TQD/TorqueDemand/Signal_convert/SWC_Subsystem/Speed Setting Mode/MSA Speed Setting ON" /begin REF_CHARACTERISTIC KTQD_SetSpdDeltaLongFit_kph KTQD_SmartEcoLimitSpd_kph /end REF_CHARACTERISTIC /end GROUP
/begin GROUP S1427_Front_Wheel_Torque "SWC_FDC_type/run_SWC_FDC_RxTx_5ms_sys/APP/TQD/TorqueDemand/Signal_convert/VehWeightEst/Calaulation/Front Wheel Torque" /begin REF_CHARACTERISTIC KTQD_VehWeighEstTime_s /end REF_CHARACTERISTIC /end GROUP
/begin GROUP S1427_Long_Acc "SWC_FDC_type/run_SWC_FDC_RxTx_5ms_sys/APP/TQD/TorqueDemand/Signal_convert/VehWeightEst/Calaulation/Long Acc" /begin REF_CHARACTERISTIC KTQD_VehWeighEstTime_s /end REF_CHARACTERISTIC /end GROUP
/begin GROUP S1427_Rear_Wheel_Torque "SWC_FDC_type/run_SWC_FDC_RxTx_5ms_sys/APP/TQD/TorqueDemand/Signal_convert/VehWeightEst/Calaulation/Rear Wheel Torque" /begin REF_CHARACTERISTIC KTQD_VehWeighEstTime_s /end REF_CHARACTERISTIC /end GROUP
/begin GROUP S1066_Subsystem1 "SWC_FDC_type/run_SWC_FDC_RxTx_5ms_sys/APP/TPM/TPMS/TPMS/Learn/AutoLocation/IDIdentify/Subsystem1" /begin REF_CHARACTERISTIC KTPM_DataInVehSpdThreshold_kph /end REF_CHARACTERISTIC /end GROUP
/begin GROUP S1066_Subsystem2 "SWC_FDC_type/run_SWC_FDC_RxTx_5ms_sys/APP/TPM/TPMS/TPMS/Learn/AutoLocation/IDIdentify/Subsystem2" /begin REF_CHARACTERISTIC KTPM_DataInVehSpdThreshold_kph /end REF_CHARACTERISTIC /end GROUP
/begin GROUP S1066_Subsystem3 "SWC_FDC_type/run_SWC_FDC_RxTx_5ms_sys/APP/TPM/TPMS/TPMS/Learn/AutoLocation/IDIdentify/Subsystem3" /begin REF_CHARACTERISTIC KTPM_DataInVehSpdThreshold_kph /end REF_CHARACTERISTIC /end GROUP
/begin GROUP S1066_Subsystem7 "SWC_FDC_type/run_SWC_FDC_RxTx_5ms_sys/APP/TPM/TPMS/TPMS/Learn/AutoLocation/IDIdentify/Subsystem7" /begin REF_CHARACTERISTIC KTPM_DataInVehSpdThreshold_kph /end REF_CHARACTERISTIC /end GROUP
/begin GROUP S1562_LUT_D_SnowMode "SWC_FDC_type/run_SWC_FDC_RxTx_5ms_sys/APP/TQD/TorqueDemand/TorqueModule/DriverWhlTqDem/PedalMapWhlTq/NoLHM/ShiftD/LUT_D_SnowMode" /begin REF_CHARACTERISTIC KTQD_PedalMapRDCUpLim_Nm /end REF_CHARACTERISTIC /end GROUP
/begin GROUP S1565_ECO_OnePedal_TqMap "SWC_FDC_type/run_SWC_FDC_RxTx_5ms_sys/APP/TQD/TorqueDemand/TorqueModule/DriverWhlTqDem/PedalMapWhlTq/NoLHM/ShiftD/LUT_D_ECO/ECO_OnePedal_TqMap" /begin REF_CHARACTERISTIC KTQD_APSReqDelayTime_s /end REF_CHARACTERISTIC /end GROUP
/begin GROUP S1567_NRM_OnePedal_TqMap "SWC_FDC_type/run_SWC_FDC_RxTx_5ms_sys/APP/TQD/TorqueDemand/TorqueModule/DriverWhlTqDem/PedalMapWhlTq/NoLHM/ShiftD/LUT_D_Normal/NRM_OnePedal_TqMap" /begin REF_CHARACTERISTIC KTQD_APSReqDelayTime_s /end REF_CHARACTERISTIC /end GROUP
/begin GROUP S1569_Sport_OnePedal_TqMap "SWC_FDC_type/run_SWC_FDC_RxTx_5ms_sys/APP/TQD/TorqueDemand/TorqueModule/DriverWhlTqDem/PedalMapWhlTq/NoLHM/ShiftD/LUT_D_Sport/Sport_OnePedal_TqMap" /begin REF_CHARACTERISTIC KTQD_APSReqDelayTime_s /end REF_CHARACTERISTIC /end GROUP
/end MODULE
/end PROJECT
