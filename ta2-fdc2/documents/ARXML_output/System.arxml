AUTOSAR XML (schema 4-3-0)
package /SysEnv_ARPkg
  system System_FDC: category=SYSTEM_DESCRIPTION, ecu-extract-version=1.0.0, system-version=1.0.0
    100 x system mapping:
      SystemMapping
        sw-impl-mappings:
          20 x swc to impl mapping:
            BswMTest_ImplMapping: component-implementation=Impl_BswMTest_type, component=root_FDC.BswMTest
            SWC_APS_ImplMapping: component-implementation=Impl_SWC_APS_type, component=root_FDC.SWC_APS
            SWC_CDD_ImplMapping: component-implementation=Impl_SWC_CDD_type, component=root_FDC.SWC_CDD
            SWC_CGW_ImplMapping: component-implementation=Impl_SWC_CGW_type, component=root_FDC.SWC_CGW
            SWC_DID_ImplMapping: component-implementation=Impl_SWC_DID_type, component=root_FDC.SWC_DID
            SWC_DKC_ImplMapping: component-implementation=Impl_SWC_DKC_type, component=root_FDC.SWC_DKC
            SWC_SCP_ImplMapping: component-implementation=Impl_SWC_SCP_type, component=root_FDC.SWC_SCP
            SWC_INP_ImplMapping: component-implementation=Impl_SWC_INP_type, component=root_FDC.SWC_INP
            SWC_HALIN_ImplMapping: component-implementation=Impl_SWC_HALIN_type, component=root_FDC.SWC_HALIN
            SWC_HALIN_CDD_ImplMapping: component-implementation=Impl_SWC_HALIN_CDD_type, component=root_FDC.SWC_HALIN_CDD
            SWC_OUTP_ImplMapping: component-implementation=Impl_SWC_OUTP_type, component=root_FDC.SWC_OUTP
            SWC_HALOUT_ImplMapping: component-implementation=Impl_SWC_HALOUT_type, component=root_FDC.SWC_HALOUT
            SWC_FDC_ImplMapping: component-implementation=Impl_SWC_FDC_type, component=root_FDC.SWC_FDC
            SWC_IMU_ImplMapping: component-implementation=Impl_SWC_IMU_type, component=root_FDC.SWC_IMU
            SWC_IOEXP_ImplMapping: component-implementation=Impl_SWC_IOEXP_type, component=root_FDC.SWC_IOEXP
            SWC_LOG_ImplMapping: component-implementation=Impl_SWC_LOG_type, component=root_FDC.SWC_LOG
            SWC_NVM_ImplMapping: component-implementation=Impl_SWC_NVM_type, component=root_FDC.SWC_NVM
            SWC_UART_ImplMapping: component-implementation=Impl_SWC_UART_type, component=root_FDC.SWC_UART
            SWC_UDS_ImplMapping: component-implementation=Impl_SWC_UDS_type, component=root_FDC.SWC_UDS
            SWC_VES_ImplMapping: component-implementation=Impl_SWC_VES_type, component=root_FDC.SWC_VES
        sw-mappings:
          swc to ecu mapping SWC_ECUMapping: ecu-instance=FUSION
            component:
              root_FDC.SWC_FDC
              root_FDC.SWC_CDD
              root_FDC.BswMTest
              root_FDC.SWC_NVM
              root_FDC.SWC_UDS
              root_FDC.SWC_VES
              root_FDC.SWC_IMU
              root_FDC.SWC_UART
              root_FDC.SWC_DID
              root_FDC.SWC_IOEXP
              root_FDC.SWC_APS
              root_FDC.SWC_CGW
              root_FDC.SWC_DKC
              root_FDC.SWC_LOG
              root_FDC.SWC_SCP
              root_FDC.SWC_INP
              root_FDC.SWC_HALIN
              root_FDC.SWC_HALIN_CDD
              root_FDC.SWC_OUTP
              root_FDC.SWC_HALOUT
      MAP_HALOUTP_CAN1_FD1_C100_0: sender-receiver-to-signal-group-mapping{communication-direction=OUT, data-element=SWC_HALOUT.root_FDC.P_CAN1_FD1_C100_0.CAN1_SG_FD1_C100_0, signal-group=CAN1_SG_FD1_C100_0, type-mapping=sender-rec-record-type-mapping=sender-rec-record-element-mapping{implementation-record-element=CAN1_VCUEBSRd4BR, system-signal=CAN1_VCUEBSRd4BR}}
      MAP_HALOUTP_CAN1_FD1_C100_1: sender-receiver-to-signal-group-mapping{communication-direction=OUT, data-element=SWC_HALOUT.root_FDC.P_CAN1_FD1_C100_1.CAN1_SG_FD1_C100_1, signal-group=CAN1_SG_FD1_C100_1, type-mapping=sender-rec-record-type-mapping=record-element-mappings=[{implementation-record-element=CAN1_VCUEBSHBSw, system-signal=CAN1_VCUEBSHBSw}, {implementation-record-element=CAN1_VCUEBSHHSw, system-signal=CAN1_VCUEBSHHSw}]}
      MAP_HALOUTP_CAN1_FD1_C100_2: sender-receiver-to-signal-group-mapping{communication-direction=OUT, data-element=SWC_HALOUT.root_FDC.P_CAN1_FD1_C100_2.CAN1_SG_FD1_C100_2, signal-group=CAN1_SG_FD1_C100_2, type-mapping=sender-rec-record-type-mapping=record-element-mappings=[{implementation-record-element=CAN1_GearFlashInd, system-signal=CAN1_GearFlashInd}, {implementation-record-element=CAN1_VCUnoPBInd, system-signal=CAN1_VCUnoPBInd}, {implementation-record-element=CAN1_VCUWarnInd, system-signal=CAN1_VCUWarnInd}, {implementation-record-element=CAN1_VCUKeyStatus, system-signal=CAN1_VCUKeyStatus}, {implementation-record-element=CAN1_VCUDTCHisSta, system-signal=CAN1_VCUDTCHisSta}, {implementation-record-element=CAN1_VCUDTCHisCode, system-signal=CAN1_VCUDTCHisCode}, {implementation-record-element=CAN1_VCUDTCCurrSta, system-signal=CAN1_VCUDTCCurrSta}, {implementation-record-element=CAN1_VCUDTCCurrCode, system-signal=CAN1_VCUDTCCurrCode}, {implementation-record-element=CAN1_VCUBCMBuzzReq, system-signal=CAN1_VCUBCMBuzzReq}, {implementation-record-element=CAN1_PweLmtInd, system-signal=CAN1_PweLmtInd}, {implementation-record-element=CAN1_LVBattLow, system-signal=CAN1_LVBattLow}]}
      MAP_HALOUTP_CAN1_FD1_C100_3: sender-receiver-to-signal-group-mapping{communication-direction=OUT, data-element=SWC_HALOUT.root_FDC.P_CAN1_FD1_C100_3.CAN1_SG_FD1_C100_3, signal-group=CAN1_SG_FD1_C100_3, type-mapping=sender-rec-record-type-mapping=record-element-mappings=[{implementation-record-element=CAN1_BrakeSW, system-signal=CAN1_BrakeSW}, {implementation-record-element=CAN1_VCUVehSpd, system-signal=CAN1_VCUVehSpd}]}
      MAP_HALOUTP_CAN1_FD1_C10_0: sender-receiver-to-signal-group-mapping{communication-direction=OUT, data-element=SWC_HALOUT.root_FDC.P_CAN1_FD1_C10_0.CAN1_SG_FD1_C10_0, signal-group=CAN1_SG_FD1_C10_0, type-mapping=sender-rec-record-type-mapping=sender-rec-record-element-mapping{implementation-record-element=CAN1_VehActDriveDirect, system-signal=CAN1_VehActDriveDirect}}
      MAP_HALOUTP_CAN1_FD1_C10_1: sender-receiver-to-signal-group-mapping{communication-direction=OUT, data-element=SWC_HALOUT.root_FDC.P_CAN1_FD1_C10_1.CAN1_SG_FD1_C10_1, signal-group=CAN1_SG_FD1_C10_1, type-mapping=sender-rec-record-type-mapping=record-element-mappings=[{implementation-record-element=CAN1_ActEMOutSftSpd, system-signal=CAN1_ActEMOutSftSpd}, {implementation-record-element=CAN1_SACtrlDev, system-signal=CAN1_SACtrlDev}, {implementation-record-element=CAN1_RetSelNonEng, system-signal=CAN1_RetSelNonEng}, {implementation-record-element=CAN1_EMTrqModeDrvBrk, system-signal=CAN1_EMTrqModeDrvBrk}, {implementation-record-element=CAN1_DrvDemEMRtapTrq, system-signal=CAN1_DrvDemEMRtapTrq}, {implementation-record-element=CAN1_ActMaxAvaEMRecpTrq, system-signal=CAN1_ActMaxAvaEMRecpTrq}, {implementation-record-element=CAN1_ActEMpTrqHrls, system-signal=CAN1_ActEMpTrqHrls}, {implementation-record-element=CAN1_ActEMpTrq, system-signal=CAN1_ActEMpTrq}]}
      MAP_HALOUTP_CAN1_FD1_C200_0: sender-receiver-to-signal-group-mapping{communication-direction=OUT, data-element=SWC_HALOUT.root_FDC.P_CAN1_FD1_C200_0.CAN1_SG_FD1_C200_0, signal-group=CAN1_SG_FD1_C200_0, type-mapping=sender-rec-record-type-mapping=sender-rec-record-element-mapping{implementation-record-element=CAN1_SysPowerMode, system-signal=CAN1_SysPowerMode}}
      MAP_HALOUTP_CAN1_FD1_C20_0: sender-receiver-to-signal-group-mapping{communication-direction=OUT, data-element=SWC_HALOUT.root_FDC.P_CAN1_FD1_C20_0.CAN1_SG_FD1_C20_0, signal-group=CAN1_SG_FD1_C20_0, type-mapping=sender-rec-record-type-mapping=record-element-mappings=[{implementation-record-element=CAN1_DCCurr, system-signal=CAN1_DCCurr}, {implementation-record-element=CAN1_MinTorqAvail, system-signal=CAN1_MinTorqAvail}, {implementation-record-element=CAN1_MaxTorqAvail, system-signal=CAN1_MaxTorqAvail}, {implementation-record-element=CAN1_DCVol, system-signal=CAN1_DCVol}]}
      MAP_HALOUTP_CAN1_FD1_C250_0: sender-receiver-to-signal-group-mapping{communication-direction=OUT, data-element=SWC_HALOUT.root_FDC.P_CAN1_FD1_C250_0.CAN1_SG_FD1_C250_0, signal-group=CAN1_SG_FD1_C250_0, type-mapping=sender-rec-record-type-mapping=record-element-mappings=[{implementation-record-element=CAN1_EMParasLoss, system-signal=CAN1_EMParasLoss}, {implementation-record-element=CAN1_NFricPercTorq, system-signal=CAN1_NFricPercTorq}]}
      MAP_HALOUTP_CAN1_FD1_C5000_0: sender-receiver-to-signal-group-mapping{communication-direction=OUT, data-element=SWC_HALOUT.root_FDC.P_CAN1_FD1_C5000_0.CAN1_SG_FD1_C5000_0, signal-group=CAN1_SG_FD1_C5000_0, type-mapping=sender-rec-record-type-mapping=record-element-mappings=[{implementation-record-element=CAN1_RC1MaxRetSpdP2, system-signal=CAN1_RC1MaxRetSpdP2}, {implementation-record-element=CAN1_RC1RetType, system-signal=CAN1_RC1RetType}, {implementation-record-element=CAN1_RC1RetSpdPekTrqP5, system-signal=CAN1_RC1RetSpdPekTrqP5}, {implementation-record-element=CAN1_RC1RetSpdP4, system-signal=CAN1_RC1RetSpdP4}, {implementation-record-element=CAN1_RC1RetSpdP3, system-signal=CAN1_RC1RetSpdP3}, {implementation-record-element=CAN1_RC1RetSpdIdleP1, system-signal=CAN1_RC1RetSpdIdleP1}, {implementation-record-element=CAN1_RC1RetLocat, system-signal=CAN1_RC1RetLocat}, {implementation-record-element=CAN1_RC1RetCtrlMth, system-signal=CAN1_RC1RetCtrlMth}, {implementation-record-element=CAN1_RC1RefRetTrq, system-signal=CAN1_RC1RefRetTrq}, {implementation-record-element=CAN1_RC1PctTrqPekTrqP5, system-signal=CAN1_RC1PctTrqPekTrqP5}, {implementation-record-element=CAN1_RC1PctTrqP4, system-signal=CAN1_RC1PctTrqP4}, {implementation-record-element=CAN1_RC1PctTrqP3, system-signal=CAN1_RC1PctTrqP3}, {implementation-record-element=CAN1_RC1PctTrqMaxSpdP2, system-signal=CAN1_RC1PctTrqMaxSpdP2}, {implementation-record-element=CAN1_RC1PctTrqIdleP1, system-signal=CAN1_RC1PctTrqIdleP1}]}
      MAP_HALOUTP_CAN1_FD1_C5000_1: sender-receiver-to-signal-group-mapping{communication-direction=OUT, data-element=SWC_HALOUT.root_FDC.P_CAN1_FD1_C5000_1.CAN1_SG_FD1_C5000_1, signal-group=CAN1_SG_FD1_C5000_1, type-mapping=sender-rec-record-type-mapping=record-element-mappings=[{implementation-record-element=CAN1_EMDefTrqLmt, system-signal=CAN1_EMDefTrqLmt}, {implementation-record-element=CAN1_EMSupVarRTSC1MSG, system-signal=CAN1_EMSupVarRTSC1MSG}, {implementation-record-element=CAN1_EMSupTSC1CtrlPG4, system-signal=CAN1_EMSupTSC1CtrlPG4}, {implementation-record-element=CAN1_EMSupTSC1CtrlPG3, system-signal=CAN1_EMSupTSC1CtrlPG3}, {implementation-record-element=CAN1_EMSupTSC1CtrlPG2, system-signal=CAN1_EMSupTSC1CtrlPG2}, {implementation-record-element=CAN1_EMSupTSC1CtrlPG1, system-signal=CAN1_EMSupTSC1CtrlPG1}, {implementation-record-element=CAN1_EMSpdIdleP1, system-signal=CAN1_EMSpdIdleP1}, {implementation-record-element=CAN1_EMSpdHIdleP6, system-signal=CAN1_EMSpdHIdleP6}, {implementation-record-element=CAN1_EMReqTrqCtrlUpLmt, system-signal=CAN1_EMReqTrqCtrlUpLmt}, {implementation-record-element=CAN1_EMReqTrqCtrlLoLmt, system-signal=CAN1_EMReqTrqCtrlLoLmt}, {implementation-record-element=CAN1_EMReqSpdCtrlUpLmt, system-signal=CAN1_EMReqSpdCtrlUpLmt}, {implementation-record-element=CAN1_EMReqSpdCtrlLoLmt, system-signal=CAN1_EMReqSpdCtrlLoLmt}, {implementation-record-element=CAN1_EMPercTorqP5, system-signal=CAN1_EMPercTorqP5}, {implementation-record-element=CAN1_EMPercTorqP4, system-signal=CAN1_EMPercTorqP4}, {implementation-record-element=CAN1_EMPercTorqP3, system-signal=CAN1_EMPercTorqP3}, {implementation-record-element=CAN1_EMPercTorqP2, system-signal=CAN1_EMPercTorqP2}, {implementation-record-element=CAN1_EMPercTorqIdleP1, system-signal=CAN1_EMPercTorqIdleP1}, {implementation-record-element=CAN1_EMMomOfInertia, system-signal=CAN1_EMMomOfInertia}, {implementation-record-element=CAN1_EMMaxMOvrTLmt, system-signal=CAN1_EMMaxMOvrTLmt}, {implementation-record-element=CAN1_EMMaxMEngOvrSP7, system-signal=CAN1_EMMaxMEngOvrSP7}, {implementation-record-element=CAN1_EMGainEndSpdGvn, system-signal=CAN1_EMGainEndSpdGvn}, {implementation-record-element=CAN1_EMExtRSCtrlUpLmt, system-signal=CAN1_EMExtRSCtrlUpLmt}, {implementation-record-element=CAN1_EMEMSpdP5, system-signal=CAN1_EMEMSpdP5}, {implementation-record-element=CAN1_EMEMSpdP4, system-signal=CAN1_EMEMSpdP4}, {implementation-record-element=CAN1_EMEMSpdP3, system-signal=CAN1_EMEMSpdP3}, {implementation-record-element=CAN1_EMEMSpdP2, system-signal=CAN1_EMEMSpdP2}, {implementation-record-element=CAN1_EMEMRefTorq, system-signal=CAN1_EMEMRefTorq}]}
      MAP_HALOUTP_CAN1_FD1_C50_0: sender-receiver-to-signal-group-mapping{communication-direction=OUT, data-element=SWC_HALOUT.root_FDC.P_CAN1_FD1_C50_0.CAN1_SG_FD1_C50_0, signal-group=CAN1_SG_FD1_C50_0, type-mapping=sender-rec-record-type-mapping=sender-rec-record-element-mapping{implementation-record-element=CAN1_ActDriveDirect, system-signal=CAN1_ActDriveDirect}}
      MAP_HALOUTP_CAN1_FD1_C50_1: sender-receiver-to-signal-group-mapping{communication-direction=OUT, data-element=SWC_HALOUT.root_FDC.P_CAN1_FD1_C50_1.CAN1_SG_FD1_C50_1, signal-group=CAN1_SG_FD1_C50_1, type-mapping=sender-rec-record-type-mapping=record-element-mappings=[{implementation-record-element=CAN1_AccPedal1LowSW, system-signal=CAN1_AccPedal1LowSW}, {implementation-record-element=CAN1_EEC2MSGCnt, system-signal=CAN1_EEC2MSGCnt}, {implementation-record-element=CAN1_EEC2MSGCS, system-signal=CAN1_EEC2MSGCS}, {implementation-record-element=CAN1_AccPedalPos1, system-signal=CAN1_AccPedalPos1}]}
      MAP_HALOUTP_CAN1_FD1_C80_0: sender-receiver-to-signal-group-mapping{communication-direction=OUT, data-element=SWC_HALOUT.root_FDC.P_CAN1_FD1_C80_0.CAN1_SG_FD1_C80_0, signal-group=CAN1_SG_FD1_C80_0, type-mapping=sender-rec-record-type-mapping=record-element-mappings=[{implementation-record-element=CAN1_DLEngaged, system-signal=CAN1_DLEngaged}, {implementation-record-element=CAN1_ShiftPgs, system-signal=CAN1_ShiftPgs}]}
      MAP_HALOUTP_CAN1_FD1_CE100_0: sender-receiver-to-signal-group-mapping{communication-direction=OUT, data-element=SWC_HALOUT.root_FDC.P_CAN1_FD1_CE100_0.CAN1_SG_FD1_CE100_0, signal-group=CAN1_SG_FD1_CE100_0, type-mapping=sender-rec-record-type-mapping=record-element-mappings=[{implementation-record-element=CAN1_CFGEM1DT0, system-signal=CAN1_CFGEM1DT0}, {implementation-record-element=CAN1_CFGEM1DT7, system-signal=CAN1_CFGEM1DT7}, {implementation-record-element=CAN1_CFGEM1DT6, system-signal=CAN1_CFGEM1DT6}, {implementation-record-element=CAN1_CFGEM1DT5, system-signal=CAN1_CFGEM1DT5}, {implementation-record-element=CAN1_CFGEM1DT4, system-signal=CAN1_CFGEM1DT4}, {implementation-record-element=CAN1_CFGEM1DT3, system-signal=CAN1_CFGEM1DT3}, {implementation-record-element=CAN1_CFGEM1DT2, system-signal=CAN1_CFGEM1DT2}, {implementation-record-element=CAN1_CFGEM1DT1, system-signal=CAN1_CFGEM1DT1}]}
      MAP_HALOUTP_CAN1_FD1_CE100_1: sender-receiver-to-signal-group-mapping{communication-direction=OUT, data-element=SWC_HALOUT.root_FDC.P_CAN1_FD1_CE100_1.CAN1_SG_FD1_CE100_1, signal-group=CAN1_SG_FD1_CE100_1, type-mapping=sender-rec-record-type-mapping=record-element-mappings=[{implementation-record-element=CAN1_CFGEM1BAMPGN, system-signal=CAN1_CFGEM1BAMPGN}, {implementation-record-element=CAN1_CFGEM1Ctrl, system-signal=CAN1_CFGEM1Ctrl}, {implementation-record-element=CAN1_CFGEM1BAMTSize, system-signal=CAN1_CFGEM1BAMTSize}, {implementation-record-element=CAN1_CFGEM1BAMTNum, system-signal=CAN1_CFGEM1BAMTNum}, {implementation-record-element=CAN1_CFGEM1BAMRsv, system-signal=CAN1_CFGEM1BAMRsv}]}
      MAP_HALOUTP_CAN1_FD1_CE100_2: sender-receiver-to-signal-group-mapping{communication-direction=OUT, data-element=SWC_HALOUT.root_FDC.P_CAN1_FD1_CE100_2.CAN1_SG_FD1_CE100_2, signal-group=CAN1_SG_FD1_CE100_2, type-mapping=sender-rec-record-type-mapping=record-element-mappings=[{implementation-record-element=CAN1_FDC_BCM_DVRSignalL_Cmd, system-signal=CAN1_FDC_BCM_DVRSignalL_Cmd}, {implementation-record-element=CAN1_FDC_BCM_RTurnLp_Cmd, system-signal=CAN1_FDC_BCM_RTurnLp_Cmd}, {implementation-record-element=CAN1_FDC_BCM_LTurnLp_Cmd, system-signal=CAN1_FDC_BCM_LTurnLp_Cmd}, {implementation-record-element=CAN1_FDC_BCM_DVRSignalR_Cmd, system-signal=CAN1_FDC_BCM_DVRSignalR_Cmd}]}
      MAP_HALOUTP_CAN2_FD2_C1000_0: sender-receiver-to-signal-group-mapping{communication-direction=OUT, data-element=SWC_HALOUT.root_FDC.P_CAN2_FD2_C1000_0.CAN2_SG_FD2_C1000_0, signal-group=CAN2_SG_FD2_C1000_0, type-mapping=sender-rec-record-type-mapping=record-element-mappings=[{implementation-record-element=CAN2_VCUVehAcclLimit, system-signal=CAN2_VCUVehAcclLimit}, {implementation-record-element=CAN2_VCUVehSpdlimit, system-signal=CAN2_VCUVehSpdlimit}]}
      MAP_HALOUTP_CAN2_FD2_C10_0: sender-receiver-to-signal-group-mapping{communication-direction=OUT, data-element=SWC_HALOUT.root_FDC.P_CAN2_FD2_C10_0.CAN2_SG_FD2_C10_0, signal-group=CAN2_SG_FD2_C10_0, type-mapping=sender-rec-record-type-mapping=record-element-mappings=[{implementation-record-element=CAN2_ActDriveMode, system-signal=CAN2_ActDriveMode}, {implementation-record-element=CAN2_WheelSlipdet, system-signal=CAN2_WheelSlipdet}, {implementation-record-element=CAN2_VehActDriveDirect, system-signal=CAN2_VehActDriveDirect}, {implementation-record-element=CAN2_TUpASta, system-signal=CAN2_TUpASta}, {implementation-record-element=CAN2_RecuperHighSta, system-signal=CAN2_RecuperHighSta}, {implementation-record-element=CAN2_EVECU1MSGCnt, system-signal=CAN2_EVECU1MSGCnt}, {implementation-record-element=CAN2_EVECU1MSGCS, system-signal=CAN2_EVECU1MSGCS}, {implementation-record-element=CAN2_EMotorSpd, system-signal=CAN2_EMotorSpd}, {implementation-record-element=CAN2_EMotorPerformance, system-signal=CAN2_EMotorPerformance}, {implementation-record-element=CAN2_EMotorOverSpd, system-signal=CAN2_EMotorOverSpd}, {implementation-record-element=CAN2_EBrakeTorqLow, system-signal=CAN2_EBrakeTorqLow}, {implementation-record-element=CAN2_CreeperSta, system-signal=CAN2_CreeperSta}, {implementation-record-element=CAN2_CeTraxSysReady, system-signal=CAN2_CeTraxSysReady}]}
      MAP_HALOUTP_CAN2_FD2_C200_0: sender-receiver-to-signal-group-mapping{communication-direction=OUT, data-element=SWC_HALOUT.root_FDC.P_CAN2_FD2_C200_0.CAN2_SG_FD2_C200_0, signal-group=CAN2_SG_FD2_C200_0, type-mapping=sender-rec-record-type-mapping=record-element-mappings=[{implementation-record-element=CAN2_CACPresWarn, system-signal=CAN2_CACPresWarn}, {implementation-record-element=CAN2_SysPowerMode, system-signal=CAN2_SysPowerMode}, {implementation-record-element=CAN2_FDC_VCU_VCUDRM_Sta, system-signal=CAN2_FDC_VCU_VCUDRM_Sta}]}
      MAP_HALOUTP_CAN2_FD2_C500_0: sender-receiver-to-signal-group-mapping{communication-direction=OUT, data-element=SWC_HALOUT.root_FDC.P_CAN2_FD2_C500_0.CAN2_SG_FD2_C500_0, signal-group=CAN2_SG_FD2_C500_0, type-mapping=sender-rec-record-type-mapping=record-element-mappings=[{implementation-record-element=CAN2_IGNKeySta, system-signal=CAN2_IGNKeySta}, {implementation-record-element=CAN2_VSPFunc, system-signal=CAN2_VSPFunc}, {implementation-record-element=CAN2_VCU_VehicleSpd, system-signal=CAN2_VCU_VehicleSpd}]}
      MAP_HALOUTP_CAN2_FD2_C50_0: sender-receiver-to-signal-group-mapping{communication-direction=OUT, data-element=SWC_HALOUT.root_FDC.P_CAN2_FD2_C50_0.CAN2_SG_FD2_C50_0, signal-group=CAN2_SG_FD2_C50_0, type-mapping=sender-rec-record-type-mapping=record-element-mappings=[{implementation-record-element=CAN2_EVEHCMSGCS, system-signal=CAN2_EVEHCMSGCS}, {implementation-record-element=CAN2_RecuperLimOrReq, system-signal=CAN2_RecuperLimOrReq}, {implementation-record-element=CAN2_ExtWorkshopMReq, system-signal=CAN2_ExtWorkshopMReq}, {implementation-record-element=CAN2_ExtDriveMReq, system-signal=CAN2_ExtDriveMReq}, {implementation-record-element=CAN2_ExtDischgReq, system-signal=CAN2_ExtDischgReq}, {implementation-record-element=CAN2_ExtAccLimReq, system-signal=CAN2_ExtAccLimReq}, {implementation-record-element=CAN2_ElecSysRdy, system-signal=CAN2_ElecSysRdy}, {implementation-record-element=CAN2_EVSysRls, system-signal=CAN2_EVSysRls}, {implementation-record-element=CAN2_EVEHCMSGCnt, system-signal=CAN2_EVEHCMSGCnt}]}
      MAP_HALOUTP_CAN2_FD2_CE100_0: sender-receiver-to-signal-group-mapping{communication-direction=OUT, data-element=SWC_HALOUT.root_FDC.P_CAN2_FD2_CE100_0.CAN2_SG_FD2_CE100_0, signal-group=CAN2_SG_FD2_CE100_0, type-mapping=sender-rec-record-type-mapping=record-element-mappings=[{implementation-record-element=CAN2_FDC_BCM_BSD_Buzzer_Cmd, system-signal=CAN2_FDC_BCM_BSD_Buzzer_Cmd}, {implementation-record-element=CAN2_FDC_BCM_WiperL_Cmd, system-signal=CAN2_FDC_BCM_WiperL_Cmd}, {implementation-record-element=CAN2_FDC_BCM_WiperH_Cmd, system-signal=CAN2_FDC_BCM_WiperH_Cmd}, {implementation-record-element=CAN2_FDC_BCM_Washer_Cmd, system-signal=CAN2_FDC_BCM_Washer_Cmd}, {implementation-record-element=CAN2_FDC_BCM_TurnLpPattern_Sta, system-signal=CAN2_FDC_BCM_TurnLpPattern_Sta}, {implementation-record-element=CAN2_FDC_BCM_TurnBuzzerEN_Sta, system-signal=CAN2_FDC_BCM_TurnBuzzerEN_Sta}, {implementation-record-element=CAN2_FDC_BCM_Stop_IND_Cmd, system-signal=CAN2_FDC_BCM_Stop_IND_Cmd}, {implementation-record-element=CAN2_FDC_BCM_STOPBALL_Cmd, system-signal=CAN2_FDC_BCM_STOPBALL_Cmd}, {implementation-record-element=CAN2_FDC_BCM_SRTLp_Cmd, system-signal=CAN2_FDC_BCM_SRTLp_Cmd}, {implementation-record-element=CAN2_FDC_BCM_SMKR_Cmd, system-signal=CAN2_FDC_BCM_SMKR_Cmd}, {implementation-record-element=CAN2_FDC_BCM_SMKL_Cmd, system-signal=CAN2_FDC_BCM_SMKL_Cmd}, {implementation-record-element=CAN2_FDC_BCM_SLTLp_Cmd, system-signal=CAN2_FDC_BCM_SLTLp_Cmd}, {implementation-record-element=CAN2_FDC_BCM_RoomLpSet_Sta, system-signal=CAN2_FDC_BCM_RoomLpSet_Sta}, {implementation-record-element=CAN2_FDC_BCM_RoomLpAmb_Cmd, system-signal=CAN2_FDC_BCM_RoomLpAmb_Cmd}, {implementation-record-element=CAN2_FDC_BCM_RoomLpAmbSet_Sta, system-signal=CAN2_FDC_BCM_RoomLpAmbSet_Sta}, {implementation-record-element=CAN2_FDC_BCM_RTurnSW_Sta, system-signal=CAN2_FDC_BCM_RTurnSW_Sta}, {implementation-record-element=CAN2_FDC_BCM_RTurnLp_Cmd, system-signal=CAN2_FDC_BCM_RTurnLp_Cmd}, {implementation-record-element=CAN2_FDC_BCM_RRoomLpSet_Sta, system-signal=CAN2_FDC_BCM_RRoomLpSet_Sta}, {implementation-record-element=CAN2_FDC_BCM_RGear_Sta, system-signal=CAN2_FDC_BCM_RGear_Sta}, {implementation-record-element=CAN2_FDC_BCM_RFLamp_Cmd, system-signal=CAN2_FDC_BCM_RFLamp_Cmd}, {implementation-record-element=CAN2_FDC_BCM_RDoor_Sta, system-signal=CAN2_FDC_BCM_RDoor_Sta}, {implementation-record-element=CAN2_FDC_BCM_RDRL_Cmd, system-signal=CAN2_FDC_BCM_RDRL_Cmd}, {implementation-record-element=CAN2_FDC_BCM_RBSDY_Cmd, system-signal=CAN2_FDC_BCM_RBSDY_Cmd}, {implementation-record-element=CAN2_FDC_BCM_RBSDR_Cmd, system-signal=CAN2_FDC_BCM_RBSDR_Cmd}, {implementation-record-element=CAN2_FDC_BCM_PLamp_Cmd, system-signal=CAN2_FDC_BCM_PLamp_Cmd}, {implementation-record-element=CAN2_FDC_BCM_OutDoorOpenSW_Sta, system-signal=CAN2_FDC_BCM_OutDoorOpenSW_Sta}, {implementation-record-element=CAN2_FDC_BCM_MRoomLpSet_Sta, system-signal=CAN2_FDC_BCM_MRoomLpSet_Sta}, {implementation-record-element=CAN2_FDC_BCM_MDoor_Sta, system-signal=CAN2_FDC_BCM_MDoor_Sta}, {implementation-record-element=CAN2_FDC_BCM_MDOpenSV_Cmd, system-signal=CAN2_FDC_BCM_MDOpenSV_Cmd}, {implementation-record-element=CAN2_FDC_BCM_MDCloseSV_Cmd, system-signal=CAN2_FDC_BCM_MDCloseSV_Cmd}, {implementation-record-element=CAN2_FDC_BCM_LTurnSW_Sta, system-signal=CAN2_FDC_BCM_LTurnSW_Sta}, {implementation-record-element=CAN2_FDC_BCM_LTurnLp_Cmd, system-signal=CAN2_FDC_BCM_LTurnLp_Cmd}, {implementation-record-element=CAN2_FDC_BCM_LDRL_Cmd, system-signal=CAN2_FDC_BCM_LDRL_Cmd}, {implementation-record-element=CAN2_FDC_BCM_LBeam_Cmd, system-signal=CAN2_FDC_BCM_LBeam_Cmd}, {implementation-record-element=CAN2_FDC_BCM_LBSDY_Cmd, system-signal=CAN2_FDC_BCM_LBSDY_Cmd}, {implementation-record-element=CAN2_FDC_BCM_LBSDR_Cmd, system-signal=CAN2_FDC_BCM_LBSDR_Cmd}, {implementation-record-element=CAN2_FDC_BCM_InnerCallBell_Cmd, system-signal=CAN2_FDC_BCM_InnerCallBell_Cmd}, {implementation-record-element=CAN2_FDC_BCM_InnerBuzzer_Cmd, system-signal=CAN2_FDC_BCM_InnerBuzzer_Cmd}, {implementation-record-element=CAN2_FDC_BCM_InnerBuzzerMode_Sta, system-signal=CAN2_FDC_BCM_InnerBuzzerMode_Sta}, {implementation-record-element=CAN2_FDC_BCM_HelpIND_Cmd, system-signal=CAN2_FDC_BCM_HelpIND_Cmd}, {implementation-record-element=CAN2_FDC_BCM_HazardSW_Sta, system-signal=CAN2_FDC_BCM_HazardSW_Sta}, {implementation-record-element=CAN2_FDC_BCM_HBeam_Cmd, system-signal=CAN2_FDC_BCM_HBeam_Cmd}, {implementation-record-element=CAN2_FDC_BCM_FRoomLpSet_Sta, system-signal=CAN2_FDC_BCM_FRoomLpSet_Sta}, {implementation-record-element=CAN2_FDC_BCM_FDoor_Sta, system-signal=CAN2_FDC_BCM_FDoor_Sta}, {implementation-record-element=CAN2_FDC_BCM_FDOpenSV_Cmd, system-signal=CAN2_FDC_BCM_FDOpenSV_Cmd}, {implementation-record-element=CAN2_FDC_BCM_FDCloseSV_Cmd, system-signal=CAN2_FDC_BCM_FDCloseSV_Cmd}, {implementation-record-element=CAN2_FDC_BCM_EmSV_Cmd, system-signal=CAN2_FDC_BCM_EmSV_Cmd}, {implementation-record-element=CAN2_FDC_BCM_EmExitSW_Sta, system-signal=CAN2_FDC_BCM_EmExitSW_Sta}, {implementation-record-element=CAN2_FDC_BCM_DVRSignalR_Cmd, system-signal=CAN2_FDC_BCM_DVRSignalR_Cmd}, {implementation-record-element=CAN2_FDC_BCM_DVRSignalL_Cmd, system-signal=CAN2_FDC_BCM_DVRSignalL_Cmd}, {implementation-record-element=CAN2_FDC_BCM_CallBell_Cmd, system-signal=CAN2_FDC_BCM_CallBell_Cmd}, {implementation-record-element=CAN2_FDC_BCM_Brake_Cmd, system-signal=CAN2_FDC_BCM_Brake_Cmd}]}
      MAP_HALOUTP_CAN2_GW2_C100_0: sender-receiver-to-signal-group-mapping{communication-direction=OUT, data-element=SWC_HALOUT.root_FDC.P_CAN2_GW2_C100_0.CAN2_SG_GW2_C100_0, signal-group=CAN2_SG_GW2_C100_0, type-mapping=sender-rec-record-type-mapping=record-element-mappings=[{implementation-record-element=CAN2_CACTempWarn, system-signal=CAN2_CACTempWarn}, {implementation-record-element=CAN2_VCUnoPBInd, system-signal=CAN2_VCUnoPBInd}, {implementation-record-element=CAN2_VCUWarnInd, system-signal=CAN2_VCUWarnInd}, {implementation-record-element=CAN2_PweLmtInd, system-signal=CAN2_PweLmtInd}, {implementation-record-element=CAN2_LVBattLow, system-signal=CAN2_LVBattLow}, {implementation-record-element=CAN2_GearFlashInd, system-signal=CAN2_GearFlashInd}, {implementation-record-element=CAN2_DACStatus, system-signal=CAN2_DACStatus}]}
      MAP_HALOUTP_CAN3_FD3_C100_0: sender-receiver-to-signal-group-mapping{communication-direction=OUT, data-element=SWC_HALOUT.root_FDC.P_CAN3_FD3_C100_0.CAN3_SG_FD3_C100_0, signal-group=CAN3_SG_FD3_C100_0, type-mapping=sender-rec-record-type-mapping=record-element-mappings=[{implementation-record-element=CAN3_V2BACPosRlyFlt, system-signal=CAN3_V2BACPosRlyFlt}, {implementation-record-element=CAN3_V2BVehSpd, system-signal=CAN3_V2BVehSpd}, {implementation-record-element=CAN3_V2BOilPosRlySta, system-signal=CAN3_V2BOilPosRlySta}, {implementation-record-element=CAN3_V2BOilPosRlyFlt, system-signal=CAN3_V2BOilPosRlyFlt}, {implementation-record-element=CAN3_V2BMainPosRlySta, system-signal=CAN3_V2BMainPosRlySta}, {implementation-record-element=CAN3_V2BMainPosRlyFlt, system-signal=CAN3_V2BMainPosRlyFlt}, {implementation-record-element=CAN3_V2BLifeSig, system-signal=CAN3_V2BLifeSig}, {implementation-record-element=CAN3_V2BHVOnOff, system-signal=CAN3_V2BHVOnOff}, {implementation-record-element=CAN3_V2BDCDCPosRlySta, system-signal=CAN3_V2BDCDCPosRlySta}, {implementation-record-element=CAN3_V2BDCDCPosRlyFlt, system-signal=CAN3_V2BDCDCPosRlyFlt}, {implementation-record-element=CAN3_V2BAux4RlySta, system-signal=CAN3_V2BAux4RlySta}, {implementation-record-element=CAN3_V2BAux4ReyFlt, system-signal=CAN3_V2BAux4ReyFlt}, {implementation-record-element=CAN3_V2BAux3RlySta, system-signal=CAN3_V2BAux3RlySta}, {implementation-record-element=CAN3_V2BAux3RlyFlt, system-signal=CAN3_V2BAux3RlyFlt}, {implementation-record-element=CAN3_V2BAux3OnOff, system-signal=CAN3_V2BAux3OnOff}, {implementation-record-element=CAN3_V2BAux2RlySta, system-signal=CAN3_V2BAux2RlySta}, {implementation-record-element=CAN3_V2BAux2RlyFlt, system-signal=CAN3_V2BAux2RlyFlt}, {implementation-record-element=CAN3_V2BAux2OnOff, system-signal=CAN3_V2BAux2OnOff}, {implementation-record-element=CAN3_V2BAux1RlySta, system-signal=CAN3_V2BAux1RlySta}, {implementation-record-element=CAN3_V2BAux1RlyFlt, system-signal=CAN3_V2BAux1RlyFlt}, {implementation-record-element=CAN3_V2BAux1OnOff, system-signal=CAN3_V2BAux1OnOff}, {implementation-record-element=CAN3_V2BAirPosRlySta, system-signal=CAN3_V2BAirPosRlySta}, {implementation-record-element=CAN3_V2BAirPosRlyFlt, system-signal=CAN3_V2BAirPosRlyFlt}, {implementation-record-element=CAN3_V2BACPosRlySta, system-signal=CAN3_V2BACPosRlySta}]}
      MAP_HALOUTP_CAN3_FD3_C10_0: sender-receiver-to-signal-group-mapping{communication-direction=OUT, data-element=SWC_HALOUT.root_FDC.P_CAN3_FD3_C10_0.CAN3_SG_FD3_C10_0, signal-group=CAN3_SG_FD3_C10_0, type-mapping=sender-rec-record-type-mapping=record-element-mappings=[{implementation-record-element=CAN3_DCDCRlyEn, system-signal=CAN3_DCDCRlyEn}, {implementation-record-element=CAN3_VCULife1, system-signal=CAN3_VCULife1}, {implementation-record-element=CAN3_MCUHVPwrOnOffReq, system-signal=CAN3_MCUHVPwrOnOffReq}, {implementation-record-element=CAN3_EHPSRlyEn, system-signal=CAN3_EHPSRlyEn}, {implementation-record-element=CAN3_EACRlyEn, system-signal=CAN3_EACRlyEn}]}
      MAP_HALOUTP_CAN3_FD3_C10_1: sender-receiver-to-signal-group-mapping{communication-direction=OUT, data-element=SWC_HALOUT.root_FDC.P_CAN3_FD3_C10_1.CAN3_SG_FD3_C10_1, signal-group=CAN3_SG_FD3_C10_1, type-mapping=sender-rec-record-type-mapping=record-element-mappings=[{implementation-record-element=CAN3_VCUMCUCtrlMd, system-signal=CAN3_VCUMCUCtrlMd}, {implementation-record-element=CAN3_VCUMCUHandBrk, system-signal=CAN3_VCUMCUHandBrk}, {implementation-record-element=CAN3_VCUMCUGearSta, system-signal=CAN3_VCUMCUGearSta}, {implementation-record-element=CAN3_VCUMCUFootBrk, system-signal=CAN3_VCUMCUFootBrk}, {implementation-record-element=CAN3_VCUMCUFailRst, system-signal=CAN3_VCUMCUFailRst}, {implementation-record-element=CAN3_VCUMCUEn, system-signal=CAN3_VCUMCUEn}, {implementation-record-element=CAN3_VCUMCUDemTrq, system-signal=CAN3_VCUMCUDemTrq}, {implementation-record-element=CAN3_VCUMCUDemSpd, system-signal=CAN3_VCUMCUDemSpd}, {implementation-record-element=CAN3_VCUMCUDemRC, system-signal=CAN3_VCUMCUDemRC}, {implementation-record-element=CAN3_VCUMCUDemLoNegVal, system-signal=CAN3_VCUMCUDemLoNegVal}, {implementation-record-element=CAN3_VCUMCUDemHiPosVal, system-signal=CAN3_VCUMCUDemHiPosVal}, {implementation-record-element=CAN3_VCUMCUDemCS, system-signal=CAN3_VCUMCUDemCS}]}
      MAP_HALOUTP_CAN3_FD3_C200_0: sender-receiver-to-signal-group-mapping{communication-direction=OUT, data-element=SWC_HALOUT.root_FDC.P_CAN3_FD3_C200_0.CAN3_SG_FD3_C200_0, signal-group=CAN3_SG_FD3_C200_0, type-mapping=sender-rec-record-type-mapping=record-element-mappings=[{implementation-record-element=CAN3_ChrgFault, system-signal=CAN3_ChrgFault}, {implementation-record-element=CAN3_VCUPSSSta, system-signal=CAN3_VCUPSSSta}, {implementation-record-element=CAN3_VCUIRCSta, system-signal=CAN3_VCUIRCSta}, {implementation-record-element=CAN3_VCUIGNSta, system-signal=CAN3_VCUIGNSta}, {implementation-record-element=CAN3_SysPowerMode, system-signal=CAN3_SysPowerMode}, {implementation-record-element=CAN3_PowerUpState, system-signal=CAN3_PowerUpState}, {implementation-record-element=CAN3_PowerUpFault, system-signal=CAN3_PowerUpFault}, {implementation-record-element=CAN3_PowerDownState, system-signal=CAN3_PowerDownState}, {implementation-record-element=CAN3_PowerDownFault, system-signal=CAN3_PowerDownFault}, {implementation-record-element=CAN3_ChrgState, system-signal=CAN3_ChrgState}]}
      MAP_HALOUTP_CAN3_FD3_C200_1: sender-receiver-to-signal-group-mapping{communication-direction=OUT, data-element=SWC_HALOUT.root_FDC.P_CAN3_FD3_C200_1.CAN3_SG_FD3_C200_1, signal-group=CAN3_SG_FD3_C200_1, type-mapping=sender-rec-record-type-mapping=sender-rec-record-element-mapping{implementation-record-element=CAN3_FDC_THCM_EWPPEReq_Cmd, system-signal=CAN3_FDC_THCM_EWPPEReq_Cmd}}
      MAP_HALOUTP_CAN4_FD4_C100_0: sender-receiver-to-signal-group-mapping{communication-direction=OUT, data-element=SWC_HALOUT.root_FDC.P_CAN4_FD4_C100_0.CAN4_SG_FD4_C100_0, signal-group=CAN4_SG_FD4_C100_0, type-mapping=sender-rec-record-type-mapping=record-element-mappings=[{implementation-record-element=CAN4_DCDCEnDemand, system-signal=CAN4_DCDCEnDemand}, {implementation-record-element=CAN4_VCULife2, system-signal=CAN4_VCULife2}, {implementation-record-element=CAN4_FDC_EHPS_SpdDemand_Cmd, system-signal=CAN4_FDC_EHPS_SpdDemand_Cmd}, {implementation-record-element=CAN4_FDC_EHPS_EnDemand_Cmd, system-signal=CAN4_FDC_EHPS_EnDemand_Cmd}, {implementation-record-element=CAN4_FDC_CHA_EACEnDemand_Cmd, system-signal=CAN4_FDC_CHA_EACEnDemand_Cmd}, {implementation-record-element=CAN4_EACSpdDemand, system-signal=CAN4_EACSpdDemand}]}
      MAP_HALOUTP_CAN4_FD4_C10_0: sender-receiver-to-signal-group-mapping{communication-direction=OUT, data-element=SWC_HALOUT.root_FDC.P_CAN4_FD4_C10_0.CAN4_SG_FD4_C10_0, signal-group=CAN4_SG_FD4_C10_0, type-mapping=sender-rec-record-type-mapping=record-element-mappings=[{implementation-record-element=CAN4_ACHVPwrOnOffReq, system-signal=CAN4_ACHVPwrOnOffReq}, {implementation-record-element=CAN4_VCU_DeFogTMSRlyEn_cmd, system-signal=CAN4_VCU_DeFogTMSRlyEn_cmd}, {implementation-record-element=CAN4_VCU_DCDCEACEHPSRlyEn_cmd, system-signal=CAN4_VCU_DCDCEACEHPSRlyEn_cmd}, {implementation-record-element=CAN4_VCULife1, system-signal=CAN4_VCULife1}, {implementation-record-element=CAN4_MCUHVPwrOnOffReq, system-signal=CAN4_MCUHVPwrOnOffReq}]}
      MAP_HALOUTP_CAN4_FD4_C200_0: sender-receiver-to-signal-group-mapping{communication-direction=OUT, data-element=SWC_HALOUT.root_FDC.P_CAN4_FD4_C200_0.CAN4_SG_FD4_C200_0, signal-group=CAN4_SG_FD4_C200_0, type-mapping=sender-rec-record-type-mapping=record-element-mappings=[{implementation-record-element=CAN4_SysPowerMode, system-signal=CAN4_SysPowerMode}, {implementation-record-element=CAN4_VCUIRCSta, system-signal=CAN4_VCUIRCSta}, {implementation-record-element=CAN4_VCUIGNSta, system-signal=CAN4_VCUIGNSta}]}
      MAP_HALOUTP_CAN4_FD4_CE100_0: sender-receiver-to-signal-group-mapping{communication-direction=OUT, data-element=SWC_HALOUT.root_FDC.P_CAN4_FD4_CE100_0.CAN4_SG_FD4_CE100_0, signal-group=CAN4_SG_FD4_CE100_0, type-mapping=sender-rec-record-type-mapping=record-element-mappings=[{implementation-record-element=CAN4_FDC_BCM_BSD_Buzzer_Cmd, system-signal=CAN4_FDC_BCM_BSD_Buzzer_Cmd}, {implementation-record-element=CAN4_VCUKeyStatus, system-signal=CAN4_VCUKeyStatus}, {implementation-record-element=CAN4_FDC_BCM_WiperL_Cmd, system-signal=CAN4_FDC_BCM_WiperL_Cmd}, {implementation-record-element=CAN4_FDC_BCM_WiperH_Cmd, system-signal=CAN4_FDC_BCM_WiperH_Cmd}, {implementation-record-element=CAN4_FDC_BCM_Washer_Cmd, system-signal=CAN4_FDC_BCM_Washer_Cmd}, {implementation-record-element=CAN4_FDC_BCM_TurnLpPattern_Sta, system-signal=CAN4_FDC_BCM_TurnLpPattern_Sta}, {implementation-record-element=CAN4_FDC_BCM_Stop_IND_Cmd, system-signal=CAN4_FDC_BCM_Stop_IND_Cmd}, {implementation-record-element=CAN4_FDC_BCM_STOPBALL_Cmd, system-signal=CAN4_FDC_BCM_STOPBALL_Cmd}, {implementation-record-element=CAN4_FDC_BCM_SRTLp_Cmd, system-signal=CAN4_FDC_BCM_SRTLp_Cmd}, {implementation-record-element=CAN4_FDC_BCM_SMKR_Cmd, system-signal=CAN4_FDC_BCM_SMKR_Cmd}, {implementation-record-element=CAN4_FDC_BCM_SMKL_Cmd, system-signal=CAN4_FDC_BCM_SMKL_Cmd}, {implementation-record-element=CAN4_FDC_BCM_SLTLp_Cmd, system-signal=CAN4_FDC_BCM_SLTLp_Cmd}, {implementation-record-element=CAN4_FDC_BCM_RoomLpAmb_Cmd, system-signal=CAN4_FDC_BCM_RoomLpAmb_Cmd}, {implementation-record-element=CAN4_FDC_BCM_RTurnLp_Cmd, system-signal=CAN4_FDC_BCM_RTurnLp_Cmd}, {implementation-record-element=CAN4_FDC_BCM_RGear_Sta, system-signal=CAN4_FDC_BCM_RGear_Sta}, {implementation-record-element=CAN4_FDC_BCM_RFLamp_Cmd, system-signal=CAN4_FDC_BCM_RFLamp_Cmd}, {implementation-record-element=CAN4_FDC_BCM_RDoor_Sta, system-signal=CAN4_FDC_BCM_RDoor_Sta}, {implementation-record-element=CAN4_FDC_BCM_RDRL_Cmd, system-signal=CAN4_FDC_BCM_RDRL_Cmd}, {implementation-record-element=CAN4_FDC_BCM_RBSDY_Cmd, system-signal=CAN4_FDC_BCM_RBSDY_Cmd}, {implementation-record-element=CAN4_FDC_BCM_RBSDR_Cmd, system-signal=CAN4_FDC_BCM_RBSDR_Cmd}, {implementation-record-element=CAN4_FDC_BCM_PLamp_Cmd, system-signal=CAN4_FDC_BCM_PLamp_Cmd}, {implementation-record-element=CAN4_FDC_BCM_OutDoorOpenSW_Sta, system-signal=CAN4_FDC_BCM_OutDoorOpenSW_Sta}, {implementation-record-element=CAN4_FDC_BCM_MDoor_Sta, system-signal=CAN4_FDC_BCM_MDoor_Sta}, {implementation-record-element=CAN4_FDC_BCM_MDOpenSV_Cmd, system-signal=CAN4_FDC_BCM_MDOpenSV_Cmd}, {implementation-record-element=CAN4_FDC_BCM_MDCloseSV_Cmd, system-signal=CAN4_FDC_BCM_MDCloseSV_Cmd}, {implementation-record-element=CAN4_FDC_BCM_LTurnLp_Cmd, system-signal=CAN4_FDC_BCM_LTurnLp_Cmd}, {implementation-record-element=CAN4_FDC_BCM_LDRL_Cmd, system-signal=CAN4_FDC_BCM_LDRL_Cmd}, {implementation-record-element=CAN4_FDC_BCM_LBeam_Cmd, system-signal=CAN4_FDC_BCM_LBeam_Cmd}, {implementation-record-element=CAN4_FDC_BCM_LBSDY_Cmd, system-signal=CAN4_FDC_BCM_LBSDY_Cmd}, {implementation-record-element=CAN4_FDC_BCM_LBSDR_Cmd, system-signal=CAN4_FDC_BCM_LBSDR_Cmd}, {implementation-record-element=CAN4_FDC_BCM_InnerCallBell_Cmd, system-signal=CAN4_FDC_BCM_InnerCallBell_Cmd}, {implementation-record-element=CAN4_FDC_BCM_InnerBuzzer_Cmd, system-signal=CAN4_FDC_BCM_InnerBuzzer_Cmd}, {implementation-record-element=CAN4_FDC_BCM_InnerBuzzerMode_Sta, system-signal=CAN4_FDC_BCM_InnerBuzzerMode_Sta}, {implementation-record-element=CAN4_FDC_BCM_HBeam_Cmd, system-signal=CAN4_FDC_BCM_HBeam_Cmd}, {implementation-record-element=CAN4_FDC_BCM_FDoor_Sta, system-signal=CAN4_FDC_BCM_FDoor_Sta}, {implementation-record-element=CAN4_FDC_BCM_FDOpenSV_Cmd, system-signal=CAN4_FDC_BCM_FDOpenSV_Cmd}, {implementation-record-element=CAN4_FDC_BCM_FDCloseSV_Cmd, system-signal=CAN4_FDC_BCM_FDCloseSV_Cmd}, {implementation-record-element=CAN4_FDC_BCM_EmSV_Cmd, system-signal=CAN4_FDC_BCM_EmSV_Cmd}, {implementation-record-element=CAN4_FDC_BCM_EmExitSW_Sta, system-signal=CAN4_FDC_BCM_EmExitSW_Sta}, {implementation-record-element=CAN4_FDC_BCM_DVRSignalR_Cmd, system-signal=CAN4_FDC_BCM_DVRSignalR_Cmd}, {implementation-record-element=CAN4_FDC_BCM_DVRSignalL_Cmd, system-signal=CAN4_FDC_BCM_DVRSignalL_Cmd}, {implementation-record-element=CAN4_FDC_BCM_CallBell_Cmd, system-signal=CAN4_FDC_BCM_CallBell_Cmd}, {implementation-record-element=CAN4_FDC_BCM_Brake_Cmd, system-signal=CAN4_FDC_BCM_Brake_Cmd}]}
      MAP_HALOUTP_CAN4_FD4_CE100_1: sender-receiver-to-signal-group-mapping{communication-direction=OUT, data-element=SWC_HALOUT.root_FDC.P_CAN4_FD4_CE100_1.CAN4_SG_FD4_CE100_1, signal-group=CAN4_SG_FD4_CE100_1, type-mapping=sender-rec-record-type-mapping=record-element-mappings=[{implementation-record-element=CAN4_FDC_BCM_FRoomLp_Cmd, system-signal=CAN4_FDC_BCM_FRoomLp_Cmd}, {implementation-record-element=CAN4_FDC_THCM_CoolFanReq_Cmd, system-signal=CAN4_FDC_THCM_CoolFanReq_Cmd}, {implementation-record-element=CAN4_FDC_BCM_RRoomLp_Cmd, system-signal=CAN4_FDC_BCM_RRoomLp_Cmd}, {implementation-record-element=CAN4_FDC_BCM_MRoomLp_Cmd, system-signal=CAN4_FDC_BCM_MRoomLp_Cmd}]}
      MAP_HALOUTP_CAN5_FD5_C100_0: sender-receiver-to-signal-group-mapping{communication-direction=OUT, data-element=SWC_HALOUT.root_FDC.P_CAN5_FD5_C100_0.CAN5_SG_FD5_C100_0, signal-group=CAN5_SG_FD5_C100_0, type-mapping=sender-rec-record-type-mapping=record-element-mappings=[{implementation-record-element=CAN5_AlcLockSta, system-signal=CAN5_AlcLockSta}, {implementation-record-element=CAN5_VCUHVILSta, system-signal=CAN5_VCUHVILSta}, {implementation-record-element=CAN5_B2VAPlusSta, system-signal=CAN5_B2VAPlusSta}]}
      MAP_HALOUTP_CAN5_FD5_C200_0: sender-receiver-to-signal-group-mapping{communication-direction=OUT, data-element=SWC_HALOUT.root_FDC.P_CAN5_FD5_C200_0.CAN5_SG_FD5_C200_0, signal-group=CAN5_SG_FD5_C200_0, type-mapping=sender-rec-record-type-mapping=sender-rec-record-element-mapping{implementation-record-element=CAN5_SysPowerMode, system-signal=CAN5_SysPowerMode}}
      MAP_HALOUTP_CAN6_FD6_C200_0: sender-receiver-to-signal-group-mapping{communication-direction=OUT, data-element=SWC_HALOUT.root_FDC.P_CAN6_FD6_C200_0.CAN6_SG_FD6_C200_0, signal-group=CAN6_SG_FD6_C200_0, type-mapping=sender-rec-record-type-mapping=sender-rec-record-element-mapping{implementation-record-element=CAN6_SysPowerMode, system-signal=CAN6_SysPowerMode}}
      MAP_HALOUTP_CAN7_FD7_C100_0: sender-receiver-to-signal-group-mapping{communication-direction=OUT, data-element=SWC_HALOUT.root_FDC.P_CAN7_FD7_C100_0.CAN7_SG_FD7_C100_0, signal-group=CAN7_SG_FD7_C100_0, type-mapping=sender-rec-record-type-mapping=sender-rec-record-element-mapping{implementation-record-element=CAN7_VCUKeyStatus, system-signal=CAN7_VCUKeyStatus}}
      MAP_HALOUTP_CAN7_FD7_C10_0: sender-receiver-to-signal-group-mapping{communication-direction=OUT, data-element=SWC_HALOUT.root_FDC.P_CAN7_FD7_C10_0.CAN7_SG_FD7_C10_0, signal-group=CAN7_SG_FD7_C10_0, type-mapping=sender-rec-record-type-mapping=sender-rec-record-element-mapping{implementation-record-element=CAN7_EMotorSpd, system-signal=CAN7_EMotorSpd}}
      MAP_HALOUTP_CAN7_FD7_C200_0: sender-receiver-to-signal-group-mapping{communication-direction=OUT, data-element=SWC_HALOUT.root_FDC.P_CAN7_FD7_C200_0.CAN7_SG_FD7_C200_0, signal-group=CAN7_SG_FD7_C200_0, type-mapping=sender-rec-record-type-mapping=sender-rec-record-element-mapping{implementation-record-element=CAN7_SysPowerMode, system-signal=CAN7_SysPowerMode}}
      MAP_HALOUTP_CAN7_FD7_C50_0: sender-receiver-to-signal-group-mapping{communication-direction=OUT, data-element=SWC_HALOUT.root_FDC.P_CAN7_FD7_C50_0.CAN7_SG_FD7_C50_0, signal-group=CAN7_SG_FD7_C50_0, type-mapping=sender-rec-record-type-mapping=sender-rec-record-element-mapping{implementation-record-element=CAN7_AccPedalPos1, system-signal=CAN7_AccPedalPos1}}
      MAP_HALOUTP_CAN7_FD7_CE100_0: sender-receiver-to-signal-group-mapping{communication-direction=OUT, data-element=SWC_HALOUT.root_FDC.P_CAN7_FD7_CE100_0.CAN7_SG_FD7_CE100_0, signal-group=CAN7_SG_FD7_CE100_0, type-mapping=sender-rec-record-type-mapping=record-element-mappings=[{implementation-record-element=CAN7_FDC_BCM_DVRSignalL_Cmd, system-signal=CAN7_FDC_BCM_DVRSignalL_Cmd}, {implementation-record-element=CAN7_FDC_BCM_PLamp_Cmd, system-signal=CAN7_FDC_BCM_PLamp_Cmd}, {implementation-record-element=CAN7_FDC_BCM_MDoor_Sta, system-signal=CAN7_FDC_BCM_MDoor_Sta}, {implementation-record-element=CAN7_FDC_BCM_LBeam_Cmd, system-signal=CAN7_FDC_BCM_LBeam_Cmd}, {implementation-record-element=CAN7_FDC_BCM_HBeam_Cmd, system-signal=CAN7_FDC_BCM_HBeam_Cmd}, {implementation-record-element=CAN7_FDC_BCM_FDoor_Sta, system-signal=CAN7_FDC_BCM_FDoor_Sta}, {implementation-record-element=CAN7_FDC_BCM_DVRSignalR_Cmd, system-signal=CAN7_FDC_BCM_DVRSignalR_Cmd}]}
      MAP_HALIN_R_CAN1_AC_BTMS_C1000_0: sender-receiver-to-signal-group-mapping{communication-direction=IN, data-element=SWC_HALIN.root_FDC.R_CAN1_AC_BTMS_C1000_0.CAN1_SG_AC_BTMS_C1000_0, signal-group=CAN1_SG_AC_BTMS_C1000_0, type-mapping=sender-rec-record-type-mapping=record-element-mappings=[{implementation-record-element=CAN1_ACAmbTemp, system-signal=CAN1_ACAmbTemp}, {implementation-record-element=CAN1_THCM_Reserve4_Sta, system-signal=CAN1_THCM_Reserve4_Sta}, {implementation-record-element=CAN1_THCM_Reserve3_Sta, system-signal=CAN1_THCM_Reserve3_Sta}, {implementation-record-element=CAN1_THCM_Reserve2_Sta, system-signal=CAN1_THCM_Reserve2_Sta}, {implementation-record-element=CAN1_THCM_Reserve1_Sta, system-signal=CAN1_THCM_Reserve1_Sta}, {implementation-record-element=CAN1_ACCabinTemp, system-signal=CAN1_ACCabinTemp}]}
      MAP_HALIN_R_CAN1_AC_BTMS_C1000_1: sender-receiver-to-signal-group-mapping{communication-direction=IN, data-element=SWC_HALIN.root_FDC.R_CAN1_AC_BTMS_C1000_1.CAN1_SG_AC_BTMS_C1000_1, signal-group=CAN1_SG_AC_BTMS_C1000_1, type-mapping=sender-rec-record-type-mapping=record-element-mappings=[{implementation-record-element=CAN1_ACFanSpdSta, system-signal=CAN1_ACFanSpdSta}, {implementation-record-element=CAN1_THCM_Reserve9_Sta, system-signal=CAN1_THCM_Reserve9_Sta}, {implementation-record-element=CAN1_THCM_Reserve8_Sta, system-signal=CAN1_THCM_Reserve8_Sta}, {implementation-record-element=CAN1_THCM_Reserve7_Sta, system-signal=CAN1_THCM_Reserve7_Sta}, {implementation-record-element=CAN1_THCM_Reserve6_Sta, system-signal=CAN1_THCM_Reserve6_Sta}, {implementation-record-element=CAN1_THCM_Reserve5_Sta, system-signal=CAN1_THCM_Reserve5_Sta}, {implementation-record-element=CAN1_THCM_Reserve13_Sta, system-signal=CAN1_THCM_Reserve13_Sta}, {implementation-record-element=CAN1_THCM_Reserve12_Sta, system-signal=CAN1_THCM_Reserve12_Sta}, {implementation-record-element=CAN1_THCM_Reserve11_Sta, system-signal=CAN1_THCM_Reserve11_Sta}, {implementation-record-element=CAN1_THCM_Reserve10_Sta, system-signal=CAN1_THCM_Reserve10_Sta}, {implementation-record-element=CAN1_THCM_Outcycle_Sta, system-signal=CAN1_THCM_Outcycle_Sta}, {implementation-record-element=CAN1_ACPwrSta, system-signal=CAN1_ACPwrSta}, {implementation-record-element=CAN1_ACMODESta, system-signal=CAN1_ACMODESta}]}
      MAP_HALIN_R_CAN1_AC_BTMS_C1000_4: sender-receiver-to-signal-group-mapping{communication-direction=IN, data-element=SWC_HALIN.root_FDC.R_CAN1_AC_BTMS_C1000_4.CAN1_SG_AC_BTMS_C1000_4, signal-group=CAN1_SG_AC_BTMS_C1000_4, type-mapping=sender-rec-record-type-mapping=record-element-mappings=[{implementation-record-element=CAN1_TM2BFaultCode, system-signal=CAN1_TM2BFaultCode}, {implementation-record-element=CAN1_TM2BWorkStatus, system-signal=CAN1_TM2BWorkStatus}, {implementation-record-element=CAN1_TM2BTMSHVRlySta, system-signal=CAN1_TM2BTMSHVRlySta}, {implementation-record-element=CAN1_TM2BRQPower, system-signal=CAN1_TM2BRQPower}, {implementation-record-element=CAN1_TM2BOutletTemp, system-signal=CAN1_TM2BOutletTemp}, {implementation-record-element=CAN1_TM2BInletTemp, system-signal=CAN1_TM2BInletTemp}, {implementation-record-element=CAN1_TM2BFaultLv, system-signal=CAN1_TM2BFaultLv}]}
      MAP_HALIN_R_CAN1_AC_BTMS_C5000_0: sender-receiver-to-signal-group-mapping{communication-direction=IN, data-element=SWC_HALIN.root_FDC.R_CAN1_AC_BTMS_C5000_0.CAN1_SG_AC_BTMS_C5000_0, signal-group=CAN1_SG_AC_BTMS_C5000_0, type-mapping=sender-rec-record-type-mapping=sender-rec-record-element-mapping{implementation-record-element=CAN1_ACTempSetSta, system-signal=CAN1_ACTempSetSta}}
      MAP_HALIN_R_CAN1_ASC1_A: sender-receiver-to-signal-group-mapping{communication-direction=IN, data-element=SWC_HALIN.root_FDC.R_CAN1_ASC1_A.CAN1_SG_ASC1_A, signal-group=CAN1_SG_ASC1_A, type-mapping=sender-rec-record-type-mapping=sender-rec-record-element-mapping{implementation-record-element=CAN1_ASC1KneelingInfo, system-signal=CAN1_ASC1KneelingInfo}}
      MAP_HALIN_R_CAN1_EBC1: sender-receiver-to-signal-group-mapping{communication-direction=IN, data-element=SWC_HALIN.root_FDC.R_CAN1_EBC1.CAN1_SG_EBC1, signal-group=CAN1_SG_EBC1, type-mapping=sender-rec-record-type-mapping=record-element-mappings=[{implementation-record-element=CAN1_ABSFullyOper, system-signal=CAN1_ABSFullyOper}, {implementation-record-element=CAN1_TrailerABSWarnSig, system-signal=CAN1_TrailerABSWarnSig}, {implementation-record-element=CAN1_TrailerABSSta, system-signal=CAN1_TrailerABSSta}, {implementation-record-element=CAN1_TractCtrlOvrSw, system-signal=CAN1_TractCtrlOvrSw}, {implementation-record-element=CAN1_SACtrlBrakeCtrl, system-signal=CAN1_SACtrlBrakeCtrl}, {implementation-record-element=CAN1_RmAccelEnSw, system-signal=CAN1_RmAccelEnSw}, {implementation-record-element=CAN1_HaltBrakeSw, system-signal=CAN1_HaltBrakeSw}, {implementation-record-element=CAN1_EngRetSel, system-signal=CAN1_EngRetSel}, {implementation-record-element=CAN1_EngDerateSw, system-signal=CAN1_EngDerateSw}, {implementation-record-element=CAN1_EngAuxShutdownSw, system-signal=CAN1_EngAuxShutdownSw}, {implementation-record-element=CAN1_EBSRedWarnLampSta, system-signal=CAN1_EBSRedWarnLampSta}, {implementation-record-element=CAN1_EBSBrakeSw, system-signal=CAN1_EBSBrakeSw}, {implementation-record-element=CAN1_EBSAmWarnLampSta, system-signal=CAN1_EBSAmWarnLampSta}, {implementation-record-element=CAN1_BrakePedalPos, system-signal=CAN1_BrakePedalPos}, {implementation-record-element=CAN1_AntiLBrakABSAct, system-signal=CAN1_AntiLBrakABSAct}, {implementation-record-element=CAN1_AcltrInterlockSw, system-signal=CAN1_AcltrInterlockSw}, {implementation-record-element=CAN1_ATCASRInfoSig, system-signal=CAN1_ATCASRInfoSig}, {implementation-record-element=CAN1_ASROffroadSw, system-signal=CAN1_ASROffroadSw}, {implementation-record-element=CAN1_ASRHillHolderSw, system-signal=CAN1_ASRHillHolderSw}, {implementation-record-element=CAN1_ASREngCtrlAtc, system-signal=CAN1_ASREngCtrlAtc}, {implementation-record-element=CAN1_ASRBrakeCtrlAtc, system-signal=CAN1_ASRBrakeCtrlAtc}, {implementation-record-element=CAN1_ABSOffroadSw, system-signal=CAN1_ABSOffroadSw}]}
      MAP_HALIN_R_CAN1_EBC2: sender-receiver-to-signal-group-mapping{communication-direction=IN, data-element=SWC_HALIN.root_FDC.R_CAN1_EBC2.CAN1_SG_EBC2, signal-group=CAN1_SG_EBC2, type-mapping=sender-rec-record-type-mapping=record-element-mappings=[{implementation-record-element=CAN1_FASpeed, system-signal=CAN1_FASpeed}, {implementation-record-element=CAN1_RelaSpdRA2RWheel, system-signal=CAN1_RelaSpdRA2RWheel}, {implementation-record-element=CAN1_RelaSpdRA2LWheel, system-signal=CAN1_RelaSpdRA2LWheel}, {implementation-record-element=CAN1_RelaSpdRA1RWheel, system-signal=CAN1_RelaSpdRA1RWheel}, {implementation-record-element=CAN1_RelaSpdRA1LWheel, system-signal=CAN1_RelaSpdRA1LWheel}, {implementation-record-element=CAN1_RelaSpdFARWheel, system-signal=CAN1_RelaSpdFARWheel}, {implementation-record-element=CAN1_RelaSpdFALWheel, system-signal=CAN1_RelaSpdFALWheel}]}
      MAP_HALIN_R_CAN1_EBC5: sender-receiver-to-signal-group-mapping{communication-direction=IN, data-element=SWC_HALIN.root_FDC.R_CAN1_EBC5.CAN1_SG_EBC5, signal-group=CAN1_SG_EBC5, type-mapping=sender-rec-record-type-mapping=record-element-mappings=[{implementation-record-element=CAN1_BrkTempeWarn, system-signal=CAN1_BrkTempeWarn}, {implementation-record-element=CAN1_XBRSysSta, system-signal=CAN1_XBRSysSta}, {implementation-record-element=CAN1_XBRActtrlMode, system-signal=CAN1_XBRActtrlMode}, {implementation-record-element=CAN1_XBRAcltnLimit, system-signal=CAN1_XBRAcltnLimit}, {implementation-record-element=CAN1_RailroadMode, system-signal=CAN1_RailroadMode}, {implementation-record-element=CAN1_ParkBrkActuFAct, system-signal=CAN1_ParkBrkActuFAct}, {implementation-record-element=CAN1_HillHolderMode, system-signal=CAN1_HillHolderMode}, {implementation-record-element=CAN1_HaltBrkMode, system-signal=CAN1_HaltBrkMode}, {implementation-record-element=CAN1_FndBrkUse, system-signal=CAN1_FndBrkUse}, {implementation-record-element=CAN1_EmhBrkAct, system-signal=CAN1_EmhBrkAct}]}
      MAP_HALIN_R_CAN1_ECAS_DM1: sender-receiver-to-signal-group-mapping{communication-direction=IN, data-element=SWC_HALIN.root_FDC.R_CAN1_ECAS_DM1.CAN1_SG_ECAS_DM1, signal-group=CAN1_SG_ECAS_DM1, type-mapping=sender-rec-record-type-mapping=sender-rec-record-element-mapping{implementation-record-element=CAN1_ECASAWarmLampSta, system-signal=CAN1_ECASAWarmLampSta}}
      MAP_HALIN_R_CAN1_EMC1_EM1: sender-receiver-to-signal-group-mapping{communication-direction=IN, data-element=SWC_HALIN.root_FDC.R_CAN1_EMC1_EM1.CAN1_SG_EMC1_EM1, signal-group=CAN1_SG_EMC1_EM1, type-mapping=sender-rec-record-type-mapping=record-element-mappings=[{implementation-record-element=CAN1_EM1CS, system-signal=CAN1_EM1CS}, {implementation-record-element=CAN1_EM1ReqTorqLimDriv, system-signal=CAN1_EM1ReqTorqLimDriv}, {implementation-record-element=CAN1_EM1ReqTorqLimBrk, system-signal=CAN1_EM1ReqTorqLimBrk}, {implementation-record-element=CAN1_EM1ReqTorqHRlsDri, system-signal=CAN1_EM1ReqTorqHRlsDri}, {implementation-record-element=CAN1_EM1ReqTorqHRlsBrk, system-signal=CAN1_EM1ReqTorqHRlsBrk}, {implementation-record-element=CAN1_EM1OvrCtrlMPriDriv, system-signal=CAN1_EM1OvrCtrlMPriDriv}, {implementation-record-element=CAN1_EM1OvrCtrlMPriBrk, system-signal=CAN1_EM1OvrCtrlMPriBrk}, {implementation-record-element=CAN1_EM1OvrCtrlMDriv, system-signal=CAN1_EM1OvrCtrlMDriv}, {implementation-record-element=CAN1_EM1OvrCtrlMBrk, system-signal=CAN1_EM1OvrCtrlMBrk}, {implementation-record-element=CAN1_EM1Cnt, system-signal=CAN1_EM1Cnt}]}
      MAP_HALIN_R_CAN1_HRW: sender-receiver-to-signal-group-mapping{communication-direction=IN, data-element=SWC_HALIN.root_FDC.R_CAN1_HRW.CAN1_SG_HRW, signal-group=CAN1_SG_HRW, type-mapping=sender-rec-record-type-mapping=record-element-mappings=[{implementation-record-element=CAN1_WhlSpeed_FL, system-signal=CAN1_WhlSpeed_FL}, {implementation-record-element=CAN1_WhlSpeed_RR, system-signal=CAN1_WhlSpeed_RR}, {implementation-record-element=CAN1_WhlSpeed_RL, system-signal=CAN1_WhlSpeed_RL}, {implementation-record-element=CAN1_WhlSpeed_FR, system-signal=CAN1_WhlSpeed_FR}]}
      MAP_HALIN_R_CAN1_TC1: sender-receiver-to-signal-group-mapping{communication-direction=IN, data-element=SWC_HALIN.root_FDC.R_CAN1_TC1.CAN1_SG_TC1, signal-group=CAN1_SG_TC1, type-mapping=sender-rec-record-type-mapping=record-element-mappings=[{implementation-record-element=CAN1_DrivDirF, system-signal=CAN1_DrivDirF}, {implementation-record-element=CAN1_TransReqGear, system-signal=CAN1_TransReqGear}, {implementation-record-element=CAN1_LifeCnt, system-signal=CAN1_LifeCnt}, {implementation-record-element=CAN1_DrivDirR, system-signal=CAN1_DrivDirR}, {implementation-record-element=CAN1_DrivDirN, system-signal=CAN1_DrivDirN}]}
      MAP_HALIN_R_CAN2_IVI_C100_0: sender-receiver-to-signal-group-mapping{communication-direction=IN, data-element=SWC_HALIN.root_FDC.R_CAN2_IVI_C100_0.CAN2_SG_IVI_C100_0, signal-group=CAN2_SG_IVI_C100_0, type-mapping=sender-rec-record-type-mapping=record-element-mappings=[{implementation-record-element=CAN2_IVI_ACCoolTempSetdownReq_Cmd, system-signal=CAN2_IVI_ACCoolTempSetdownReq_Cmd}, {implementation-record-element=CAN2_IVI_ACTempSet_Cmd, system-signal=CAN2_IVI_ACTempSet_Cmd}, {implementation-record-element=CAN2_IVI_ACRemoteReq_Cmd, system-signal=CAN2_IVI_ACRemoteReq_Cmd}, {implementation-record-element=CAN2_IVI_ACPwrReq_Cmd, system-signal=CAN2_IVI_ACPwrReq_Cmd}, {implementation-record-element=CAN2_IVI_ACOutCycleReq_Cmd, system-signal=CAN2_IVI_ACOutCycleReq_Cmd}, {implementation-record-element=CAN2_IVI_ACMODEReq_Cmd, system-signal=CAN2_IVI_ACMODEReq_Cmd}, {implementation-record-element=CAN2_IVI_ACHeatTempSetUPReq_Cmd, system-signal=CAN2_IVI_ACHeatTempSetUPReq_Cmd}, {implementation-record-element=CAN2_IVI_ACHeatTempSetDownReq_Cmd, system-signal=CAN2_IVI_ACHeatTempSetDownReq_Cmd}, {implementation-record-element=CAN2_IVI_ACFanSpdReq_Cmd, system-signal=CAN2_IVI_ACFanSpdReq_Cmd}, {implementation-record-element=CAN2_IVI_ACCoolTempSetupReq_Cmd, system-signal=CAN2_IVI_ACCoolTempSetupReq_Cmd}]}
      MAP_HALIN_R_CAN3_B2TM_Info: sender-receiver-to-signal-group-mapping{communication-direction=IN, data-element=SWC_HALIN.root_FDC.R_CAN3_B2TM_Info.CAN3_SG_B2TM_Info, signal-group=CAN3_SG_B2TM_Info, type-mapping=sender-rec-record-type-mapping=record-element-mappings=[{implementation-record-element=CAN3_B2TChgSta, system-signal=CAN3_B2TChgSta}, {implementation-record-element=CAN3_B2TSetTemp, system-signal=CAN3_B2TSetTemp}, {implementation-record-element=CAN3_B2TSetModeA, system-signal=CAN3_B2TSetModeA}, {implementation-record-element=CAN3_B2TPackVol, system-signal=CAN3_B2TPackVol}, {implementation-record-element=CAN3_B2TMLifeSig, system-signal=CAN3_B2TMLifeSig}, {implementation-record-element=CAN3_B2TMCRC, system-signal=CAN3_B2TMCRC}, {implementation-record-element=CAN3_B2THVRlySta, system-signal=CAN3_B2THVRlySta}, {implementation-record-element=CAN3_B2THVCmd, system-signal=CAN3_B2THVCmd}]}
      MAP_HALIN_R_CAN3_B2V_BattInfo1: sender-receiver-to-signal-group-mapping{communication-direction=IN, data-element=SWC_HALIN.root_FDC.R_CAN3_B2V_BattInfo1.CAN3_SG_B2V_BattInfo1, signal-group=CAN3_SG_B2V_BattInfo1, type-mapping=sender-rec-record-type-mapping=record-element-mappings=[{implementation-record-element=CAN3_B2VBI1BattType, system-signal=CAN3_B2VBI1BattType}, {implementation-record-element=CAN3_B2VBI1RatePower, system-signal=CAN3_B2VBI1RatePower}, {implementation-record-element=CAN3_B2VBI1RateHVolt, system-signal=CAN3_B2VBI1RateHVolt}, {implementation-record-element=CAN3_B2VBI1RateCap, system-signal=CAN3_B2VBI1RateCap}]}
      MAP_HALIN_R_CAN3_B2V_CurrentLimit: sender-receiver-to-signal-group-mapping{communication-direction=IN, data-element=SWC_HALIN.root_FDC.R_CAN3_B2V_CurrentLimit.CAN3_SG_B2V_CurrentLimit, signal-group=CAN3_SG_B2V_CurrentLimit, type-mapping=sender-rec-record-type-mapping=record-element-mappings=[{implementation-record-element=CAN3_B2VAPlsDischgCurr, system-signal=CAN3_B2VAPlsDischgCurr}, {implementation-record-element=CAN3_B2VAvaPlsChgCurr, system-signal=CAN3_B2VAvaPlsChgCurr}]}
      MAP_HALIN_R_CAN3_B2V_Fult1_32960: sender-receiver-to-signal-group-mapping{communication-direction=IN, data-element=SWC_HALIN.root_FDC.R_CAN3_B2V_Fult1_32960.CAN3_SG_B2V_Fult1_32960, signal-group=CAN3_SG_B2V_Fult1_32960, type-mapping=sender-rec-record-type-mapping=sender-rec-record-element-mapping{implementation-record-element=CAN3_B2VHVILFault, system-signal=CAN3_B2VHVILFault}}
      MAP_HALIN_R_CAN3_B2V_ST1: sender-receiver-to-signal-group-mapping{communication-direction=IN, data-element=SWC_HALIN.root_FDC.R_CAN3_B2V_ST1.CAN3_SG_B2V_ST1, signal-group=CAN3_SG_B2V_ST1, type-mapping=sender-rec-record-type-mapping=record-element-mappings=[{implementation-record-element=CAN3_B2VACChgConnSta, system-signal=CAN3_B2VACChgConnSta}, {implementation-record-element=CAN3_B2VST1RChrgCy, system-signal=CAN3_B2VST1RChrgCy}, {implementation-record-element=CAN3_B2VPrechgRelaySta, system-signal=CAN3_B2VPrechgRelaySta}, {implementation-record-element=CAN3_B2VPChrgNegRlySta, system-signal=CAN3_B2VPChrgNegRlySta}, {implementation-record-element=CAN3_B2VPChrgConnSta, system-signal=CAN3_B2VPChrgConnSta}, {implementation-record-element=CAN3_B2VPChgPosRlySta, system-signal=CAN3_B2VPChgPosRlySta}, {implementation-record-element=CAN3_B2VMainPosRlySta, system-signal=CAN3_B2VMainPosRlySta}, {implementation-record-element=CAN3_B2VMainNegRlySta, system-signal=CAN3_B2VMainNegRlySta}, {implementation-record-element=CAN3_B2VHeatingSta, system-signal=CAN3_B2VHeatingSta}, {implementation-record-element=CAN3_B2VHeatPosRlySta, system-signal=CAN3_B2VHeatPosRlySta}, {implementation-record-element=CAN3_B2VHeatNegRelaySta, system-signal=CAN3_B2VHeatNegRelaySta}, {implementation-record-element=CAN3_B2VDCChgP2RlySta, system-signal=CAN3_B2VDCChgP2RlySta}, {implementation-record-element=CAN3_B2VDCChgP1RlySta, system-signal=CAN3_B2VDCChgP1RlySta}, {implementation-record-element=CAN3_B2VDCChgN2RlySta, system-signal=CAN3_B2VDCChgN2RlySta}, {implementation-record-element=CAN3_B2VDCChgN1RlySta, system-signal=CAN3_B2VDCChgN1RlySta}, {implementation-record-element=CAN3_B2VDCChgConnSta, system-signal=CAN3_B2VDCChgConnSta}, {implementation-record-element=CAN3_B2VCoolingSta, system-signal=CAN3_B2VCoolingSta}, {implementation-record-element=CAN3_B2VChgSta, system-signal=CAN3_B2VChgSta}, {implementation-record-element=CAN3_B2VChgMode, system-signal=CAN3_B2VChgMode}, {implementation-record-element=CAN3_B2VBMUHVSta, system-signal=CAN3_B2VBMUHVSta}, {implementation-record-element=CAN3_B2VBMUBalSta, system-signal=CAN3_B2VBMUBalSta}, {implementation-record-element=CAN3_B2VAux3RlySta, system-signal=CAN3_B2VAux3RlySta}, {implementation-record-element=CAN3_B2VAux2RlySta, system-signal=CAN3_B2VAux2RlySta}, {implementation-record-element=CAN3_B2VAux1RlySta, system-signal=CAN3_B2VAux1RlySta}, {implementation-record-element=CAN3_B2VACChgPosRlySta, system-signal=CAN3_B2VACChgPosRlySta}, {implementation-record-element=CAN3_B2VACChgNegRlySta, system-signal=CAN3_B2VACChgNegRlySta}]}
      MAP_HALIN_R_CAN3_B2V_ST2: sender-receiver-to-signal-group-mapping{communication-direction=IN, data-element=SWC_HALIN.root_FDC.R_CAN3_B2V_ST2.CAN3_SG_B2V_ST2, signal-group=CAN3_SG_B2V_ST2, type-mapping=sender-rec-record-type-mapping=record-element-mappings=[{implementation-record-element=CAN3_B2VFaultCode, system-signal=CAN3_B2VFaultCode}, {implementation-record-element=CAN3_B2VST2LifeSig, system-signal=CAN3_B2VST2LifeSig}, {implementation-record-element=CAN3_B2VSOH, system-signal=CAN3_B2VSOH}, {implementation-record-element=CAN3_B2VSOC, system-signal=CAN3_B2VSOC}, {implementation-record-element=CAN3_B2VRqHVPwrOff, system-signal=CAN3_B2VRqHVPwrOff}, {implementation-record-element=CAN3_B2VPackInsideVol, system-signal=CAN3_B2VPackInsideVol}, {implementation-record-element=CAN3_B2VPackCurr, system-signal=CAN3_B2VPackCurr}, {implementation-record-element=CAN3_B2VFaultLv, system-signal=CAN3_B2VFaultLv}]}
      MAP_HALIN_R_CAN3_B2V_ST4: sender-receiver-to-signal-group-mapping{communication-direction=IN, data-element=SWC_HALIN.root_FDC.R_CAN3_B2V_ST4.CAN3_SG_B2V_ST4, signal-group=CAN3_SG_B2V_ST4, type-mapping=sender-rec-record-type-mapping=record-element-mappings=[{implementation-record-element=CAN3_B2VCellAvgTemp, system-signal=CAN3_B2VCellAvgTemp}, {implementation-record-element=CAN3_B2VPackMinTemp, system-signal=CAN3_B2VPackMinTemp}, {implementation-record-element=CAN3_B2VPackMaxTemp, system-signal=CAN3_B2VPackMaxTemp}, {implementation-record-element=CAN3_B2VMinTempPos, system-signal=CAN3_B2VMinTempPos}, {implementation-record-element=CAN3_B2VMinTempCSCSN, system-signal=CAN3_B2VMinTempCSCSN}, {implementation-record-element=CAN3_B2VMaxTempPos, system-signal=CAN3_B2VMaxTempPos}, {implementation-record-element=CAN3_B2VMaxTempCSCSN, system-signal=CAN3_B2VMaxTempCSCSN}]}
      MAP_HALIN_R_CAN3_B2V_ST5: sender-receiver-to-signal-group-mapping{communication-direction=IN, data-element=SWC_HALIN.root_FDC.R_CAN3_B2V_ST5.CAN3_SG_B2V_ST5, signal-group=CAN3_SG_B2V_ST5, type-mapping=sender-rec-record-type-mapping=sender-rec-record-element-mapping{implementation-record-element=CAN3_B2VCellMinVol, system-signal=CAN3_B2VCellMinVol}}
      MAP_HALIN_R_CAN3_EWP1: sender-receiver-to-signal-group-mapping{communication-direction=IN, data-element=SWC_HALIN.root_FDC.R_CAN3_EWP1.CAN3_SG_EWP1, signal-group=CAN3_SG_EWP1, type-mapping=sender-rec-record-type-mapping=sender-rec-record-element-mapping{implementation-record-element=CAN3_EWPPEFault, system-signal=CAN3_EWPPEFault}}
      MAP_HALIN_R_CAN3_TM_MCUSta1: sender-receiver-to-signal-group-mapping{communication-direction=IN, data-element=SWC_HALIN.root_FDC.R_CAN3_TM_MCUSta1.CAN3_SG_TM_MCUSta1, signal-group=CAN3_SG_TM_MCUSta1, type-mapping=sender-rec-record-type-mapping=record-element-mappings=[{implementation-record-element=CAN3_AtvDisChgEnFbk, system-signal=CAN3_AtvDisChgEnFbk}, {implementation-record-element=CAN3_MotorTrq, system-signal=CAN3_MotorTrq}, {implementation-record-element=CAN3_MotorSpd, system-signal=CAN3_MotorSpd}, {implementation-record-element=CAN3_MCUMsgSta1LCnt, system-signal=CAN3_MCUMsgSta1LCnt}, {implementation-record-element=CAN3_MCUIGBTEnFbk, system-signal=CAN3_MCUIGBTEnFbk}, {implementation-record-element=CAN3_MCUCtrlMdSta, system-signal=CAN3_MCUCtrlMdSta}]}
      MAP_HALIN_R_CAN3_TM_MCUSta2: sender-receiver-to-signal-group-mapping{communication-direction=IN, data-element=SWC_HALIN.root_FDC.R_CAN3_TM_MCUSta2.CAN3_SG_TM_MCUSta2, signal-group=CAN3_SG_TM_MCUSta2, type-mapping=sender-rec-record-type-mapping=record-element-mappings=[{implementation-record-element=CAN3_MCUFailGrade, system-signal=CAN3_MCUFailGrade}, {implementation-record-element=CAN3_MotorTemp, system-signal=CAN3_MotorTemp}, {implementation-record-element=CAN3_MCUTrqLimLo, system-signal=CAN3_MCUTrqLimLo}, {implementation-record-element=CAN3_MCUTrqLimHi, system-signal=CAN3_MCUTrqLimHi}, {implementation-record-element=CAN3_MCUTemp, system-signal=CAN3_MCUTemp}, {implementation-record-element=CAN3_MCUMsgSta2LCnt, system-signal=CAN3_MCUMsgSta2LCnt}]}
      MAP_HALIN_R_CAN3_TM_MCUSta3: sender-receiver-to-signal-group-mapping{communication-direction=IN, data-element=SWC_HALIN.root_FDC.R_CAN3_TM_MCUSta3.CAN3_SG_TM_MCUSta3, signal-group=CAN3_SG_TM_MCUSta3, type-mapping=sender-rec-record-type-mapping=record-element-mappings=[{implementation-record-element=CAN3_MCUDCCur, system-signal=CAN3_MCUDCCur}, {implementation-record-element=CAN3_MCUFailCode, system-signal=CAN3_MCUFailCode}, {implementation-record-element=CAN3_MCUDCVol, system-signal=CAN3_MCUDCVol}]}
      MAP_HALIN_R_CAN4_ZFR_C100_0: sender-receiver-to-signal-group-mapping{communication-direction=IN, data-element=SWC_HALIN.root_FDC.R_CAN4_ZFR_C100_0.CAN4_SG_ZFR_C100_0, signal-group=CAN4_SG_ZFR_C100_0, type-mapping=sender-rec-record-type-mapping=sender-rec-record-element-mapping{implementation-record-element=CAN4_ParkBrakeSW, system-signal=CAN4_ParkBrakeSW}}
      MAP_HALIN_R_CAN4_ZFR_CE100_0: sender-receiver-to-signal-group-mapping{communication-direction=IN, data-element=SWC_HALIN.root_FDC.R_CAN4_ZFR_CE100_0.CAN4_SG_ZFR_CE100_0, signal-group=CAN4_SG_ZFR_CE100_0, type-mapping=sender-rec-record-type-mapping=record-element-mappings=[{implementation-record-element=CAN4_AirPressureFC2, system-signal=CAN4_AirPressureFC2}, {implementation-record-element=CAN4_ZFR_BCM_WiperL_Sta, system-signal=CAN4_ZFR_BCM_WiperL_Sta}, {implementation-record-element=CAN4_ZFR_BCM_WiperLSW_Sta, system-signal=CAN4_ZFR_BCM_WiperLSW_Sta}, {implementation-record-element=CAN4_ZFR_BCM_WiperH_Sta, system-signal=CAN4_ZFR_BCM_WiperH_Sta}, {implementation-record-element=CAN4_ZFR_BCM_WiperHSW_Sta, system-signal=CAN4_ZFR_BCM_WiperHSW_Sta}, {implementation-record-element=CAN4_ZFR_BCM_WiperAS_Sta, system-signal=CAN4_ZFR_BCM_WiperAS_Sta}, {implementation-record-element=CAN4_ZFR_BCM_Washer_Sta, system-signal=CAN4_ZFR_BCM_Washer_Sta}, {implementation-record-element=CAN4_ZFR_BCM_WasherSW_Sta, system-signal=CAN4_ZFR_BCM_WasherSW_Sta}, {implementation-record-element=CAN4_ZFR_BCM_TurnBuzzer_Sta, system-signal=CAN4_ZFR_BCM_TurnBuzzer_Sta}, {implementation-record-element=CAN4_ZFR_BCM_Seatbelt_Sta, system-signal=CAN4_ZFR_BCM_Seatbelt_Sta}, {implementation-record-element=CAN4_ZFR_BCM_RFogLp_SW_Sta, system-signal=CAN4_ZFR_BCM_RFogLp_SW_Sta}, {implementation-record-element=CAN4_ZFR_BCM_RFTurnLp_Sta, system-signal=CAN4_ZFR_BCM_RFTurnLp_Sta}, {implementation-record-element=CAN4_ZFR_BCM_RFTurnLpC_Sta, system-signal=CAN4_ZFR_BCM_RFTurnLpC_Sta}, {implementation-record-element=CAN4_ZFR_BCM_RDRL_Sta, system-signal=CAN4_ZFR_BCM_RDRL_Sta}, {implementation-record-element=CAN4_ZFR_BCM_RBSDY_Sta, system-signal=CAN4_ZFR_BCM_RBSDY_Sta}, {implementation-record-element=CAN4_ZFR_BCM_RBSDR_Sta, system-signal=CAN4_ZFR_BCM_RBSDR_Sta}, {implementation-record-element=CAN4_ZFR_BCM_PosLpSW_Sta, system-signal=CAN4_ZFR_BCM_PosLpSW_Sta}, {implementation-record-element=CAN4_ZFR_BCM_PLamp_Sta, system-signal=CAN4_ZFR_BCM_PLamp_Sta}, {implementation-record-element=CAN4_ZFR_BCM_LightSensorV_Sta, system-signal=CAN4_ZFR_BCM_LightSensorV_Sta}, {implementation-record-element=CAN4_ZFR_BCM_LFTurnLp_Sta, system-signal=CAN4_ZFR_BCM_LFTurnLp_Sta}, {implementation-record-element=CAN4_ZFR_BCM_LFTurnLpC_Sta, system-signal=CAN4_ZFR_BCM_LFTurnLpC_Sta}, {implementation-record-element=CAN4_ZFR_BCM_LDRL_Sta, system-signal=CAN4_ZFR_BCM_LDRL_Sta}, {implementation-record-element=CAN4_ZFR_BCM_LBeam_Sta, system-signal=CAN4_ZFR_BCM_LBeam_Sta}, {implementation-record-element=CAN4_ZFR_BCM_LBSDY_Sta, system-signal=CAN4_ZFR_BCM_LBSDY_Sta}, {implementation-record-element=CAN4_ZFR_BCM_LBSDR_Sta, system-signal=CAN4_ZFR_BCM_LBSDR_Sta}, {implementation-record-element=CAN4_ZFR_BCM_HornSW_Sta, system-signal=CAN4_ZFR_BCM_HornSW_Sta}, {implementation-record-element=CAN4_ZFR_BCM_HeadLpSW_Sta, system-signal=CAN4_ZFR_BCM_HeadLpSW_Sta}, {implementation-record-element=CAN4_ZFR_BCM_HBeam_Sta, system-signal=CAN4_ZFR_BCM_HBeam_Sta}, {implementation-record-element=CAN4_ZFR_BCM_HBeamSW_Sta, system-signal=CAN4_ZFR_BCM_HBeamSW_Sta}, {implementation-record-element=CAN4_ZFR_BCM_DVRSignalReverse_Sta, system-signal=CAN4_ZFR_BCM_DVRSignalReverse_Sta}, {implementation-record-element=CAN4_ZFR_BCM_DVRSignalR_Sta, system-signal=CAN4_ZFR_BCM_DVRSignalR_Sta}, {implementation-record-element=CAN4_ZFR_BCM_DVRSignalL_Sta, system-signal=CAN4_ZFR_BCM_DVRSignalL_Sta}, {implementation-record-element=CAN4_ZFR_BCM_DVRMidDoor_Sta, system-signal=CAN4_ZFR_BCM_DVRMidDoor_Sta}, {implementation-record-element=CAN4_ZFR_BCM_Brake_Sta, system-signal=CAN4_ZFR_BCM_Brake_Sta}, {implementation-record-element=CAN4_ZFR_BCM_BacklightDuty_Sta, system-signal=CAN4_ZFR_BCM_BacklightDuty_Sta}, {implementation-record-element=CAN4_ZFR_BCM_BSD_Dimmer_Sta, system-signal=CAN4_ZFR_BCM_BSD_Dimmer_Sta}, {implementation-record-element=CAN4_ZFR_BCM_AutoLightSW_Sta, system-signal=CAN4_ZFR_BCM_AutoLightSW_Sta}]}
      MAP_HALIN_R_CAN4_ZRR_CE100_0: sender-receiver-to-signal-group-mapping{communication-direction=IN, data-element=SWC_HALIN.root_FDC.R_CAN4_ZRR_CE100_0.CAN4_SG_ZRR_CE100_0, signal-group=CAN4_SG_ZRR_CE100_0, type-mapping=sender-rec-record-type-mapping=sender-rec-record-element-mapping{implementation-record-element=CAN4_ZRR_BCM_AllDoor_Sta, system-signal=CAN4_ZRR_BCM_AllDoor_Sta}}
      MAP_HALIN_R_CAN4_ZRR_CE100_1: sender-receiver-to-signal-group-mapping{communication-direction=IN, data-element=SWC_HALIN.root_FDC.R_CAN4_ZRR_CE100_1.CAN4_SG_ZRR_CE100_1, signal-group=CAN4_SG_ZRR_CE100_1, type-mapping=sender-rec-record-type-mapping=record-element-mappings=[{implementation-record-element=CAN4_AirPressurePC3, system-signal=CAN4_AirPressurePC3}, {implementation-record-element=CAN4_ZRR_BCM_TurnBuzzer_Sta, system-signal=CAN4_ZRR_BCM_TurnBuzzer_Sta}, {implementation-record-element=CAN4_ZRR_BCM_StopLight_Sta, system-signal=CAN4_ZRR_BCM_StopLight_Sta}, {implementation-record-element=CAN4_ZRR_BCM_STOPSW_Sta, system-signal=CAN4_ZRR_BCM_STOPSW_Sta}, {implementation-record-element=CAN4_ZRR_BCM_STOPSW2_Sta, system-signal=CAN4_ZRR_BCM_STOPSW2_Sta}, {implementation-record-element=CAN4_ZRR_BCM_SRTLp_Sta, system-signal=CAN4_ZRR_BCM_SRTLp_Sta}, {implementation-record-element=CAN4_ZRR_BCM_SMKR_Sta, system-signal=CAN4_ZRR_BCM_SMKR_Sta}, {implementation-record-element=CAN4_ZRR_BCM_SMKL_Sta, system-signal=CAN4_ZRR_BCM_SMKL_Sta}, {implementation-record-element=CAN4_ZRR_BCM_SLTLp_Sta, system-signal=CAN4_ZRR_BCM_SLTLp_Sta}, {implementation-record-element=CAN4_ZRR_BCM_RoomLpAmb_Sta, system-signal=CAN4_ZRR_BCM_RoomLpAmb_Sta}, {implementation-record-element=CAN4_ZRR_BCM_ReverseLp_Sta, system-signal=CAN4_ZRR_BCM_ReverseLp_Sta}, {implementation-record-element=CAN4_ZRR_BCM_ReverseBuz_Sta, system-signal=CAN4_ZRR_BCM_ReverseBuz_Sta}, {implementation-record-element=CAN4_ZRR_BCM_RRTurnLp_Sta, system-signal=CAN4_ZRR_BCM_RRTurnLp_Sta}, {implementation-record-element=CAN4_ZRR_BCM_RRTurnLpC_Sta, system-signal=CAN4_ZRR_BCM_RRTurnLpC_Sta}, {implementation-record-element=CAN4_ZRR_BCM_RFLamp_Sta, system-signal=CAN4_ZRR_BCM_RFLamp_Sta}, {implementation-record-element=CAN4_ZRR_BCM_PLamp_Sta, system-signal=CAN4_ZRR_BCM_PLamp_Sta}, {implementation-record-element=CAN4_ZRR_BCM_MDoorAP_Sta, system-signal=CAN4_ZRR_BCM_MDoorAP_Sta}, {implementation-record-element=CAN4_ZRR_BCM_MDOpenSV_Sta, system-signal=CAN4_ZRR_BCM_MDOpenSV_Sta}, {implementation-record-element=CAN4_ZRR_BCM_MDCloseSV_Sta, system-signal=CAN4_ZRR_BCM_MDCloseSV_Sta}, {implementation-record-element=CAN4_ZRR_BCM_LRTurnLp_Sta, system-signal=CAN4_ZRR_BCM_LRTurnLp_Sta}, {implementation-record-element=CAN4_ZRR_BCM_LRTurnLpC_Sta, system-signal=CAN4_ZRR_BCM_LRTurnLpC_Sta}, {implementation-record-element=CAN4_ZRR_BCM_FDoorAP_Sta, system-signal=CAN4_ZRR_BCM_FDoorAP_Sta}, {implementation-record-element=CAN4_ZRR_BCM_FDOpenSV_Sta, system-signal=CAN4_ZRR_BCM_FDOpenSV_Sta}, {implementation-record-element=CAN4_ZRR_BCM_FDCloseSV_Sta, system-signal=CAN4_ZRR_BCM_FDCloseSV_Sta}, {implementation-record-element=CAN4_ZRR_BCM_EmSV_Sta, system-signal=CAN4_ZRR_BCM_EmSV_Sta}, {implementation-record-element=CAN4_ZRR_BCM_EmLight_Sta, system-signal=CAN4_ZRR_BCM_EmLight_Sta}, {implementation-record-element=CAN4_ZRR_BCM_CallingSW_Sta, system-signal=CAN4_ZRR_BCM_CallingSW_Sta}, {implementation-record-element=CAN4_ZRR_BCM_BrakeLp_Sta, system-signal=CAN4_ZRR_BCM_BrakeLp_Sta}, {implementation-record-element=CAN4_FDC_CHASSIS_VCUEACPress_Sta, system-signal=CAN4_FDC_CHASSIS_VCUEACPress_Sta}, {implementation-record-element=CAN4_AirPressureRC1, system-signal=CAN4_AirPressureRC1}]}
      MAP_HALIN_R_CAN4_zGW_CANRr1_C50_0: sender-receiver-to-signal-group-mapping{communication-direction=IN, data-element=SWC_HALIN.root_FDC.R_CAN4_zGW_CANRr1_C50_0.CAN4_SG_zGW_CANRr1_C50_0, signal-group=CAN4_SG_zGW_CANRr1_C50_0, type-mapping=sender-rec-record-type-mapping=record-element-mappings=[{implementation-record-element=CAN4_DCDC_En_Sta, system-signal=CAN4_DCDC_En_Sta}, {implementation-record-element=CAN4_PDU_SelfChk_Sta, system-signal=CAN4_PDU_SelfChk_Sta}, {implementation-record-element=CAN4_PDU_MCUPreRly_Sta, system-signal=CAN4_PDU_MCUPreRly_Sta}, {implementation-record-element=CAN4_PDU_MCUPosRly_Sta, system-signal=CAN4_PDU_MCUPosRly_Sta}, {implementation-record-element=CAN4_PDU_MCUHVLoop_Sta, system-signal=CAN4_PDU_MCUHVLoop_Sta}, {implementation-record-element=CAN4_PDU_LifeSig_Sta, system-signal=CAN4_PDU_LifeSig_Sta}, {implementation-record-element=CAN4_PDU_HVIL_Sta, system-signal=CAN4_PDU_HVIL_Sta}, {implementation-record-element=CAN4_PDU_DeFogTMSRly_Sta, system-signal=CAN4_PDU_DeFogTMSRly_Sta}, {implementation-record-element=CAN4_PDU_DCDCEACEHPSRly_Sta, system-signal=CAN4_PDU_DCDCEACEHPSRly_Sta}, {implementation-record-element=CAN4_PDU_DCDCEACEHPSPreRly_Sta, system-signal=CAN4_PDU_DCDCEACEHPSPreRly_Sta}, {implementation-record-element=CAN4_PDU_DCDCEACEHPSHVLoop_Sta, system-signal=CAN4_PDU_DCDCEACEHPSHVLoop_Sta}, {implementation-record-element=CAN4_PDU_ACRly_Sta, system-signal=CAN4_PDU_ACRly_Sta}, {implementation-record-element=CAN4_EHPS_MotorSpd_Sta, system-signal=CAN4_EHPS_MotorSpd_Sta}, {implementation-record-element=CAN4_EHPS_LifeSig_Sta, system-signal=CAN4_EHPS_LifeSig_Sta}, {implementation-record-element=CAN4_EHPS_InvTemp_Sta, system-signal=CAN4_EHPS_InvTemp_Sta}, {implementation-record-element=CAN4_EHPS_ErrLv_Sta, system-signal=CAN4_EHPS_ErrLv_Sta}, {implementation-record-element=CAN4_EHPS_En_Sta, system-signal=CAN4_EHPS_En_Sta}, {implementation-record-element=CAN4_EAC_LifeSig_Sta, system-signal=CAN4_EAC_LifeSig_Sta}, {implementation-record-element=CAN4_EAC_InvTemp_Sta, system-signal=CAN4_EAC_InvTemp_Sta}, {implementation-record-element=CAN4_EAC_ErrLv_Sta, system-signal=CAN4_EAC_ErrLv_Sta}, {implementation-record-element=CAN4_EAC_En_Sta, system-signal=CAN4_EAC_En_Sta}, {implementation-record-element=CAN4_DCDC_Temp_Sta, system-signal=CAN4_DCDC_Temp_Sta}, {implementation-record-element=CAN4_DCDC_OutVol_Sta, system-signal=CAN4_DCDC_OutVol_Sta}, {implementation-record-element=CAN4_DCDC_LifeSig_Sta, system-signal=CAN4_DCDC_LifeSig_Sta}, {implementation-record-element=CAN4_DCDC_ErrLv_Sta, system-signal=CAN4_DCDC_ErrLv_Sta}]}
      MAP_CGW_P_CAN1_FD1_C1000_0: sender-receiver-to-signal-group-mapping{communication-direction=OUT, data-element=SWC_CGW.root_FDC.P_CAN1_FD1_C1000_0.CAN1_SG_FD1_C1000_0, signal-group=CAN1_SG_FD1_C1000_0, type-mapping=sender-rec-record-type-mapping=record-element-mappings=[{implementation-record-element=CAN1_AirPressureFC2, system-signal=CAN1_AirPressureFC2}, {implementation-record-element=CAN1_AirPressureRC1, system-signal=CAN1_AirPressureRC1}, {implementation-record-element=CAN1_AirPressurePC3, system-signal=CAN1_AirPressurePC3}]}
      MAP_CGW_P_CAN1_CGW_FD1_C100_3: sender-receiver-to-signal-group-mapping{communication-direction=OUT, data-element=SWC_CGW.root_FDC.P_CAN1_CGW_FD1_C100_3.CAN1_SG_CGW_FD1_C100_3, signal-group=CAN1_SG_CGW_FD1_C100_3, type-mapping=sender-rec-record-type-mapping=sender-rec-record-element-mapping{implementation-record-element=CAN1_ParkBrakeSW, system-signal=CAN1_ParkBrakeSW}}
      MAP_CGW_P_CAN2_CGW_FD2_C1000_0: sender-receiver-to-signal-group-mapping{communication-direction=OUT, data-element=SWC_CGW.root_FDC.P_CAN2_CGW_FD2_C1000_0.CAN2_SG_CGW_FD2_C1000_0, signal-group=CAN2_SG_CGW_FD2_C1000_0, type-mapping=sender-rec-record-type-mapping=record-element-mappings=[{implementation-record-element=CAN2_ACMODESta, system-signal=CAN2_ACMODESta}, {implementation-record-element=CAN2_TPMSWarnIndi, system-signal=CAN2_TPMSWarnIndi}, {implementation-record-element=CAN2_THCM_Faultlv_Sta, system-signal=CAN2_THCM_Faultlv_Sta}, {implementation-record-element=CAN2_RFWheelTmpIndi, system-signal=CAN2_RFWheelTmpIndi}, {implementation-record-element=CAN2_RFWheelTemp, system-signal=CAN2_RFWheelTemp}, {implementation-record-element=CAN2_RFWheelPress, system-signal=CAN2_RFWheelPress}, {implementation-record-element=CAN2_RFSensorFail, system-signal=CAN2_RFSensorFail}, {implementation-record-element=CAN2_RFPressIndi, system-signal=CAN2_RFPressIndi}, {implementation-record-element=CAN2_RFBatWarn, system-signal=CAN2_RFBatWarn}, {implementation-record-element=CAN2_RBOWheelTmpIndi, system-signal=CAN2_RBOWheelTmpIndi}, {implementation-record-element=CAN2_RBOWheelTemp, system-signal=CAN2_RBOWheelTemp}, {implementation-record-element=CAN2_RBOWheelPress, system-signal=CAN2_RBOWheelPress}, {implementation-record-element=CAN2_RBOSensorFail, system-signal=CAN2_RBOSensorFail}, {implementation-record-element=CAN2_RBOPressIndi, system-signal=CAN2_RBOPressIndi}, {implementation-record-element=CAN2_RBOBatWarn, system-signal=CAN2_RBOBatWarn}, {implementation-record-element=CAN2_RBIWheelTmpIndi, system-signal=CAN2_RBIWheelTmpIndi}, {implementation-record-element=CAN2_RBIWheelPress, system-signal=CAN2_RBIWheelPress}, {implementation-record-element=CAN2_RBISensorFail, system-signal=CAN2_RBISensorFail}, {implementation-record-element=CAN2_RBIPressIndi, system-signal=CAN2_RBIPressIndi}, {implementation-record-element=CAN2_RBIBatWarn, system-signal=CAN2_RBIBatWarn}, {implementation-record-element=CAN2_LFWheelTmpIndi, system-signal=CAN2_LFWheelTmpIndi}, {implementation-record-element=CAN2_LFWheelTemp, system-signal=CAN2_LFWheelTemp}, {implementation-record-element=CAN2_LFWheelPress, system-signal=CAN2_LFWheelPress}, {implementation-record-element=CAN2_LFSensorFail, system-signal=CAN2_LFSensorFail}, {implementation-record-element=CAN2_LFPressIndi, system-signal=CAN2_LFPressIndi}, {implementation-record-element=CAN2_LFBatWarn, system-signal=CAN2_LFBatWarn}, {implementation-record-element=CAN2_LBOWheelTmpIndi, system-signal=CAN2_LBOWheelTmpIndi}, {implementation-record-element=CAN2_LBOWheelTemp, system-signal=CAN2_LBOWheelTemp}, {implementation-record-element=CAN2_LBOWheelPress, system-signal=CAN2_LBOWheelPress}, {implementation-record-element=CAN2_LBOSensorFail, system-signal=CAN2_LBOSensorFail}, {implementation-record-element=CAN2_LBOPressIndi, system-signal=CAN2_LBOPressIndi}, {implementation-record-element=CAN2_LBOBatWarn, system-signal=CAN2_LBOBatWarn}, {implementation-record-element=CAN2_LBIWheelTmpIndi, system-signal=CAN2_LBIWheelTmpIndi}, {implementation-record-element=CAN2_LBIWheelTemp, system-signal=CAN2_LBIWheelTemp}, {implementation-record-element=CAN2_LBIWheelPress, system-signal=CAN2_LBIWheelPress}, {implementation-record-element=CAN2_LBISensorFail, system-signal=CAN2_LBISensorFail}, {implementation-record-element=CAN2_LBIPressIndi, system-signal=CAN2_LBIPressIndi}, {implementation-record-element=CAN2_LBIBatWarn, system-signal=CAN2_LBIBatWarn}]}
      MAP_CGW_P_CAN2_CGW_GW2_C100_0: sender-receiver-to-signal-group-mapping{communication-direction=OUT, data-element=SWC_CGW.root_FDC.P_CAN2_CGW_GW2_C100_0.CAN2_SG_CGW_GW2_C100_0, signal-group=CAN2_SG_CGW_GW2_C100_0, type-mapping=sender-rec-record-type-mapping=record-element-mappings=[{implementation-record-element=CAN2_ABSFullyOper, system-signal=CAN2_ABSFullyOper}, {implementation-record-element=CAN2_ZRR_CHASSIS_LiningWearRR_Sta, system-signal=CAN2_ZRR_CHASSIS_LiningWearRR_Sta}, {implementation-record-element=CAN2_ZRR_CHASSIS_LiningWearRL_Sta, system-signal=CAN2_ZRR_CHASSIS_LiningWearRL_Sta}, {implementation-record-element=CAN2_ZFR_CHASSIS_LiningWearFR_Sta, system-signal=CAN2_ZFR_CHASSIS_LiningWearFR_Sta}, {implementation-record-element=CAN2_ZFR_CHASSIS_LiningWearFL_Sta, system-signal=CAN2_ZFR_CHASSIS_LiningWearFL_Sta}, {implementation-record-element=CAN2_WhlSpeed_RR, system-signal=CAN2_WhlSpeed_RR}, {implementation-record-element=CAN2_WhlSpeed_RL, system-signal=CAN2_WhlSpeed_RL}, {implementation-record-element=CAN2_WhlSpeed_FR, system-signal=CAN2_WhlSpeed_FR}, {implementation-record-element=CAN2_WhlSpeed_FL, system-signal=CAN2_WhlSpeed_FL}, {implementation-record-element=CAN2_VDCBrakeLightReq, system-signal=CAN2_VDCBrakeLightReq}, {implementation-record-element=CAN2_TransReqGear, system-signal=CAN2_TransReqGear}, {implementation-record-element=CAN2_ParkBrakeSW, system-signal=CAN2_ParkBrakeSW}, {implementation-record-element=CAN2_MCUFailGrade, system-signal=CAN2_MCUFailGrade}, {implementation-record-element=CAN2_EHPS_ErrLv_Sta, system-signal=CAN2_EHPS_ErrLv_Sta}, {implementation-record-element=CAN2_ECASAWarmLampSta, system-signal=CAN2_ECASAWarmLampSta}, {implementation-record-element=CAN2_EBSRedWarnLampSta, system-signal=CAN2_EBSRedWarnLampSta}, {implementation-record-element=CAN2_EBSBrakeSw, system-signal=CAN2_EBSBrakeSw}, {implementation-record-element=CAN2_EBSAmWarnLampSta, system-signal=CAN2_EBSAmWarnLampSta}, {implementation-record-element=CAN2_DCDC_En_Sta, system-signal=CAN2_DCDC_En_Sta}, {implementation-record-element=CAN2_B2VSOH, system-signal=CAN2_B2VSOH}, {implementation-record-element=CAN2_B2VSOC, system-signal=CAN2_B2VSOC}, {implementation-record-element=CAN2_B2VPChrgConnSta, system-signal=CAN2_B2VPChrgConnSta}, {implementation-record-element=CAN2_B2VFaultCode, system-signal=CAN2_B2VFaultCode}, {implementation-record-element=CAN2_B2VDCChgConnSta, system-signal=CAN2_B2VDCChgConnSta}, {implementation-record-element=CAN2_B2VChgSta, system-signal=CAN2_B2VChgSta}, {implementation-record-element=CAN2_B2VChgMode, system-signal=CAN2_B2VChgMode}, {implementation-record-element=CAN2_B2VBI1RatePower, system-signal=CAN2_B2VBI1RatePower}, {implementation-record-element=CAN2_B2VBI1RateHVolt, system-signal=CAN2_B2VBI1RateHVolt}, {implementation-record-element=CAN2_B2VBI1RateCap, system-signal=CAN2_B2VBI1RateCap}, {implementation-record-element=CAN2_B2VBI1BattType, system-signal=CAN2_B2VBI1BattType}, {implementation-record-element=CAN2_B2THVRlySta, system-signal=CAN2_B2THVRlySta}, {implementation-record-element=CAN2_AirPressureRC1, system-signal=CAN2_AirPressureRC1}, {implementation-record-element=CAN2_ASREngCtrlAtc, system-signal=CAN2_ASREngCtrlAtc}, {implementation-record-element=CAN2_ASRBrakeCtrlAtc, system-signal=CAN2_ASRBrakeCtrlAtc}, {implementation-record-element=CAN2_ASC1KneelingInfo, system-signal=CAN2_ASC1KneelingInfo}, {implementation-record-element=CAN2_ACTempSetSta, system-signal=CAN2_ACTempSetSta}]}
      MAP_CGW_R_CAN1_AC_BTMS_C1000_1: sender-receiver-to-signal-group-mapping{communication-direction=IN, data-element=SWC_CGW.root_FDC.R_CAN1_AC_BTMS_C1000_1.CAN1_SG_AC_BTMS_C1000_1, signal-group=CAN1_SG_AC_BTMS_C1000_1, type-mapping=sender-rec-record-type-mapping=record-element-mappings=[{implementation-record-element=CAN1_ACFanSpdSta, system-signal=CAN1_ACFanSpdSta}, {implementation-record-element=CAN1_THCM_Reserve9_Sta, system-signal=CAN1_THCM_Reserve9_Sta}, {implementation-record-element=CAN1_THCM_Reserve8_Sta, system-signal=CAN1_THCM_Reserve8_Sta}, {implementation-record-element=CAN1_THCM_Reserve7_Sta, system-signal=CAN1_THCM_Reserve7_Sta}, {implementation-record-element=CAN1_THCM_Reserve6_Sta, system-signal=CAN1_THCM_Reserve6_Sta}, {implementation-record-element=CAN1_THCM_Reserve5_Sta, system-signal=CAN1_THCM_Reserve5_Sta}, {implementation-record-element=CAN1_THCM_Reserve13_Sta, system-signal=CAN1_THCM_Reserve13_Sta}, {implementation-record-element=CAN1_THCM_Reserve12_Sta, system-signal=CAN1_THCM_Reserve12_Sta}, {implementation-record-element=CAN1_THCM_Reserve11_Sta, system-signal=CAN1_THCM_Reserve11_Sta}, {implementation-record-element=CAN1_THCM_Reserve10_Sta, system-signal=CAN1_THCM_Reserve10_Sta}, {implementation-record-element=CAN1_THCM_Outcycle_Sta, system-signal=CAN1_THCM_Outcycle_Sta}, {implementation-record-element=CAN1_ACPwrSta, system-signal=CAN1_ACPwrSta}, {implementation-record-element=CAN1_ACMODESta, system-signal=CAN1_ACMODESta}]}
      MAP_CGW_R_CAN1_AC_BTMS_C1000_2: sender-receiver-to-signal-group-mapping{communication-direction=IN, data-element=SWC_CGW.root_FDC.R_CAN1_AC_BTMS_C1000_2.CAN1_SG_AC_BTMS_C1000_2, signal-group=CAN1_SG_AC_BTMS_C1000_2, type-mapping=sender-rec-record-type-mapping=sender-rec-record-element-mapping{implementation-record-element=CAN1_THCM_Faultlv_Sta, system-signal=CAN1_THCM_Faultlv_Sta}}
      MAP_CGW_R_CAN1_AC_BTMS_C5000_0: sender-receiver-to-signal-group-mapping{communication-direction=IN, data-element=SWC_CGW.root_FDC.R_CAN1_AC_BTMS_C5000_0.CAN1_SG_AC_BTMS_C5000_0, signal-group=CAN1_SG_AC_BTMS_C5000_0, type-mapping=sender-rec-record-type-mapping=sender-rec-record-element-mapping{implementation-record-element=CAN1_ACTempSetSta, system-signal=CAN1_ACTempSetSta}}
      MAP_CGW_R_CAN1_ASC1_A: sender-receiver-to-signal-group-mapping{communication-direction=IN, data-element=SWC_CGW.root_FDC.R_CAN1_ASC1_A.CAN1_SG_ASC1_A, signal-group=CAN1_SG_ASC1_A, type-mapping=sender-rec-record-type-mapping=sender-rec-record-element-mapping{implementation-record-element=CAN1_ASC1KneelingInfo, system-signal=CAN1_ASC1KneelingInfo}}
      MAP_CGW_R_CAN1_EBC1: sender-receiver-to-signal-group-mapping{communication-direction=IN, data-element=SWC_CGW.root_FDC.R_CAN1_EBC1.CAN1_SG_EBC1, signal-group=CAN1_SG_EBC1, type-mapping=sender-rec-record-type-mapping=record-element-mappings=[{implementation-record-element=CAN1_ABSFullyOper, system-signal=CAN1_ABSFullyOper}, {implementation-record-element=CAN1_TrailerABSWarnSig, system-signal=CAN1_TrailerABSWarnSig}, {implementation-record-element=CAN1_TrailerABSSta, system-signal=CAN1_TrailerABSSta}, {implementation-record-element=CAN1_TractCtrlOvrSw, system-signal=CAN1_TractCtrlOvrSw}, {implementation-record-element=CAN1_SACtrlBrakeCtrl, system-signal=CAN1_SACtrlBrakeCtrl}, {implementation-record-element=CAN1_RmAccelEnSw, system-signal=CAN1_RmAccelEnSw}, {implementation-record-element=CAN1_HaltBrakeSw, system-signal=CAN1_HaltBrakeSw}, {implementation-record-element=CAN1_EngRetSel, system-signal=CAN1_EngRetSel}, {implementation-record-element=CAN1_EngDerateSw, system-signal=CAN1_EngDerateSw}, {implementation-record-element=CAN1_EngAuxShutdownSw, system-signal=CAN1_EngAuxShutdownSw}, {implementation-record-element=CAN1_EBSRedWarnLampSta, system-signal=CAN1_EBSRedWarnLampSta}, {implementation-record-element=CAN1_EBSBrakeSw, system-signal=CAN1_EBSBrakeSw}, {implementation-record-element=CAN1_EBSAmWarnLampSta, system-signal=CAN1_EBSAmWarnLampSta}, {implementation-record-element=CAN1_BrakePedalPos, system-signal=CAN1_BrakePedalPos}, {implementation-record-element=CAN1_AntiLBrakABSAct, system-signal=CAN1_AntiLBrakABSAct}, {implementation-record-element=CAN1_AcltrInterlockSw, system-signal=CAN1_AcltrInterlockSw}, {implementation-record-element=CAN1_ATCASRInfoSig, system-signal=CAN1_ATCASRInfoSig}, {implementation-record-element=CAN1_ASROffroadSw, system-signal=CAN1_ASROffroadSw}, {implementation-record-element=CAN1_ASRHillHolderSw, system-signal=CAN1_ASRHillHolderSw}, {implementation-record-element=CAN1_ASREngCtrlAtc, system-signal=CAN1_ASREngCtrlAtc}, {implementation-record-element=CAN1_ASRBrakeCtrlAtc, system-signal=CAN1_ASRBrakeCtrlAtc}, {implementation-record-element=CAN1_ABSOffroadSw, system-signal=CAN1_ABSOffroadSw}]}
      MAP_CGW_R_CAN1_ECAS_DM1: sender-receiver-to-signal-group-mapping{communication-direction=IN, data-element=SWC_CGW.root_FDC.R_CAN1_ECAS_DM1.CAN1_SG_ECAS_DM1, signal-group=CAN1_SG_ECAS_DM1, type-mapping=sender-rec-record-type-mapping=sender-rec-record-element-mapping{implementation-record-element=CAN1_ECASAWarmLampSta, system-signal=CAN1_ECASAWarmLampSta}}
      MAP_CGW_R_CAN1_HRW: sender-receiver-to-signal-group-mapping{communication-direction=IN, data-element=SWC_CGW.root_FDC.R_CAN1_HRW.CAN1_SG_HRW, signal-group=CAN1_SG_HRW, type-mapping=sender-rec-record-type-mapping=record-element-mappings=[{implementation-record-element=CAN1_WhlSpeed_FL, system-signal=CAN1_WhlSpeed_FL}, {implementation-record-element=CAN1_WhlSpeed_RR, system-signal=CAN1_WhlSpeed_RR}, {implementation-record-element=CAN1_WhlSpeed_RL, system-signal=CAN1_WhlSpeed_RL}, {implementation-record-element=CAN1_WhlSpeed_FR, system-signal=CAN1_WhlSpeed_FR}]}
      MAP_CGW_R_CAN1_TC1: sender-receiver-to-signal-group-mapping{communication-direction=IN, data-element=SWC_CGW.root_FDC.R_CAN1_TC1.CAN1_SG_TC1, signal-group=CAN1_SG_TC1, type-mapping=sender-rec-record-type-mapping=record-element-mappings=[{implementation-record-element=CAN1_DrivDirF, system-signal=CAN1_DrivDirF}, {implementation-record-element=CAN1_TransReqGear, system-signal=CAN1_TransReqGear}, {implementation-record-element=CAN1_LifeCnt, system-signal=CAN1_LifeCnt}, {implementation-record-element=CAN1_DrivDirR, system-signal=CAN1_DrivDirR}, {implementation-record-element=CAN1_DrivDirN, system-signal=CAN1_DrivDirN}]}
      MAP_CGW_R_CAN1_TPMS1: sender-receiver-to-signal-group-mapping{communication-direction=IN, data-element=SWC_CGW.root_FDC.R_CAN1_TPMS1.CAN1_SG_TPMS1, signal-group=CAN1_SG_TPMS1, type-mapping=sender-rec-record-type-mapping=record-element-mappings=[{implementation-record-element=CAN1_LBIBatWarn, system-signal=CAN1_LBIBatWarn}, {implementation-record-element=CAN1_TPMSWarnIndi, system-signal=CAN1_TPMSWarnIndi}, {implementation-record-element=CAN1_RFWheelTmpIndi, system-signal=CAN1_RFWheelTmpIndi}, {implementation-record-element=CAN1_RFSensorFail, system-signal=CAN1_RFSensorFail}, {implementation-record-element=CAN1_RFPressIndi, system-signal=CAN1_RFPressIndi}, {implementation-record-element=CAN1_RFBatWarn, system-signal=CAN1_RFBatWarn}, {implementation-record-element=CAN1_RBOWheelTmpIndi, system-signal=CAN1_RBOWheelTmpIndi}, {implementation-record-element=CAN1_RBOSensorFail, system-signal=CAN1_RBOSensorFail}, {implementation-record-element=CAN1_RBOPressIndi, system-signal=CAN1_RBOPressIndi}, {implementation-record-element=CAN1_RBOBatWarn, system-signal=CAN1_RBOBatWarn}, {implementation-record-element=CAN1_RBIWheelTmpIndi, system-signal=CAN1_RBIWheelTmpIndi}, {implementation-record-element=CAN1_RBISensorFail, system-signal=CAN1_RBISensorFail}, {implementation-record-element=CAN1_RBIPressIndi, system-signal=CAN1_RBIPressIndi}, {implementation-record-element=CAN1_RBIBatWarn, system-signal=CAN1_RBIBatWarn}, {implementation-record-element=CAN1_LFWheelTmpIndi, system-signal=CAN1_LFWheelTmpIndi}, {implementation-record-element=CAN1_LFSensorFail, system-signal=CAN1_LFSensorFail}, {implementation-record-element=CAN1_LFPressIndi, system-signal=CAN1_LFPressIndi}, {implementation-record-element=CAN1_LFBatWarn, system-signal=CAN1_LFBatWarn}, {implementation-record-element=CAN1_LBOWheelTmpIndi, system-signal=CAN1_LBOWheelTmpIndi}, {implementation-record-element=CAN1_LBOSensorFail, system-signal=CAN1_LBOSensorFail}, {implementation-record-element=CAN1_LBOPressIndi, system-signal=CAN1_LBOPressIndi}, {implementation-record-element=CAN1_LBOBatWarn, system-signal=CAN1_LBOBatWarn}, {implementation-record-element=CAN1_LBIWheelTmpIndi, system-signal=CAN1_LBIWheelTmpIndi}, {implementation-record-element=CAN1_LBISensorFail, system-signal=CAN1_LBISensorFail}, {implementation-record-element=CAN1_LBIPressIndi, system-signal=CAN1_LBIPressIndi}]}
      MAP_CGW_R_CAN1_TPMS2: sender-receiver-to-signal-group-mapping{communication-direction=IN, data-element=SWC_CGW.root_FDC.R_CAN1_TPMS2.CAN1_SG_TPMS2, signal-group=CAN1_SG_TPMS2, type-mapping=sender-rec-record-type-mapping=record-element-mappings=[{implementation-record-element=CAN1_LBIWheelPress, system-signal=CAN1_LBIWheelPress}, {implementation-record-element=CAN1_RFWheelPress, system-signal=CAN1_RFWheelPress}, {implementation-record-element=CAN1_RBOWheelPress, system-signal=CAN1_RBOWheelPress}, {implementation-record-element=CAN1_RBIWheelPress, system-signal=CAN1_RBIWheelPress}, {implementation-record-element=CAN1_LFWheelPress, system-signal=CAN1_LFWheelPress}, {implementation-record-element=CAN1_LBOWheelPress, system-signal=CAN1_LBOWheelPress}]}
      MAP_CGW_R_CAN1_TPMS3: sender-receiver-to-signal-group-mapping{communication-direction=IN, data-element=SWC_CGW.root_FDC.R_CAN1_TPMS3.CAN1_SG_TPMS3, signal-group=CAN1_SG_TPMS3, type-mapping=sender-rec-record-type-mapping=record-element-mappings=[{implementation-record-element=CAN1_LBIWheelTemp, system-signal=CAN1_LBIWheelTemp}, {implementation-record-element=CAN1_RFWheelTemp, system-signal=CAN1_RFWheelTemp}, {implementation-record-element=CAN1_RBOWheelTemp, system-signal=CAN1_RBOWheelTemp}, {implementation-record-element=CAN1_RBIWheelTemp, system-signal=CAN1_RBIWheelTemp}, {implementation-record-element=CAN1_LFWheelTemp, system-signal=CAN1_LFWheelTemp}, {implementation-record-element=CAN1_LBOWheelTemp, system-signal=CAN1_LBOWheelTemp}]}
      MAP_CGW_R_CAN1_VDC1: sender-receiver-to-signal-group-mapping{communication-direction=IN, data-element=SWC_CGW.root_FDC.R_CAN1_VDC1.CAN1_SG_VDC1, signal-group=CAN1_SG_VDC1, type-mapping=sender-rec-record-type-mapping=sender-rec-record-element-mapping{implementation-record-element=CAN1_VDCBrakeLightReq, system-signal=CAN1_VDCBrakeLightReq}}
      MAP_CGW_R_CAN3_B2TM_Info: sender-receiver-to-signal-group-mapping{communication-direction=IN, data-element=SWC_CGW.root_FDC.R_CAN3_B2TM_Info.CAN3_SG_B2TM_Info, signal-group=CAN3_SG_B2TM_Info, type-mapping=sender-rec-record-type-mapping=record-element-mappings=[{implementation-record-element=CAN3_B2TChgSta, system-signal=CAN3_B2TChgSta}, {implementation-record-element=CAN3_B2TSetTemp, system-signal=CAN3_B2TSetTemp}, {implementation-record-element=CAN3_B2TSetModeA, system-signal=CAN3_B2TSetModeA}, {implementation-record-element=CAN3_B2TPackVol, system-signal=CAN3_B2TPackVol}, {implementation-record-element=CAN3_B2TMLifeSig, system-signal=CAN3_B2TMLifeSig}, {implementation-record-element=CAN3_B2TMCRC, system-signal=CAN3_B2TMCRC}, {implementation-record-element=CAN3_B2THVRlySta, system-signal=CAN3_B2THVRlySta}, {implementation-record-element=CAN3_B2THVCmd, system-signal=CAN3_B2THVCmd}]}
      MAP_CGW_R_CAN3_B2V_BattInfo1: sender-receiver-to-signal-group-mapping{communication-direction=IN, data-element=SWC_CGW.root_FDC.R_CAN3_B2V_BattInfo1.CAN3_SG_B2V_BattInfo1, signal-group=CAN3_SG_B2V_BattInfo1, type-mapping=sender-rec-record-type-mapping=record-element-mappings=[{implementation-record-element=CAN3_B2VBI1BattType, system-signal=CAN3_B2VBI1BattType}, {implementation-record-element=CAN3_B2VBI1RatePower, system-signal=CAN3_B2VBI1RatePower}, {implementation-record-element=CAN3_B2VBI1RateHVolt, system-signal=CAN3_B2VBI1RateHVolt}, {implementation-record-element=CAN3_B2VBI1RateCap, system-signal=CAN3_B2VBI1RateCap}]}
      MAP_CGW_R_CAN3_B2V_ST1: sender-receiver-to-signal-group-mapping{communication-direction=IN, data-element=SWC_CGW.root_FDC.R_CAN3_B2V_ST1.CAN3_SG_B2V_ST1, signal-group=CAN3_SG_B2V_ST1, type-mapping=sender-rec-record-type-mapping=record-element-mappings=[{implementation-record-element=CAN3_B2VACChgConnSta, system-signal=CAN3_B2VACChgConnSta}, {implementation-record-element=CAN3_B2VST1RChrgCy, system-signal=CAN3_B2VST1RChrgCy}, {implementation-record-element=CAN3_B2VPrechgRelaySta, system-signal=CAN3_B2VPrechgRelaySta}, {implementation-record-element=CAN3_B2VPChrgNegRlySta, system-signal=CAN3_B2VPChrgNegRlySta}, {implementation-record-element=CAN3_B2VPChrgConnSta, system-signal=CAN3_B2VPChrgConnSta}, {implementation-record-element=CAN3_B2VPChgPosRlySta, system-signal=CAN3_B2VPChgPosRlySta}, {implementation-record-element=CAN3_B2VMainPosRlySta, system-signal=CAN3_B2VMainPosRlySta}, {implementation-record-element=CAN3_B2VMainNegRlySta, system-signal=CAN3_B2VMainNegRlySta}, {implementation-record-element=CAN3_B2VHeatingSta, system-signal=CAN3_B2VHeatingSta}, {implementation-record-element=CAN3_B2VHeatPosRlySta, system-signal=CAN3_B2VHeatPosRlySta}, {implementation-record-element=CAN3_B2VHeatNegRelaySta, system-signal=CAN3_B2VHeatNegRelaySta}, {implementation-record-element=CAN3_B2VDCChgP2RlySta, system-signal=CAN3_B2VDCChgP2RlySta}, {implementation-record-element=CAN3_B2VDCChgP1RlySta, system-signal=CAN3_B2VDCChgP1RlySta}, {implementation-record-element=CAN3_B2VDCChgN2RlySta, system-signal=CAN3_B2VDCChgN2RlySta}, {implementation-record-element=CAN3_B2VDCChgN1RlySta, system-signal=CAN3_B2VDCChgN1RlySta}, {implementation-record-element=CAN3_B2VDCChgConnSta, system-signal=CAN3_B2VDCChgConnSta}, {implementation-record-element=CAN3_B2VCoolingSta, system-signal=CAN3_B2VCoolingSta}, {implementation-record-element=CAN3_B2VChgSta, system-signal=CAN3_B2VChgSta}, {implementation-record-element=CAN3_B2VChgMode, system-signal=CAN3_B2VChgMode}, {implementation-record-element=CAN3_B2VBMUHVSta, system-signal=CAN3_B2VBMUHVSta}, {implementation-record-element=CAN3_B2VBMUBalSta, system-signal=CAN3_B2VBMUBalSta}, {implementation-record-element=CAN3_B2VAux3RlySta, system-signal=CAN3_B2VAux3RlySta}, {implementation-record-element=CAN3_B2VAux2RlySta, system-signal=CAN3_B2VAux2RlySta}, {implementation-record-element=CAN3_B2VAux1RlySta, system-signal=CAN3_B2VAux1RlySta}, {implementation-record-element=CAN3_B2VACChgPosRlySta, system-signal=CAN3_B2VACChgPosRlySta}, {implementation-record-element=CAN3_B2VACChgNegRlySta, system-signal=CAN3_B2VACChgNegRlySta}]}
      MAP_CGW_R_CAN3_B2V_ST2: sender-receiver-to-signal-group-mapping{communication-direction=IN, data-element=SWC_CGW.root_FDC.R_CAN3_B2V_ST2.CAN3_SG_B2V_ST2, signal-group=CAN3_SG_B2V_ST2, type-mapping=sender-rec-record-type-mapping=record-element-mappings=[{implementation-record-element=CAN3_B2VFaultCode, system-signal=CAN3_B2VFaultCode}, {implementation-record-element=CAN3_B2VST2LifeSig, system-signal=CAN3_B2VST2LifeSig}, {implementation-record-element=CAN3_B2VSOH, system-signal=CAN3_B2VSOH}, {implementation-record-element=CAN3_B2VSOC, system-signal=CAN3_B2VSOC}, {implementation-record-element=CAN3_B2VRqHVPwrOff, system-signal=CAN3_B2VRqHVPwrOff}, {implementation-record-element=CAN3_B2VPackInsideVol, system-signal=CAN3_B2VPackInsideVol}, {implementation-record-element=CAN3_B2VPackCurr, system-signal=CAN3_B2VPackCurr}, {implementation-record-element=CAN3_B2VFaultLv, system-signal=CAN3_B2VFaultLv}]}
      MAP_CGW_R_CAN3_TM_MCUSta2: sender-receiver-to-signal-group-mapping{communication-direction=IN, data-element=SWC_CGW.root_FDC.R_CAN3_TM_MCUSta2.CAN3_SG_TM_MCUSta2, signal-group=CAN3_SG_TM_MCUSta2, type-mapping=sender-rec-record-type-mapping=record-element-mappings=[{implementation-record-element=CAN3_MCUFailGrade, system-signal=CAN3_MCUFailGrade}, {implementation-record-element=CAN3_MotorTemp, system-signal=CAN3_MotorTemp}, {implementation-record-element=CAN3_MCUTrqLimLo, system-signal=CAN3_MCUTrqLimLo}, {implementation-record-element=CAN3_MCUTrqLimHi, system-signal=CAN3_MCUTrqLimHi}, {implementation-record-element=CAN3_MCUTemp, system-signal=CAN3_MCUTemp}, {implementation-record-element=CAN3_MCUMsgSta2LCnt, system-signal=CAN3_MCUMsgSta2LCnt}]}
      MAP_CGW_R_CAN4_ZFR_C100_0: sender-receiver-to-signal-group-mapping{communication-direction=IN, data-element=SWC_CGW.root_FDC.R_CAN4_ZFR_C100_0.CAN4_SG_ZFR_C100_0, signal-group=CAN4_SG_ZFR_C100_0, type-mapping=sender-rec-record-type-mapping=sender-rec-record-element-mapping{implementation-record-element=CAN4_ParkBrakeSW, system-signal=CAN4_ParkBrakeSW}}
      MAP_CGW_R_CAN4_ZFR_C5000_0: sender-receiver-to-signal-group-mapping{communication-direction=IN, data-element=SWC_CGW.root_FDC.R_CAN4_ZFR_C5000_0.CAN4_SG_ZFR_C5000_0, signal-group=CAN4_SG_ZFR_C5000_0, type-mapping=sender-rec-record-type-mapping=record-element-mappings=[{implementation-record-element=CAN4_ZFR_CHASSIS_LiningWearFL_Sta, system-signal=CAN4_ZFR_CHASSIS_LiningWearFL_Sta}, {implementation-record-element=CAN4_ZFR_CHASSIS_LiningWearFR_Sta, system-signal=CAN4_ZFR_CHASSIS_LiningWearFR_Sta}]}
      MAP_CGW_R_CAN4_ZFR_CE100_0: sender-receiver-to-signal-group-mapping{communication-direction=IN, data-element=SWC_CGW.root_FDC.R_CAN4_ZFR_CE100_0.CAN4_SG_ZFR_CE100_0, signal-group=CAN4_SG_ZFR_CE100_0, type-mapping=sender-rec-record-type-mapping=record-element-mappings=[{implementation-record-element=CAN4_AirPressureFC2, system-signal=CAN4_AirPressureFC2}, {implementation-record-element=CAN4_ZFR_BCM_WiperL_Sta, system-signal=CAN4_ZFR_BCM_WiperL_Sta}, {implementation-record-element=CAN4_ZFR_BCM_WiperLSW_Sta, system-signal=CAN4_ZFR_BCM_WiperLSW_Sta}, {implementation-record-element=CAN4_ZFR_BCM_WiperH_Sta, system-signal=CAN4_ZFR_BCM_WiperH_Sta}, {implementation-record-element=CAN4_ZFR_BCM_WiperHSW_Sta, system-signal=CAN4_ZFR_BCM_WiperHSW_Sta}, {implementation-record-element=CAN4_ZFR_BCM_WiperAS_Sta, system-signal=CAN4_ZFR_BCM_WiperAS_Sta}, {implementation-record-element=CAN4_ZFR_BCM_Washer_Sta, system-signal=CAN4_ZFR_BCM_Washer_Sta}, {implementation-record-element=CAN4_ZFR_BCM_WasherSW_Sta, system-signal=CAN4_ZFR_BCM_WasherSW_Sta}, {implementation-record-element=CAN4_ZFR_BCM_TurnBuzzer_Sta, system-signal=CAN4_ZFR_BCM_TurnBuzzer_Sta}, {implementation-record-element=CAN4_ZFR_BCM_Seatbelt_Sta, system-signal=CAN4_ZFR_BCM_Seatbelt_Sta}, {implementation-record-element=CAN4_ZFR_BCM_RFogLp_SW_Sta, system-signal=CAN4_ZFR_BCM_RFogLp_SW_Sta}, {implementation-record-element=CAN4_ZFR_BCM_RFTurnLp_Sta, system-signal=CAN4_ZFR_BCM_RFTurnLp_Sta}, {implementation-record-element=CAN4_ZFR_BCM_RFTurnLpC_Sta, system-signal=CAN4_ZFR_BCM_RFTurnLpC_Sta}, {implementation-record-element=CAN4_ZFR_BCM_RDRL_Sta, system-signal=CAN4_ZFR_BCM_RDRL_Sta}, {implementation-record-element=CAN4_ZFR_BCM_RBSDY_Sta, system-signal=CAN4_ZFR_BCM_RBSDY_Sta}, {implementation-record-element=CAN4_ZFR_BCM_RBSDR_Sta, system-signal=CAN4_ZFR_BCM_RBSDR_Sta}, {implementation-record-element=CAN4_ZFR_BCM_PosLpSW_Sta, system-signal=CAN4_ZFR_BCM_PosLpSW_Sta}, {implementation-record-element=CAN4_ZFR_BCM_PLamp_Sta, system-signal=CAN4_ZFR_BCM_PLamp_Sta}, {implementation-record-element=CAN4_ZFR_BCM_LightSensorV_Sta, system-signal=CAN4_ZFR_BCM_LightSensorV_Sta}, {implementation-record-element=CAN4_ZFR_BCM_LFTurnLp_Sta, system-signal=CAN4_ZFR_BCM_LFTurnLp_Sta}, {implementation-record-element=CAN4_ZFR_BCM_LFTurnLpC_Sta, system-signal=CAN4_ZFR_BCM_LFTurnLpC_Sta}, {implementation-record-element=CAN4_ZFR_BCM_LDRL_Sta, system-signal=CAN4_ZFR_BCM_LDRL_Sta}, {implementation-record-element=CAN4_ZFR_BCM_LBeam_Sta, system-signal=CAN4_ZFR_BCM_LBeam_Sta}, {implementation-record-element=CAN4_ZFR_BCM_LBSDY_Sta, system-signal=CAN4_ZFR_BCM_LBSDY_Sta}, {implementation-record-element=CAN4_ZFR_BCM_LBSDR_Sta, system-signal=CAN4_ZFR_BCM_LBSDR_Sta}, {implementation-record-element=CAN4_ZFR_BCM_HornSW_Sta, system-signal=CAN4_ZFR_BCM_HornSW_Sta}, {implementation-record-element=CAN4_ZFR_BCM_HeadLpSW_Sta, system-signal=CAN4_ZFR_BCM_HeadLpSW_Sta}, {implementation-record-element=CAN4_ZFR_BCM_HBeam_Sta, system-signal=CAN4_ZFR_BCM_HBeam_Sta}, {implementation-record-element=CAN4_ZFR_BCM_HBeamSW_Sta, system-signal=CAN4_ZFR_BCM_HBeamSW_Sta}, {implementation-record-element=CAN4_ZFR_BCM_DVRSignalReverse_Sta, system-signal=CAN4_ZFR_BCM_DVRSignalReverse_Sta}, {implementation-record-element=CAN4_ZFR_BCM_DVRSignalR_Sta, system-signal=CAN4_ZFR_BCM_DVRSignalR_Sta}, {implementation-record-element=CAN4_ZFR_BCM_DVRSignalL_Sta, system-signal=CAN4_ZFR_BCM_DVRSignalL_Sta}, {implementation-record-element=CAN4_ZFR_BCM_DVRMidDoor_Sta, system-signal=CAN4_ZFR_BCM_DVRMidDoor_Sta}, {implementation-record-element=CAN4_ZFR_BCM_Brake_Sta, system-signal=CAN4_ZFR_BCM_Brake_Sta}, {implementation-record-element=CAN4_ZFR_BCM_BacklightDuty_Sta, system-signal=CAN4_ZFR_BCM_BacklightDuty_Sta}, {implementation-record-element=CAN4_ZFR_BCM_BSD_Dimmer_Sta, system-signal=CAN4_ZFR_BCM_BSD_Dimmer_Sta}, {implementation-record-element=CAN4_ZFR_BCM_AutoLightSW_Sta, system-signal=CAN4_ZFR_BCM_AutoLightSW_Sta}]}
      MAP_CGW_R_CAN4_ZRR_C5000_0: sender-receiver-to-signal-group-mapping{communication-direction=IN, data-element=SWC_CGW.root_FDC.R_CAN4_ZRR_C5000_0.CAN4_SG_ZRR_C5000_0, signal-group=CAN4_SG_ZRR_C5000_0, type-mapping=sender-rec-record-type-mapping=record-element-mappings=[{implementation-record-element=CAN4_ZRR_CHASSIS_LiningWearRL_Sta, system-signal=CAN4_ZRR_CHASSIS_LiningWearRL_Sta}, {implementation-record-element=CAN4_ZRR_CHASSIS_LiningWearRR_Sta, system-signal=CAN4_ZRR_CHASSIS_LiningWearRR_Sta}]}
      MAP_CGW_R_CAN4_ZRR_CE100_1: sender-receiver-to-signal-group-mapping{communication-direction=IN, data-element=SWC_CGW.root_FDC.R_CAN4_ZRR_CE100_1.CAN4_SG_ZRR_CE100_1, signal-group=CAN4_SG_ZRR_CE100_1, type-mapping=sender-rec-record-type-mapping=record-element-mappings=[{implementation-record-element=CAN4_AirPressurePC3, system-signal=CAN4_AirPressurePC3}, {implementation-record-element=CAN4_ZRR_BCM_TurnBuzzer_Sta, system-signal=CAN4_ZRR_BCM_TurnBuzzer_Sta}, {implementation-record-element=CAN4_ZRR_BCM_StopLight_Sta, system-signal=CAN4_ZRR_BCM_StopLight_Sta}, {implementation-record-element=CAN4_ZRR_BCM_STOPSW_Sta, system-signal=CAN4_ZRR_BCM_STOPSW_Sta}, {implementation-record-element=CAN4_ZRR_BCM_STOPSW2_Sta, system-signal=CAN4_ZRR_BCM_STOPSW2_Sta}, {implementation-record-element=CAN4_ZRR_BCM_SRTLp_Sta, system-signal=CAN4_ZRR_BCM_SRTLp_Sta}, {implementation-record-element=CAN4_ZRR_BCM_SMKR_Sta, system-signal=CAN4_ZRR_BCM_SMKR_Sta}, {implementation-record-element=CAN4_ZRR_BCM_SMKL_Sta, system-signal=CAN4_ZRR_BCM_SMKL_Sta}, {implementation-record-element=CAN4_ZRR_BCM_SLTLp_Sta, system-signal=CAN4_ZRR_BCM_SLTLp_Sta}, {implementation-record-element=CAN4_ZRR_BCM_RoomLpAmb_Sta, system-signal=CAN4_ZRR_BCM_RoomLpAmb_Sta}, {implementation-record-element=CAN4_ZRR_BCM_ReverseLp_Sta, system-signal=CAN4_ZRR_BCM_ReverseLp_Sta}, {implementation-record-element=CAN4_ZRR_BCM_ReverseBuz_Sta, system-signal=CAN4_ZRR_BCM_ReverseBuz_Sta}, {implementation-record-element=CAN4_ZRR_BCM_RRTurnLp_Sta, system-signal=CAN4_ZRR_BCM_RRTurnLp_Sta}, {implementation-record-element=CAN4_ZRR_BCM_RRTurnLpC_Sta, system-signal=CAN4_ZRR_BCM_RRTurnLpC_Sta}, {implementation-record-element=CAN4_ZRR_BCM_RFLamp_Sta, system-signal=CAN4_ZRR_BCM_RFLamp_Sta}, {implementation-record-element=CAN4_ZRR_BCM_PLamp_Sta, system-signal=CAN4_ZRR_BCM_PLamp_Sta}, {implementation-record-element=CAN4_ZRR_BCM_MDoorAP_Sta, system-signal=CAN4_ZRR_BCM_MDoorAP_Sta}, {implementation-record-element=CAN4_ZRR_BCM_MDOpenSV_Sta, system-signal=CAN4_ZRR_BCM_MDOpenSV_Sta}, {implementation-record-element=CAN4_ZRR_BCM_MDCloseSV_Sta, system-signal=CAN4_ZRR_BCM_MDCloseSV_Sta}, {implementation-record-element=CAN4_ZRR_BCM_LRTurnLp_Sta, system-signal=CAN4_ZRR_BCM_LRTurnLp_Sta}, {implementation-record-element=CAN4_ZRR_BCM_LRTurnLpC_Sta, system-signal=CAN4_ZRR_BCM_LRTurnLpC_Sta}, {implementation-record-element=CAN4_ZRR_BCM_FDoorAP_Sta, system-signal=CAN4_ZRR_BCM_FDoorAP_Sta}, {implementation-record-element=CAN4_ZRR_BCM_FDOpenSV_Sta, system-signal=CAN4_ZRR_BCM_FDOpenSV_Sta}, {implementation-record-element=CAN4_ZRR_BCM_FDCloseSV_Sta, system-signal=CAN4_ZRR_BCM_FDCloseSV_Sta}, {implementation-record-element=CAN4_ZRR_BCM_EmSV_Sta, system-signal=CAN4_ZRR_BCM_EmSV_Sta}, {implementation-record-element=CAN4_ZRR_BCM_EmLight_Sta, system-signal=CAN4_ZRR_BCM_EmLight_Sta}, {implementation-record-element=CAN4_ZRR_BCM_CallingSW_Sta, system-signal=CAN4_ZRR_BCM_CallingSW_Sta}, {implementation-record-element=CAN4_ZRR_BCM_BrakeLp_Sta, system-signal=CAN4_ZRR_BCM_BrakeLp_Sta}, {implementation-record-element=CAN4_FDC_CHASSIS_VCUEACPress_Sta, system-signal=CAN4_FDC_CHASSIS_VCUEACPress_Sta}, {implementation-record-element=CAN4_AirPressureRC1, system-signal=CAN4_AirPressureRC1}]}
      MAP_CGW_R_CAN4_zGW_CANRr1_C50_0: sender-receiver-to-signal-group-mapping{communication-direction=IN, data-element=SWC_CGW.root_FDC.R_CAN4_zGW_CANRr1_C50_0.CAN4_SG_zGW_CANRr1_C50_0, signal-group=CAN4_SG_zGW_CANRr1_C50_0, type-mapping=sender-rec-record-type-mapping=record-element-mappings=[{implementation-record-element=CAN4_DCDC_En_Sta, system-signal=CAN4_DCDC_En_Sta}, {implementation-record-element=CAN4_PDU_SelfChk_Sta, system-signal=CAN4_PDU_SelfChk_Sta}, {implementation-record-element=CAN4_PDU_MCUPreRly_Sta, system-signal=CAN4_PDU_MCUPreRly_Sta}, {implementation-record-element=CAN4_PDU_MCUPosRly_Sta, system-signal=CAN4_PDU_MCUPosRly_Sta}, {implementation-record-element=CAN4_PDU_MCUHVLoop_Sta, system-signal=CAN4_PDU_MCUHVLoop_Sta}, {implementation-record-element=CAN4_PDU_LifeSig_Sta, system-signal=CAN4_PDU_LifeSig_Sta}, {implementation-record-element=CAN4_PDU_HVIL_Sta, system-signal=CAN4_PDU_HVIL_Sta}, {implementation-record-element=CAN4_PDU_DeFogTMSRly_Sta, system-signal=CAN4_PDU_DeFogTMSRly_Sta}, {implementation-record-element=CAN4_PDU_DCDCEACEHPSRly_Sta, system-signal=CAN4_PDU_DCDCEACEHPSRly_Sta}, {implementation-record-element=CAN4_PDU_DCDCEACEHPSPreRly_Sta, system-signal=CAN4_PDU_DCDCEACEHPSPreRly_Sta}, {implementation-record-element=CAN4_PDU_DCDCEACEHPSHVLoop_Sta, system-signal=CAN4_PDU_DCDCEACEHPSHVLoop_Sta}, {implementation-record-element=CAN4_PDU_ACRly_Sta, system-signal=CAN4_PDU_ACRly_Sta}, {implementation-record-element=CAN4_EHPS_MotorSpd_Sta, system-signal=CAN4_EHPS_MotorSpd_Sta}, {implementation-record-element=CAN4_EHPS_LifeSig_Sta, system-signal=CAN4_EHPS_LifeSig_Sta}, {implementation-record-element=CAN4_EHPS_InvTemp_Sta, system-signal=CAN4_EHPS_InvTemp_Sta}, {implementation-record-element=CAN4_EHPS_ErrLv_Sta, system-signal=CAN4_EHPS_ErrLv_Sta}, {implementation-record-element=CAN4_EHPS_En_Sta, system-signal=CAN4_EHPS_En_Sta}, {implementation-record-element=CAN4_EAC_LifeSig_Sta, system-signal=CAN4_EAC_LifeSig_Sta}, {implementation-record-element=CAN4_EAC_InvTemp_Sta, system-signal=CAN4_EAC_InvTemp_Sta}, {implementation-record-element=CAN4_EAC_ErrLv_Sta, system-signal=CAN4_EAC_ErrLv_Sta}, {implementation-record-element=CAN4_EAC_En_Sta, system-signal=CAN4_EAC_En_Sta}, {implementation-record-element=CAN4_DCDC_Temp_Sta, system-signal=CAN4_DCDC_Temp_Sta}, {implementation-record-element=CAN4_DCDC_OutVol_Sta, system-signal=CAN4_DCDC_OutVol_Sta}, {implementation-record-element=CAN4_DCDC_LifeSig_Sta, system-signal=CAN4_DCDC_LifeSig_Sta}, {implementation-record-element=CAN4_DCDC_ErrLv_Sta, system-signal=CAN4_DCDC_ErrLv_Sta}]}
    root-software-compositions:
      root sw composition prototype root_FDC: flat-map=root_FDC_FlatMap, software-composition=Comp_FDC_main
  flat map root_FDC_FlatMap
    flat instance descriptor FlatIns_FDC: upstream-reference=root_FDC.SWC_FDC, ecu-extract-reference=root_FDC.SWC_FDC
