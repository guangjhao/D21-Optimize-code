AUTOSAR XML (schema 4-0-3)
package /Can
  module config Can: implementation-config-variant=VARIANT-PRE-COMPILE
    CanConfigSet
      8 x CanController, all with AutomaticBusOffRecovery=0, CanBusoffProcessing=INTERRUPT, CanControllerActivation=1, CanControllerBaseAddress=0, CanControllerIcomSupported=0, CanListenOnlyMode=0, CanLoopBackMode=0, CanProtocolException=0, CanRxProcessing=INTERRUPT, CanTimeStampEnable=DISABLE, CanTxFifoMode=1, CanTxProcessing=INTERRUPT, CanWakeupFunctionalityAPI=0, CanWakeupProcessing=POLLING, CanWakeupSupport=0, ManualBusOffRecovery=0, CanCpuClockRef=McuClockReferencePoint_LLCECAN_CLK:
        CAN1: CanControllerId=0, CanHwChannel=BCAN_1, SelfReceptionEnable=1, CanControllerDefaultBaudrate=CAN1/CanControllerBaudrateConfig
          CanControllerBaudrateConfig:
            CanBusLength = 40
            CanControllerBaudRate = 250.0
            CanControllerBaudRateConfigID = 0
            CanControllerCheckCanStandard = 1
            CanControllerPrescaller = 4
            CanControllerPropSeg = 47
            CanControllerSeg1 = 16
            CanControllerSeg2 = 16
            CanControllerSyncJumpWidth = 15
            CanPropDelayTranceiver = 150.0
        CAN2: CanControllerId=1, CanHwChannel=BCAN_2, SelfReceptionEnable=1, CanControllerDefaultBaudrate=CAN2/CanControllerBaudrateConfig
          CanControllerBaudrateConfig:
            CanBusLength = 40
            CanControllerBaudRate = 500.0
            CanControllerBaudRateConfigID = 0
            CanControllerCheckCanStandard = 1
            CanControllerPrescaller = 2
            CanControllerPropSeg = 47
            CanControllerSeg1 = 16
            CanControllerSeg2 = 16
            CanControllerSyncJumpWidth = 15
            CanPropDelayTranceiver = 150.0
            CanControllerFdBaudrateConfig:
              CanBusLengthFd = 40
              CanControllerFDPrescaller = 2
              CanControllerFdBaudRate = 2000.0
              CanControllerPropSeg = 9
              CanControllerSeg1 = 6
              CanControllerSeg2 = 4
              CanControllerSyncJumpWidth = 3
              CanControllerTxBitRateSwitch = 1
        CAN3: CanHwChannel=BCAN_3, SelfReceptionEnable=1, CanControllerDefaultBaudrate=CAN3/CanControllerBaudrateConfig
          CanControllerBaudrateConfig:
            CanBusLength = 40
            CanControllerBaudRate = 250.0
            CanControllerBaudRateConfigID = 0
            CanControllerCheckCanStandard = 1
            CanControllerPrescaller = 4
            CanControllerPropSeg = 47
            CanControllerSeg1 = 16
            CanControllerSeg2 = 16
            CanControllerSyncJumpWidth = 15
            CanPropDelayTranceiver = 150.0
        CAN4: CanHwChannel=BCAN_4, SelfReceptionEnable=1, CanControllerDefaultBaudrate=CAN4/CanControllerBaudrateConfig
          CanControllerBaudrateConfig:
            CanBusLength = 40
            CanControllerBaudRate = 500.0
            CanControllerBaudRateConfigID = 0
            CanControllerCheckCanStandard = 1
            CanControllerPrescaller = 2
            CanControllerPropSeg = 47
            CanControllerSeg1 = 16
            CanControllerSeg2 = 16
            CanControllerSyncJumpWidth = 15
            CanPropDelayTranceiver = 150.0
            CanControllerFdBaudrateConfig:
              CanBusLengthFd = 40
              CanControllerFDPrescaller = 2
              CanControllerFdBaudRate = 2000.0
              CanControllerPropSeg = 9
              CanControllerSeg1 = 6
              CanControllerSeg2 = 4
              CanControllerSyncJumpWidth = 3
              CanControllerTxBitRateSwitch = 1
        CAN5: CanHwChannel=BCAN_6, SelfReceptionEnable=1, CanControllerDefaultBaudrate=CAN5/CanControllerBaudrateConfig
          CanControllerBaudrateConfig:
            CanBusLength = 40
            CanControllerBaudRate = 500.0
            CanControllerBaudRateConfigID = 0
            CanControllerCheckCanStandard = 1
            CanControllerPrescaller = 2
            CanControllerPropSeg = 47
            CanControllerSeg1 = 16
            CanControllerSeg2 = 16
            CanControllerSyncJumpWidth = 15
            CanPropDelayTranceiver = 150.0
            CanControllerFdBaudrateConfig:
              CanBusLengthFd = 40
              CanControllerFDPrescaller = 2
              CanControllerFdBaudRate = 2000.0
              CanControllerPropSeg = 9
              CanControllerSeg1 = 6
              CanControllerSeg2 = 4
              CanControllerSyncJumpWidth = 3
              CanControllerTxBitRateSwitch = 1
        CAN6: CanHwChannel=BCAN_7, SelfReceptionEnable=1, CanControllerDefaultBaudrate=CAN6/CanControllerBaudrateConfig
          CanControllerBaudrateConfig:
            CanBusLength = 40
            CanControllerBaudRate = 500.0
            CanControllerBaudRateConfigID = 0
            CanControllerCheckCanStandard = 1
            CanControllerPrescaller = 2
            CanControllerPropSeg = 47
            CanControllerSeg1 = 16
            CanControllerSeg2 = 16
            CanControllerSyncJumpWidth = 15
            CanPropDelayTranceiver = 150.0
            CanControllerFdBaudrateConfig:
              CanBusLengthFd = 40
              CanControllerFDPrescaller = 2
              CanControllerFdBaudRate = 2000.0
              CanControllerPropSeg = 9
              CanControllerSeg1 = 6
              CanControllerSeg2 = 4
              CanControllerSyncJumpWidth = 3
              CanControllerTxBitRateSwitch = 1
        CAN7: CanHwChannel=BCAN_5, SelfReceptionEnable=1, CanControllerDefaultBaudrate=CAN7/CanControllerBaudrateConfig
          CanControllerBaudrateConfig:
            CanBusLength = 40
            CanControllerBaudRate = 250.0
            CanControllerBaudRateConfigID = 0
            CanControllerCheckCanStandard = 1
            CanControllerPrescaller = 4
            CanControllerPropSeg = 47
            CanControllerSeg1 = 16
            CanControllerSeg2 = 16
            CanControllerSyncJumpWidth = 15
            CanPropDelayTranceiver = 150.0
        CAN_XCP: CanHwChannel=BCAN_15, SelfReceptionEnable=0, CanControllerDefaultBaudrate=CanControllerBaudrateConfig_0
          CanControllerBaudrateConfig_0 (CanControllerBaudrateConfig):
            CanBusLength = 40
            CanControllerBaudRate = 500.0
            CanControllerBaudRateConfigID = 0
            CanControllerCheckCanStandard = 1
            CanControllerPrescaller = 2
            CanControllerPropSeg = 47
            CanControllerSeg1 = 16
            CanControllerSeg2 = 16
            CanControllerSyncJumpWidth = 15
            CanPropDelayTranceiver = 150.0
            CanControllerFdBaudrateConfig:
              CanBusLengthFd = 40
              CanControllerFDPrescaller = 2
              CanControllerFdBaudRate = 2000.0
              CanControllerPropSeg = 9
              CanControllerSeg1 = 6
              CanControllerSeg2 = 4
              CanControllerSyncJumpWidth = 3
              CanControllerTxBitRateSwitch = 1
      CanErrorReporting:
        CAN_PROTOCOL_ERR = IGNORE
        CAN_PROTOCOL_WRN = INTERRUPT
        CONFIGURATION_ERR = IGNORE
        CanMainFunctionErrorEn = 0
        DATALOST_ERR = INTERRUPT
        INTERNAL_ERR = INTERRUPT
      87 x CanHardwareObject, all with CanHardwareObjectUsesPolling=0:
        HOH_1_CAN1: CanHandleType=BASIC, CanHwObjectCount=12, CanIdType=STANDARD, CanObjectType=RECEIVE, CanObjectId=0, CanControllerRef=CAN1
          CanHwFilter: CanHwFilterCode=0, CanHwFilterMask=0
          RangeFilter: RangeEnd=1408, RangeStart=1281
        HOH_2_CAN1: CanHandleType=BASIC, CanHwObjectCount=12, CanIdType=EXTENDED, CanObjectType=RECEIVE, CanObjectId=1, CanControllerRef=CAN1
          CanAdvancedFeature: CanAdvancedFeatureRef=AF_Host
          CanHwFilter: CanHwFilterCode=150892043, CanHwFilterMask=4294967295
        HOH_3_CAN1: CanHandleType=BASIC, CanHwObjectCount=12, CanIdType=EXTENDED, CanObjectType=RECEIVE, CanObjectId=2, CanControllerRef=CAN1
          CanAdvancedFeature: CanAdvancedFeatureRef=AF_Host
          CanHwFilter: CanHwFilterCode=201392901, CanHwFilterMask=4294967295
        HOH_4_CAN1: CanHandleType=BASIC, CanHwObjectCount=12, CanIdType=EXTENDED, CanObjectType=RECEIVE, CanObjectId=3, CanControllerRef=CAN1
          CanAdvancedFeature: CanAdvancedFeatureRef=AF_Host
          CanHwFilter: CanHwFilterCode=217050891, CanHwFilterMask=4294967295
        HOH_5_CAN1: CanHandleType=BASIC, CanHwObjectCount=12, CanIdType=EXTENDED, CanObjectType=RECEIVE, CanObjectId=4, CanControllerRef=CAN1
          CanAdvancedFeature: CanAdvancedFeatureRef=AF_Host
          CanHwFilter: CanHwFilterCode=217995823, CanHwFilterMask=4294967295
        HOH_6_CAN1: CanHandleType=BASIC, CanHwObjectCount=12, CanIdType=EXTENDED, CanObjectType=RECEIVE, CanObjectId=5, CanControllerRef=CAN1
          CanAdvancedFeature: CanAdvancedFeatureRef=AF_ToCan7_Host
          CanHwFilter: CanHwFilterCode=404541651, CanHwFilterMask=4294967295
        HOH_7_CAN1: CanHandleType=BASIC, CanHwObjectCount=12, CanIdType=EXTENDED, CanObjectType=RECEIVE, CanObjectId=6, CanControllerRef=CAN1
          CanAdvancedFeature: CanAdvancedFeatureRef=AF_ToCan7_Host
          CanHwFilter: CanHwFilterCode=404541907, CanHwFilterMask=4294967295
        HOH_8_CAN1: CanHandleType=BASIC, CanHwObjectCount=12, CanIdType=EXTENDED, CanObjectType=RECEIVE, CanObjectId=7, CanControllerRef=CAN1
          CanAdvancedFeature: CanAdvancedFeatureRef=AF_Host
          CanHwFilter: CanHwFilterCode=404542163, CanHwFilterMask=4294967295
        HOH_9_CAN1: CanHandleType=BASIC, CanHwObjectCount=12, CanIdType=EXTENDED, CanObjectType=RECEIVE, CanObjectId=8, CanControllerRef=CAN1
          CanAdvancedFeature: CanAdvancedFeatureRef=AF_Host
          CanHwFilter: CanHwFilterCode=417003782, CanHwFilterMask=4294967295
        HOH_10_CAN1: CanHandleType=BASIC, CanHwObjectCount=12, CanIdType=EXTENDED, CanObjectType=RECEIVE, CanObjectId=9, CanControllerRef=CAN1
          CanAdvancedFeature: CanAdvancedFeatureRef=AF_Host
          CanHwFilter: CanHwFilterCode=417003787, CanHwFilterMask=4294967295
        HOH_11_CAN1: CanHandleType=BASIC, CanHwObjectCount=12, CanIdType=EXTENDED, CanObjectType=RECEIVE, CanObjectId=10, CanControllerRef=CAN1
          CanAdvancedFeature: CanAdvancedFeatureRef=AF_Host
          CanHwFilter: CanHwFilterCode=417003827, CanHwFilterMask=4294967295
        HOH_12_CAN1: CanHandleType=BASIC, CanHwObjectCount=12, CanIdType=EXTENDED, CanObjectType=RECEIVE, CanObjectId=11, CanControllerRef=CAN1
          CanAdvancedFeature: CanAdvancedFeatureRef=AF_Host
          CanHwFilter: CanHwFilterCode=417003907, CanHwFilterMask=4294967295
        HOH_13_CAN1: CanHandleType=BASIC, CanHwObjectCount=12, CanIdType=EXTENDED, CanObjectType=RECEIVE, CanObjectId=12, CanControllerRef=CAN1
          CanAdvancedFeature: CanAdvancedFeatureRef=AF_Host
          CanHwFilter: CanHwFilterCode=417003908, CanHwFilterMask=4294967295
        HOH_14_CAN1: CanHandleType=BASIC, CanHwObjectCount=12, CanIdType=EXTENDED, CanObjectType=RECEIVE, CanObjectId=13, CanControllerRef=CAN1
          CanAdvancedFeature: CanAdvancedFeatureRef=AF_Host
          CanHwFilter: CanHwFilterCode=417003909, CanHwFilterMask=4294967295
        HOH_15_CAN1: CanHandleType=BASIC, CanHwObjectCount=12, CanIdType=EXTENDED, CanObjectType=RECEIVE, CanObjectId=14, CanControllerRef=CAN1
          CanAdvancedFeature: CanAdvancedFeatureRef=AF_Host
          CanHwFilter: CanHwFilterCode=417003910, CanHwFilterMask=4294967295
        HOH_16_CAN1: CanHandleType=BASIC, CanHwObjectCount=12, CanIdType=EXTENDED, CanObjectType=RECEIVE, CanObjectId=15, CanControllerRef=CAN1
          CanAdvancedFeature: CanAdvancedFeatureRef=AF_Host
          CanHwFilter: CanHwFilterCode=417003921, CanHwFilterMask=4294967295
        HOH_17_CAN1: CanHandleType=BASIC, CanHwObjectCount=12, CanIdType=EXTENDED, CanObjectType=RECEIVE, CanObjectId=16, CanControllerRef=CAN1
          CanAdvancedFeature: CanAdvancedFeatureRef=AF_ToCan7_Host
          CanHwFilter: CanHwFilterCode=418382091, CanHwFilterMask=4294967295
        HOH_18_CAN1: CanHandleType=BASIC, CanHwObjectCount=12, CanIdType=EXTENDED, CanObjectType=RECEIVE, CanObjectId=17, CanControllerRef=CAN1
          CanAdvancedFeature: CanAdvancedFeatureRef=AF_Host
          CanHwFilter: CanHwFilterCode=418517043, CanHwFilterMask=4294967295
        HOH_19_CAN1: CanHandleType=BASIC, CanHwObjectCount=12, CanIdType=EXTENDED, CanObjectType=RECEIVE, CanObjectId=18, CanControllerRef=CAN1
          CanAdvancedFeature: CanAdvancedFeatureRef=AF_Host
          CanHwFilter: CanHwFilterCode=418517299, CanHwFilterMask=4294967295
        HOH_20_CAN1: CanHandleType=BASIC, CanHwObjectCount=12, CanIdType=EXTENDED, CanObjectType=RECEIVE, CanObjectId=19, CanControllerRef=CAN1
          CanAdvancedFeature: CanAdvancedFeatureRef=AF_Host
          CanHwFilter: CanHwFilterCode=418517555, CanHwFilterMask=4294967295
        HOH_21_CAN1: CanHandleType=BASIC, CanHwObjectCount=12, CanIdType=EXTENDED, CanObjectType=RECEIVE, CanObjectId=20, CanControllerRef=CAN1
          CanAdvancedFeature: CanAdvancedFeatureRef=AF_Host
          CanHwFilter: CanHwFilterCode=419283979, CanHwFilterMask=4294967295
        HOH_22_CAN1: CanHandleType=BASIC, CanHwObjectCount=12, CanIdType=EXTENDED, CanObjectType=RECEIVE, CanObjectId=21, CanControllerRef=CAN1
          CanAdvancedFeature: CanAdvancedFeatureRef=AF_Host
          CanHwFilter: CanHwFilterCode=419319563, CanHwFilterMask=4294967295
        HOH_23_CAN1: CanHandleType=BASIC, CanHwObjectCount=12, CanIdType=EXTENDED, CanObjectType=RECEIVE, CanObjectId=22, CanControllerRef=CAN1
          CanAdvancedFeature: CanAdvancedFeatureRef=AF_ToCan2_3_4_5_6_7_Host
          CanHwFilter: CanHwFilterCode=419348235, CanHwFilterMask=4294967295
        HOH_24_CAN1: CanHandleType=BASIC, CanHwObjectCount=12, CanIdType=EXTENDED, CanObjectType=RECEIVE, CanObjectId=23, CanControllerRef=CAN1
          CanAdvancedFeature: CanAdvancedFeatureRef=AF_Host
          CanHwFilter: CanHwFilterCode=419351087, CanHwFilterMask=4294967295
        HOH_25_CAN1: CanHandleType=BASIC, CanHwObjectCount=12, CanIdType=EXTENDED, CanObjectType=RECEIVE, CanObjectId=24, CanControllerRef=CAN1
          CanAdvancedFeature: CanAdvancedFeatureRef=AF_Host
          CanHwFilter: CanHwFilterCode=419406361, CanHwFilterMask=4294967295
        HOH_26_CAN1: CanHandleType=BASIC, CanHwObjectCount=12, CanIdType=EXTENDED, CanObjectType=RECEIVE, CanObjectId=25, CanControllerRef=CAN1
          CanAdvancedFeature: CanAdvancedFeatureRef=AF_ToCan3_Host
          CanHwFilter: CanHwFilterCode=419414330, CanHwFilterMask=4294967295
        HOH_1_CAN2: CanHandleType=BASIC, CanHwObjectCount=12, CanIdType=STANDARD, CanObjectType=RECEIVE, CanObjectId=26, CanControllerRef=CAN2
          CanHwFilter: CanHwFilterCode=0, CanHwFilterMask=0
          RangeFilter: RangeEnd=1408, RangeStart=1281
        HOH_2_CAN2: CanHandleType=BASIC, CanHwObjectCount=12, CanIdType=STANDARD, CanObjectType=RECEIVE, CanObjectId=27, CanControllerRef=CAN2
          CanAdvancedFeature: CanAdvancedFeatureRef=AF_Host
          CanHwFilter: CanHwFilterCode=1538, CanHwFilterMask=2047
        HOH_3_CAN2: CanHandleType=BASIC, CanHwObjectCount=12, CanIdType=STANDARD, CanObjectType=RECEIVE, CanObjectId=28, CanControllerRef=CAN2
          CanAdvancedFeature: CanAdvancedFeatureRef=AF_Host
          CanHwFilter: CanHwFilterCode=1568, CanHwFilterMask=2047
        HOH_4_CAN2: CanHandleType=BASIC, CanHwObjectCount=12, CanIdType=STANDARD, CanObjectType=RECEIVE, CanObjectId=29, CanControllerRef=CAN2
          CanAdvancedFeature: CanAdvancedFeatureRef=AF_Host
          CanHwFilter: CanHwFilterCode=1632, CanHwFilterMask=2047
        HOH_5_CAN2: CanHandleType=BASIC, CanHwObjectCount=12, CanIdType=STANDARD, CanObjectType=RECEIVE, CanObjectId=30, CanControllerRef=CAN2
          CanAdvancedFeature: CanAdvancedFeatureRef=AF_Host
          CanHwFilter: CanHwFilterCode=1633, CanHwFilterMask=2047
        HOH_6_CAN2: CanHandleType=BASIC, CanHwObjectCount=12, CanIdType=STANDARD, CanObjectType=RECEIVE, CanObjectId=31, CanControllerRef=CAN2
          CanAdvancedFeature: CanAdvancedFeatureRef=AF_Host
          CanHwFilter: CanHwFilterCode=1634, CanHwFilterMask=2047
        HOH_7_CAN2: CanHandleType=BASIC, CanHwObjectCount=12, CanIdType=STANDARD, CanObjectType=RECEIVE, CanObjectId=32, CanControllerRef=CAN2
          CanAdvancedFeature: CanAdvancedFeatureRef=AF_Host
          CanHwFilter: CanHwFilterCode=1635, CanHwFilterMask=2047
        HOH_8_CAN2: CanHandleType=BASIC, CanHwObjectCount=12, CanIdType=EXTENDED, CanObjectType=RECEIVE, CanObjectId=33, CanControllerRef=CAN2
          CanAdvancedFeature: CanAdvancedFeatureRef=AF_ToCan1_Host
          CanHwFilter: CanHwFilterCode=419140446, CanHwFilterMask=4294967295
        HOH_9_CAN2: CanHandleType=BASIC, CanHwObjectCount=12, CanIdType=EXTENDED, CanObjectType=RECEIVE, CanObjectId=34, CanControllerRef=CAN2
          CanAdvancedFeature: CanAdvancedFeatureRef=AF_ToCan1_3_4_5_6_7_Host
          CanHwFilter: CanHwFilterCode=436085076, CanHwFilterMask=4294967295
        HOH_1_CAN3: CanHandleType=BASIC, CanHwObjectCount=12, CanIdType=STANDARD, CanObjectType=RECEIVE, CanObjectId=35, CanControllerRef=CAN3
          CanHwFilter: CanHwFilterCode=0, CanHwFilterMask=0
          RangeFilter: RangeEnd=1408, RangeStart=1281
        HOH_2_CAN3: CanHandleType=BASIC, CanHwObjectCount=12, CanIdType=EXTENDED, CanObjectType=RECEIVE, CanObjectId=36, CanControllerRef=CAN3
          CanAdvancedFeature: CanAdvancedFeatureRef=AF_Host
          CanHwFilter: CanHwFilterCode=218038277, CanHwFilterMask=4294967295
        HOH_3_CAN3: CanHandleType=BASIC, CanHwObjectCount=12, CanIdType=EXTENDED, CanObjectType=RECEIVE, CanObjectId=37, CanControllerRef=CAN3
          CanAdvancedFeature: CanAdvancedFeatureRef=AF_Host
          CanHwFilter: CanHwFilterCode=218038533, CanHwFilterMask=4294967295
        HOH_4_CAN3: CanHandleType=BASIC, CanHwObjectCount=12, CanIdType=EXTENDED, CanObjectType=RECEIVE, CanObjectId=38, CanControllerRef=CAN3
          CanAdvancedFeature: CanAdvancedFeatureRef=AF_Host
          CanHwFilter: CanHwFilterCode=218038789, CanHwFilterMask=4294967295
        HOH_5_CAN3: CanHandleType=BASIC, CanHwObjectCount=12, CanIdType=EXTENDED, CanObjectType=RECEIVE, CanObjectId=39, CanControllerRef=CAN3
          CanAdvancedFeature: CanAdvancedFeatureRef=AF_Host
          CanHwFilter: CanHwFilterCode=411168755, CanHwFilterMask=4294967295
        HOH_6_CAN3: CanHandleType=BASIC, CanHwObjectCount=12, CanIdType=EXTENDED, CanObjectType=RECEIVE, CanObjectId=40, CanControllerRef=CAN3
          CanAdvancedFeature: CanAdvancedFeatureRef=AF_ToCan7_Host
          CanHwFilter: CanHwFilterCode=411299827, CanHwFilterMask=4294967295
        HOH_7_CAN3: CanHandleType=BASIC, CanHwObjectCount=12, CanIdType=EXTENDED, CanObjectType=RECEIVE, CanObjectId=41, CanControllerRef=CAN3
          CanAdvancedFeature: CanAdvancedFeatureRef=AF_ToCan7_Host
          CanHwFilter: CanHwFilterCode=411365363, CanHwFilterMask=4294967295
        HOH_8_CAN3: CanHandleType=BASIC, CanHwObjectCount=12, CanIdType=EXTENDED, CanObjectType=RECEIVE, CanObjectId=42, CanControllerRef=CAN3
          CanAdvancedFeature: CanAdvancedFeatureRef=AF_ToCan7_Host
          CanHwFilter: CanHwFilterCode=411496435, CanHwFilterMask=4294967295
        HOH_9_CAN3: CanHandleType=BASIC, CanHwObjectCount=12, CanIdType=EXTENDED, CanObjectType=RECEIVE, CanObjectId=43, CanControllerRef=CAN3
          CanAdvancedFeature: CanAdvancedFeatureRef=AF_Host
          CanHwFilter: CanHwFilterCode=411561971, CanHwFilterMask=4294967295
        HOH_10_CAN3: CanHandleType=BASIC, CanHwObjectCount=12, CanIdType=EXTENDED, CanObjectType=RECEIVE, CanObjectId=44, CanControllerRef=CAN3
          CanAdvancedFeature: CanAdvancedFeatureRef=AF_Host
          CanHwFilter: CanHwFilterCode=415559667, CanHwFilterMask=4294967295
        HOH_11_CAN3: CanHandleType=BASIC, CanHwObjectCount=12, CanIdType=EXTENDED, CanObjectType=RECEIVE, CanObjectId=45, CanControllerRef=CAN3
          CanAdvancedFeature: CanAdvancedFeatureRef=AF_Host
          CanHwFilter: CanHwFilterCode=417003781, CanHwFilterMask=4294967295
        HOH_12_CAN3: CanHandleType=BASIC, CanHwObjectCount=12, CanIdType=EXTENDED, CanObjectType=RECEIVE, CanObjectId=46, CanControllerRef=CAN3
          CanAdvancedFeature: CanAdvancedFeatureRef=AF_Host
          CanHwFilter: CanHwFilterCode=417003911, CanHwFilterMask=4294967295
        HOH_13_CAN3: CanHandleType=BASIC, CanHwObjectCount=12, CanIdType=EXTENDED, CanObjectType=RECEIVE, CanObjectId=47, CanControllerRef=CAN3
          CanAdvancedFeature: CanAdvancedFeatureRef=AF_Host
          CanHwFilter: CanHwFilterCode=417004020, CanHwFilterMask=4294967295
        HOH_14_CAN3: CanHandleType=BASIC, CanHwObjectCount=12, CanIdType=EXTENDED, CanObjectType=RECEIVE, CanObjectId=48, CanControllerRef=CAN3
          CanAdvancedFeature: CanAdvancedFeatureRef=AF_Host
          CanHwFilter: CanHwFilterCode=417525747, CanHwFilterMask=4294967295
        HOH_15_CAN3: CanHandleType=BASIC, CanHwObjectCount=12, CanIdType=EXTENDED, CanObjectType=RECEIVE, CanObjectId=49, CanControllerRef=CAN3
          CanAdvancedFeature: CanAdvancedFeatureRef=AF_ToCan1_Host
          CanHwFilter: CanHwFilterCode=419382772, CanHwFilterMask=4294967295
        HOH_16_CAN3: CanHandleType=BASIC, CanHwObjectCount=12, CanIdType=EXTENDED, CanObjectType=RECEIVE, CanObjectId=50, CanControllerRef=CAN3
          CanAdvancedFeature: CanAdvancedFeatureRef=AF_Host
          CanHwFilter: CanHwFilterCode=419425849, CanHwFilterMask=4294967295
        HOH_1_CAN4: CanHandleType=BASIC, CanHwObjectCount=12, CanIdType=STANDARD, CanObjectType=RECEIVE, CanObjectId=51, CanControllerRef=CAN4
          CanHwFilter: CanHwFilterCode=0, CanHwFilterMask=0
          RangeFilter: RangeEnd=1408, RangeStart=1281
        HOH_2_CAN4: CanHandleType=BASIC, CanHwObjectCount=12, CanIdType=STANDARD, CanObjectType=RECEIVE, CanObjectId=52, CanControllerRef=CAN4
          CanAdvancedFeature: CanAdvancedFeatureRef=AF_Host
          CanHwFilter: CanHwFilterCode=513, CanHwFilterMask=2047
        HOH_3_CAN4: CanHandleType=BASIC, CanHwObjectCount=12, CanIdType=STANDARD, CanObjectType=RECEIVE, CanObjectId=53, CanControllerRef=CAN4
          CanAdvancedFeature: CanAdvancedFeatureRef=AF_Host
          CanHwFilter: CanHwFilterCode=514, CanHwFilterMask=2047
        HOH_4_CAN4: CanHandleType=BASIC, CanHwObjectCount=12, CanIdType=STANDARD, CanObjectType=RECEIVE, CanObjectId=54, CanControllerRef=CAN4
          CanAdvancedFeature: CanAdvancedFeatureRef=AF_Host
          CanHwFilter: CanHwFilterCode=515, CanHwFilterMask=2047
        HOH_5_CAN4: CanHandleType=BASIC, CanHwObjectCount=12, CanIdType=STANDARD, CanObjectType=RECEIVE, CanObjectId=55, CanControllerRef=CAN4
          CanAdvancedFeature: CanAdvancedFeatureRef=AF_ToCan2_Host
          CanHwFilter: CanHwFilterCode=517, CanHwFilterMask=2047
        HOH_6_CAN4: CanHandleType=BASIC, CanHwObjectCount=12, CanIdType=STANDARD, CanObjectType=RECEIVE, CanObjectId=56, CanControllerRef=CAN4
          CanAdvancedFeature: CanAdvancedFeatureRef=AF_Host
          CanHwFilter: CanHwFilterCode=518, CanHwFilterMask=2047
        HOH_7_CAN4: CanHandleType=BASIC, CanHwObjectCount=12, CanIdType=STANDARD, CanObjectType=RECEIVE, CanObjectId=57, CanControllerRef=CAN4
          CanAdvancedFeature: CanAdvancedFeatureRef=AF_Host
          CanHwFilter: CanHwFilterCode=522, CanHwFilterMask=2047
        HOH_8_CAN4: CanHandleType=BASIC, CanHwObjectCount=12, CanIdType=STANDARD, CanObjectType=RECEIVE, CanObjectId=58, CanControllerRef=CAN4
          CanAdvancedFeature: CanAdvancedFeatureRef=AF_Host
          CanHwFilter: CanHwFilterCode=1540, CanHwFilterMask=2047
        HOH_9_CAN4: CanHandleType=BASIC, CanHwObjectCount=12, CanIdType=STANDARD, CanObjectType=RECEIVE, CanObjectId=59, CanControllerRef=CAN4
          CanAdvancedFeature: CanAdvancedFeatureRef=AF_Host
          CanHwFilter: CanHwFilterCode=1636, CanHwFilterMask=2047
        HOH_10_CAN4: CanHandleType=BASIC, CanHwObjectCount=12, CanIdType=EXTENDED, CanObjectType=RECEIVE, CanObjectId=60, CanControllerRef=CAN4
          CanAdvancedFeature: CanAdvancedFeatureRef=AF_ToCan1_Host
          CanHwFilter: CanHwFilterCode=419319532, CanHwFilterMask=4294967295
        HOH_1_CAN5: CanHandleType=BASIC, CanHwObjectCount=12, CanIdType=STANDARD, CanObjectType=RECEIVE, CanObjectId=61, CanControllerRef=CAN5
          CanHwFilter: CanHwFilterCode=0, CanHwFilterMask=0
          RangeFilter: RangeEnd=1408, RangeStart=1281
        HOH_2_CAN5: CanHandleType=BASIC, CanHwObjectCount=12, CanIdType=STANDARD, CanObjectType=RECEIVE, CanObjectId=62, CanControllerRef=CAN5
          CanAdvancedFeature: CanAdvancedFeatureRef=AF_Host
          CanHwFilter: CanHwFilterCode=1616, CanHwFilterMask=2047
        HOH_1_CAN6: CanHandleType=BASIC, CanHwObjectCount=12, CanIdType=STANDARD, CanObjectType=RECEIVE, CanObjectId=63, CanControllerRef=CAN6
          CanHwFilter: CanHwFilterCode=0, CanHwFilterMask=0
          RangeFilter: RangeEnd=1408, RangeStart=1281
        HOH_1_CAN7: CanHandleType=BASIC, CanHwObjectCount=12, CanIdType=STANDARD, CanObjectType=RECEIVE, CanObjectId=64, CanControllerRef=CAN7
          CanHwFilter: CanHwFilterCode=0, CanHwFilterMask=0
          RangeFilter: RangeEnd=1408, RangeStart=1281
        HOH_2_CAN7: CanHandleType=BASIC, CanHwObjectCount=12, CanIdType=EXTENDED, CanObjectType=RECEIVE, CanObjectId=65, CanControllerRef=CAN7
          CanAdvancedFeature: CanAdvancedFeatureRef=AF_Host
          CanHwFilter: CanHwFilterCode=417003912, CanHwFilterMask=4294967295
        HOH_3_CAN7: CanHandleType=BASIC, CanHwObjectCount=12, CanIdType=EXTENDED, CanObjectType=RECEIVE, CanObjectId=66, CanControllerRef=CAN7
          CanAdvancedFeature: CanAdvancedFeatureRef=AF_Host
          CanHwFilter: CanHwFilterCode=417003913, CanHwFilterMask=4294967295
        HOH_4_CAN7: CanHandleType=BASIC, CanHwObjectCount=12, CanIdType=EXTENDED, CanObjectType=RECEIVE, CanObjectId=67, CanControllerRef=CAN7
          CanAdvancedFeature: CanAdvancedFeatureRef=AF_Host
          CanHwFilter: CanHwFilterCode=417003920, CanHwFilterMask=4294967295
        HOH_0_Can8_Xcp: CanHandleType=FULL, CanHwObjectCount=16, CanIdType=STANDARD, CanObjectType=TRANSMIT, CanTxAddFrameMac=0, CanObjectId=79, CanControllerRef=CAN_XCP
          CanHwFilter: CanHwFilterCode=1569, CanHwFilterMask=0
        HOH_1_Can8_Xcp: CanHandleType=BASIC, CanHwObjectCount=1, CanIdType=STANDARD, CanObjectType=RECEIVE, CanObjectId=68, CanControllerRef=CAN_XCP
          CanAdvancedFeature: CanAdvancedFeatureRef=AF_Host
          CanHwFilter: CanHwFilterCode=1639, CanHwFilterMask=2047
        HOH_TX_0_CAN1: CanHandleType=BASIC, CanHwObjectCount=10, CanIdType=MIXED, CanObjectType=TRANSMIT, CanTxAddFrameMac=0, CanObjectId=80, CanControllerRef=CAN1
          CanHwFilter: CanHwFilterCode=0, CanHwFilterMask=0
        HOH_TX_0_CAN2: CanHandleType=BASIC, CanHwObjectCount=13, CanIdType=MIXED, CanObjectType=TRANSMIT, CanTxAddFrameMac=0, CanObjectId=81, CanControllerRef=CAN2
          CanHwFilter: CanHwFilterCode=0, CanHwFilterMask=0
        HOH_TX_0_CAN3: CanHandleType=BASIC, CanHwObjectCount=15, CanIdType=MIXED, CanObjectType=TRANSMIT, CanTxAddFrameMac=0, CanObjectId=82, CanControllerRef=CAN3
          CanHwFilter: CanHwFilterCode=0, CanHwFilterMask=0
        HOH_TX_0_CAN4: CanHandleType=BASIC, CanHwObjectCount=10, CanIdType=MIXED, CanObjectType=TRANSMIT, CanTxAddFrameMac=0, CanObjectId=83, CanControllerRef=CAN4
          CanHwFilter: CanHwFilterCode=0, CanHwFilterMask=0
        HOH_TX_0_CAN5: CanHandleType=BASIC, CanHwObjectCount=5, CanIdType=MIXED, CanObjectType=TRANSMIT, CanTxAddFrameMac=0, CanObjectId=84, CanControllerRef=CAN5
          CanHwFilter: CanHwFilterCode=0, CanHwFilterMask=0
        HOH_TX_0_CAN6: CanHandleType=BASIC, CanHwObjectCount=10, CanIdType=MIXED, CanObjectType=TRANSMIT, CanTxAddFrameMac=0, CanObjectId=85, CanControllerRef=CAN6
          CanHwFilter: CanHwFilterCode=0, CanHwFilterMask=0
        HOH_TX_0_CAN7: CanHandleType=BASIC, CanHwObjectCount=11, CanIdType=MIXED, CanObjectType=TRANSMIT, CanTxAddFrameMac=0, CanObjectId=86, CanControllerRef=CAN7
          CanHwFilter: CanHwFilterCode=0, CanHwFilterMask=0
        HOH_TX_LOGGING_EXT_CAN1: CanHandleType=BASIC, CanHwObjectCount=16, CanIdType=EXTENDED, CanObjectType=RECEIVE, CanObjectId=69, CanControllerRef=CAN1
          CanAdvancedFeature: CanAdvancedFeatureRef=AF_Host
          CanHwFilter: CanHwFilterCode=0, CanHwFilterMask=0
          RangeFilter: RangeEnd=4294967295, RangeStart=2048
        HOH_TX_LOGGING_EXT_CAN2: CanHandleType=BASIC, CanHwObjectCount=16, CanIdType=EXTENDED, CanObjectType=RECEIVE, CanObjectId=70, CanControllerRef=CAN2
          CanAdvancedFeature: CanAdvancedFeatureRef=AF_Host
          CanHwFilter: CanHwFilterCode=0, CanHwFilterMask=0
          RangeFilter: RangeEnd=4294967295, RangeStart=2048
        HOH_TX_LOGGING_EXT_CAN3: CanHandleType=BASIC, CanHwObjectCount=16, CanIdType=EXTENDED, CanObjectType=RECEIVE, CanObjectId=71, CanControllerRef=CAN3
          CanAdvancedFeature: CanAdvancedFeatureRef=AF_Host
          CanHwFilter: CanHwFilterCode=0, CanHwFilterMask=0
          RangeFilter: RangeEnd=4294967295, RangeStart=2048
        HOH_TX_LOGGING_EXT_CAN4: CanHandleType=BASIC, CanHwObjectCount=16, CanIdType=EXTENDED, CanObjectType=RECEIVE, CanObjectId=72, CanControllerRef=CAN4
          CanAdvancedFeature: CanAdvancedFeatureRef=AF_Host
          CanHwFilter: CanHwFilterCode=0, CanHwFilterMask=0
          RangeFilter: RangeEnd=4294967295, RangeStart=2048
        HOH_TX_LOGGING_EXT_CAN5: CanHandleType=BASIC, CanHwObjectCount=16, CanIdType=EXTENDED, CanObjectType=RECEIVE, CanObjectId=73, CanControllerRef=CAN5
          CanAdvancedFeature: CanAdvancedFeatureRef=AF_Host
          CanHwFilter: CanHwFilterCode=0, CanHwFilterMask=0
          RangeFilter: RangeEnd=4294967295, RangeStart=2048
        HOH_TX_LOGGING_EXT_CAN6: CanHandleType=BASIC, CanHwObjectCount=16, CanIdType=EXTENDED, CanObjectType=RECEIVE, CanObjectId=74, CanControllerRef=CAN6
          CanAdvancedFeature: CanAdvancedFeatureRef=AF_Host
          CanHwFilter: CanHwFilterCode=0, CanHwFilterMask=0
          RangeFilter: RangeEnd=4294967295, RangeStart=2048
        HOH_TX_LOGGING_EXT_CAN7: CanHandleType=BASIC, CanHwObjectCount=16, CanIdType=EXTENDED, CanObjectType=RECEIVE, CanObjectId=75, CanControllerRef=CAN7
          CanAdvancedFeature: CanAdvancedFeatureRef=AF_Host
          CanHwFilter: CanHwFilterCode=0, CanHwFilterMask=0
          RangeFilter: RangeEnd=4294967295, RangeStart=2048
        HOH_TX_LOGGING_STD_CAN2: CanHandleType=BASIC, CanHwObjectCount=16, CanIdType=STANDARD, CanObjectType=RECEIVE, CanObjectId=76, CanControllerRef=CAN2
          CanAdvancedFeature: CanAdvancedFeatureRef=AF_Host
          CanHwFilter: CanHwFilterCode=0, CanHwFilterMask=0
          RangeFilter: RangeEnd=2047, RangeStart=0
        HOH_TX_LOGGING_STD_CAN4: CanHandleType=BASIC, CanHwObjectCount=16, CanIdType=STANDARD, CanObjectType=RECEIVE, CanObjectId=77, CanControllerRef=CAN4
          CanAdvancedFeature: CanAdvancedFeatureRef=AF_Host
          CanHwFilter: CanHwFilterCode=0, CanHwFilterMask=0
          RangeFilter: RangeEnd=2047, RangeStart=0
        HOH_TX_LOGGING_STD_CAN6: CanHandleType=BASIC, CanHwObjectCount=16, CanIdType=STANDARD, CanObjectType=RECEIVE, CanObjectId=78, CanControllerRef=CAN6
          CanAdvancedFeature: CanAdvancedFeatureRef=AF_Host
          CanHwFilter: CanHwFilterCode=0, CanHwFilterMask=0
          RangeFilter: RangeEnd=2047, RangeStart=0
    CanGeneral:
      BusOffNotification = NULL_PTR
      CanAbortOnlyOneMB = 1
      CanApiEnableMbAbort = 0
      CanDevErrorDetect = 0
      CanEnableUserModeSupport = 0
      CanIndex = 0
      CanLPduReceiveCalloutFunction = CanRxProcessCallback
      CanMainFunctionModePeriod = 0.005
      CanMulticoreSupport = 0
      CanMultiplexedTransmission = 1
      CanPublicIcomSupport = 0
      CanTimeoutDuration = 1.0
      CanTimeoutMethod = OSIF_COUNTER_DUMMY
      CanVersionInfoApi = 1
      LPDUCalloutExtension = 1
      CanSupportTTCANRef = (unset)
